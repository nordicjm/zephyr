## boards/arm/bbc_microbit_v2/Kconfig.bbc_microbit_v2
```kconfig
config BOARD_BBC_MICROBIT_V2
	bool
	default y
	select SOC_SERIES_NRF52X
	select SOC_NRF52833_QIAA
```

## boards/arm/bcm958401m2/Kconfig.valkyrie_bcm958401m2
```kconfig
config BOARD_VALKYRIE_BCM958401M2
	bool
	default y
	select SOC_SERIES_VALKYRIE
	select SOC_BCM58400
```

## boards/arm/bcm958402m2_m7/Kconfig.bcm958402m2_m7
```kconfig
config BOARD_BCM958402M2_M7
	bool
	default y
	select SOC_SERIES_VIPER
	select SOC_BCM58402_M7
```

## boards/arm/bl5340_dvk/Kconfig.bl5340_dvk_cpunet
```kconfig
config BOARD_BL5340_DVK_CPUNET
	bool
	default y
	select SOC_SERIES_NRF53X
	select SOC_NRF5340_CPUNET_QKAA
```

## boards/arm/bl5340_dvk/Kconfig.board
```kconfig
# BL5340-DVK board configuration

# Copyright (c) 2021 Laird Connectivity
# SPDX-License-Identifier: Apache-2.0

config BOARD_BL5340_DVK_CPUAPP
	bool "b1"
#bool
	select SOC_SERIES_NRF53X
	select SOC_NRF5340_CPUAPP_QKAA
	help
	  BL5340-DVK (nRF5340) Application MCU

config BOARD_BL5340_DVK_CPUAPP_NS
	bool "b2"
#bool
	select SOC_SERIES_NRF53X
	select SOC_NRF5340_CPUAPP_QKAA
	help
	  BL5340-DVK (nRF5340) Application MCU non-secure

config BOARD_BL5340_DVK_CPUNET
	bool "b3"
#bool
	select SOC_SERIES_NRF53X
	select SOC_NRF5340_CPUNET_QKAA
	help
	  BL5340-DVK (nRF5340) Network MCU
```

## boards/arm/bl652_dvk/Kconfig.bl652_dvk
```kconfig
config BOARD_BL652_DVK
	bool
	default y
	select CONFIG_SOC_SERIES_NRF52X
	select CONFIG_SOC_NRF52832_QFAA
```

## boards/arm/bl653_dvk/Kconfig.bl653_dvk
```kconfig
config BOARD_BL653_DVK
	bool
	default y
	select SOC_SERIES_NRF52X
	select SOC_NRF52833_QIAA
```

## boards/arm/bl654_dvk/Kconfig.bl654_dvk
```kconfig
config BOARD_BL654_DVK
	bool
	default y
	select SOC_SERIES_NRF52X
	select SOC_NRF52840_QIAA
```

## boards/arm/bl654_sensor_board/Kconfig.bl654_sensor_board
```kconfig
config BOARD_BL654_SENSOR_BOARD
	bool
	default y
	select SOC_SERIES_NRF52X
	select SOC_NRF52840_QIAA
```

## boards/arm/bl654_usb/Kconfig.bl654_usb
```kconfig
config BOARD_BL654_USB
	bool
	default y
	select SOC_SERIES_NRF52X
	select SOC_NRF52840_QIAA
```

## boards/arm/black_f407zg_pro/Kconfig.black_f407zg_pro
```kconfig
config BOARD_BLACK_F407ZG_PRO
	bool
	default y
	select SOC_SERIES_STM32F4X
	select SOC_STM32F407XG
```

## boards/arm/blackpill_f401cc/Kconfig.blackpill_f401cc
```kconfig
config BOARD_BLACKPILL_F401CC
	bool
	default y
	select SOC_SERIES_STM32F4X
	select SOC_STM32F401XC
```

## boards/arm/blackpill_f401cc/Kconfig.board
```kconfig
# Copyright (c) 2022 Linaro Limited
# SPDX-License-Identifier: Apache-2.0

# STM32F401CC based Black Pill V3.0+ board configuration

config BOARD_BLACKPILL_F401CC
```

## boards/arm/blackpill_f401ce/Kconfig.blackpill_f401ce
```kconfig
config BOARD_BLACKPILL_F401CE
	bool
	default y
	select SOC_SERIES_STM32F4X
	select SOC_STM32F401XE
```

## boards/arm/blackpill_f411ce/Kconfig.blackpill_f411ce
```kconfig
config BOARD_BLACKPILL_F411CE
	bool
	default y
	select SOC_SERIES_STM32F4X
	select SOC_STM32F411XE
```

## boards/arm/blueclover_plt_demo_v2_nrf52832/Kconfig.blueclover_plt_demo_v2_nrf52832
```kconfig
config BOARD_BLUECLOVER_PLT_DEMO_V2_NRF52832
	bool
	default y
	select SOC_SERIES_NRF52X
	select SOC_NRF52832_QFAA
```

## boards/arm/blueclover_plt_demo_v2_nrf52832/Kconfig.board
```kconfig
# Blue Clover PLT Demo V2 Configuration

# Copyright (c) 2021 Blue Clover
# SPDX-License-Identifier: Apache-2.0

config BOARD_BLUECLOVER_PLT_DEMO_V2_NRF52832
```

## boards/arm/bt510/Kconfig.board
```kconfig
# BT510 DVK board configuration

# Copyright (c) 2020 Laird Connectivity
# SPDX-License-Identifier: Apache-2.0

config BOARD_BT510
```

## boards/arm/bt510/Kconfig.bt510
```kconfig
config BOARD_BT510
	bool
	default y
	select SOC_SERIES_NRF52X
	select SOC_NRF52840_QIAA
```

## boards/arm/bt610/Kconfig.board
```kconfig
# BT610 board configuration

# Copyright (c) 2021 Laird Connectivity
# SPDX-License-Identifier: Apache-2.0

config BOARD_BT610
```

## boards/arm/bt610/Kconfig.bt610
```kconfig
config BOARD_BT610
	bool
	default y
	select SOC_SERIES_NRF52X
	select SOC_NRF52840_QIAA
```

## boards/arm/bt710/mcuboot_defconfig
```kconfig
CONFIG_PINCTRL=y
CONFIG_MAIN_STACK_SIZE=2048
CONFIG_NRFX_GPIOTE_NUM_OF_EVT_HANDLERS=1
CONFIG_NRFX_TWI0=y
CONFIG_ZCBOR=y
CONFIG_MCUBOOT_UTIL_LOG_LEVEL_WRN=y
CONFIG_SOC_SERIES_NRF52X=y
CONFIG_SOC_NRF52833_QIAA=y
CONFIG_ARM_MPU=y
CONFIG_SYSTEM_WORKQUEUE_STACK_SIZE=2304
# CONFIG_CLOCK_CONTROL_NRF_SHELL is not set
CONFIG_CLOCK_CONTROL_NRF_K32SRC_RC=y
CONFIG_ENTROPY_NRF5_THR_THRESHOLD=4
CONFIG_ENTROPY_NRF5_ISR_THRESHOLD=12
CONFIG_FLASH=y
# CONFIG_FLASH_SHELL is not set
# CONFIG_BME280 is not set
# CONFIG_LIS2DH is not set
CONFIG_RING_BUFFER=y
CONFIG_BASE64=y
CONFIG_BT=y
CONFIG_BT_PERIPHERAL=y
CONFIG_BT_BUF_ACL_TX_SIZE=502
CONFIG_BT_BUF_ACL_RX_SIZE=502
CONFIG_BT_L2CAP_TX_MTU=498
# CONFIG_BT_CTLR_LE_PING is not set
CONFIG_BT_CTLR_DATA_LENGTH_MAX=251
CONFIG_IMG_MANAGER=y
CONFIG_FILE_SYSTEM=y
CONFIG_FILE_SYSTEM_LITTLEFS=y
CONFIG_LOG=y
CONFIG_LOG_MAX_LEVEL=3
CONFIG_MCUMGR=y
CONFIG_MCUMGR_GRP_FS=y
CONFIG_MCUMGR_GRP_FS_CHECKSUM_HASH=y
CONFIG_MCUMGR_GRP_IMG=y
CONFIG_MCUMGR_GRP_OS=y
CONFIG_MCUMGR_GRP_ZBASIC=y
CONFIG_MCUMGR_GRP_ZBASIC_STORAGE_ERASE=y
CONFIG_MCUMGR_TRANSPORT_WORKQUEUE_STACK_SIZE=4608
CONFIG_MCUMGR_TRANSPORT_NETBUF_SIZE=2475
CONFIG_MCUMGR_TRANSPORT_BT=y
CONFIG_MCUMGR_TRANSPORT_BT_REASSEMBLY=y
CONFIG_MCUMGR_TRANSPORT_BT_CONN_PARAM_CONTROL=y
CONFIG_SHELL=y
CONFIG_SHELL_BACKEND_DUMMY=y
# CONFIG_SHELL_HELP is not set
# CONFIG_SHELL_HISTORY is not set
# CONFIG_SHELL_STATS is not set
# CONFIG_SHELL_CMDS is not set
# CONFIG_DEVICE_SHELL is not set
# CONFIG_DEVMEM_SHELL is not set
CONFIG_FLASH_MAP=y
CONFIG_STREAM_FLASH=y
CONFIG_BOOTLOADER_MCUBOOT=y
CONFIG_MCUBOOT_SIGNATURE_KEY_FILE="/tmp/aa/bootloader/mcuboot/root-rsa-2048.pem"
```

## boards/arm/cc1352r1_launchxl/Kconfig.cc1352r1_launchxl
```kconfig
config BOARD_CC1352R1_LAUNCHXL
	bool
	default y
	select SOC_SERIES_CC13X2_CC26X2
	select SOC_CC1352R
```

## boards/arm/cc26x2r1_launchxl/Kconfig.cc26x2r1_launchxl
```kconfig
config BOARD_CC26X2R1_LAUNCHXL
	bool
	default y
	select SOC_SERIES_CC13X2_CC26X2
	select SOC_CC2652R
```

## boards/arm/cc3220sf_launchxl/Kconfig.cc3220sf_launchxl
```kconfig
config BOARD_CC3220SF_LAUNCHXL
	bool
	default y
	select SOC_SERIES_CC32XX
	select SOC_CC3220SF
```
