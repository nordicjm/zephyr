## boards/arm/serpente/Kconfig.serpente
```kconfig
config BOARD_SERPENTE
	bool
	default y
	select SOC_SERIES_SAMD21
	select SOC_PART_NUMBER_SAMD21E18A
```

## boards/arm/sparkfun_thing_plus_nrf9160/Kconfig.sparkfun_thing_plus_nrf9160
```kconfig
config BOARD_SPARKFUN_THING_PLUS_NRF9160
	bool
	default y
	select SOC_SERIES_NRF91X
	select SOC_NRF9160_SICA
```

## boards/arm/sparkfun_thing_plus_nrf9160/Kconfig.sparkfun_thing_plus_nrf9160_ns
```kconfig
config BOARD_SPARKFUN_THING_PLUS_NRF9160_NS
	bool
	default y
	select SOC_SERIES_NRF91X
	select SOC_NRF9160_SICA
```

## boards/arm/steval_fcu001v1/Kconfig.steval_fcu001v1
```kconfig
config BOARD_STEVAL_FCU001V1
	bool
	default y
	select SOC_SERIES_STM32F4X
	select SOC_STM32F401XC
```

## boards/arm/stm3210c_eval/Kconfig.stm3210c_eval
```kconfig
config BOARD_STM3210C_EVAL
	bool
	default y
	select SOC_SERIES_STM32F1X
	select SOC_STM32F107XC
```

## boards/arm/stm32373c_eval/Kconfig.stm32373c_eval
```kconfig
config BOARD_STM32373C_EVAL
	bool
	default y
	select SOC_SERIES_STM32F3X
	select SOC_STM32F373XC
```

## boards/arm/stm32_min_dev/Kconfig.stm32_min_dev_black
```kconfig
config BOARD_STM32_MIN_DEV_BLACK
	bool
	default y
	select SOC_SERIES_STM32F1X
	select SOC_STM32F103X8
```

## boards/arm/stm32_min_dev/Kconfig.stm32_min_dev_blue
```kconfig
config BOARD_STM32_MIN_DEV_BLUE
	bool
	default y
	select SOC_SERIES_STM32F1X
	select SOC_STM32F103X8
```

## boards/arm/stm32f030_demo/Kconfig.stm32f030_demo
```kconfig
config BOARD_STM32F030_DEMO
	bool
	default y
	select SOC_SERIES_STM32F0X
	select SOC_STM32F030X4
```

## boards/arm/stm32f072_eval/Kconfig.board
```kconfig
# STM32F072-EVAL board configuration

# Copyright (c) 2017 BayLibre, SAS
# SPDX-License-Identifier: Apache-2.0

config BOARD_STM32F072_EVAL
```

## boards/arm/stm32f072_eval/Kconfig.stm32f072_eval
```kconfig
config BOARD_STM32F072_EVAL
	bool
	default y
	select SOC_SERIES_STM32F0X
	select SOC_STM32F072XB
```

## boards/arm/stm32f072b_disco/Kconfig.board
```kconfig
# STM32F072B-DISCO board configuration

# Copyright (c) 2017 Clage GmbH
# SPDX-License-Identifier: Apache-2.0

config BOARD_STM32F072B_DISCO
```

## boards/arm/stm32f072b_disco/Kconfig.stm32f072b_disco
```kconfig
config BOARD_STM32F072B_DISCO
	bool
	default y
	select SOC_SERIES_STM32F0X
	select SOC_STM32F072XB
```

## boards/arm/stm32f0_disco/Kconfig.stm32f0_disco
```kconfig
config BOARD_STM32F0_DISCO
	bool
	default y
	select SOC_SERIES_STM32F0X
	select SOC_STM32F051X8
```

## boards/arm/stm32f103_mini/Kconfig.stm32f103_mini
```kconfig
config BOARD_STM32F103_MINI
	bool
	default y
	select SOC_SERIES_STM32F1X
	select SOC_STM32F103XE
```

## boards/arm/stm32f3_disco/Kconfig.board
```kconfig
# STM32F3DISCOVERY board configuration

# Copyright (c) 2017 I-SENSE group of ICCS
# SPDX-License-Identifier: Apache-2.0

config BOARD_STM32F3_DISCO
```

## boards/arm/stm32f3_disco/Kconfig.stm32f3_disco
```kconfig
config BOARD_STM32F3_DISCO
	bool
	default y
	select SOC_SERIES_STM32F3X
	select SOC_STM32F303XC
```

## boards/arm/stm32f412g_disco/Kconfig.board
```kconfig
# STM32F412G-DISCO board configuration

# SPDX-License-Identifier: Apache-2.0

config BOARD_STM32F412G_DISCO
```

## boards/arm/stm32f412g_disco/Kconfig.stm32f412g_disco
```kconfig
config BOARD_STM32F412G_DISCO
	bool
	default y
	select SOC_SERIES_STM32F4X
	select SOC_STM32F412ZX
```

## boards/arm/stm32f429i_disc1/Kconfig.stm32f429i_disc1
```kconfig
config BOARD_STM32F429I_DISC1
	bool
	default y
	select SOC_SERIES_STM32F4X
	select SOC_STM32F429XX
```

## boards/arm/stm32f469i_disco/Kconfig.stm32f469i_disco
```kconfig
config BOARD_STM32F469I_DISCO
	bool
	default y
	select SOC_SERIES_STM32F4X
	select SOC_STM32F469XX
```

## boards/arm/stm32f4_disco/Kconfig.stm32f4_disco
```kconfig
config BOARD_STM32F4_DISCO
	bool
	default y
	select SOC_SERIES_STM32F4X
	select SOC_STM32F407XG
```

## boards/arm/stm32f723e_disco/Kconfig.stm32f723e_disco
```kconfig
config BOARD_STM32F723E_DISCO
	bool
	default y
	select SOC_SERIES_STM32F7X
	select SOC_STM32F723XX
```

## boards/arm/stm32f7508_dk/Kconfig.board
```kconfig
# STM32F7508-DK Discovery board configuration

# Copyright (c) 2022, Rtone.
# SPDX-License-Identifier: Apache-2.0

config BOARD_STM32F7508_DK
```

## boards/arm/stm32f7508_dk/Kconfig.stm32f7508_dk
```kconfig
config BOARD_STM32F7508_DK
	bool
	default y
	select SOC_SERIES_STM32F7X
	select SOC_STM32F750XX
```
