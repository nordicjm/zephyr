## boards/arm/mm_swiftio/Kconfig.board
```kconfig
#
# Copyright (c) 2019, MADMACHINE LIMITED
#
# SPDX-License-Identifier: Apache-2.0
#

config BOARD_MM_SWIFTIO
```

## boards/arm/mps2_an385/Kconfig.mps2_an385
```kconfig
config BOARD_MPS2_AN385
	bool
	default y
	select SOC_SERIES_MPS2
	select SOC_MPS2_AN385
	select QEMU_TARGET
	select HAS_COVERAGE_SUPPORT
```

## boards/arm/mps2_an521/Kconfig.board
```kconfig
# Copyright (c) 2018-2019 Linaro Limited
# SPDX-License-Identifier: Apache-2.0

config BOARD_MPS2_AN521_CPU0
config BOARD_MPS2_AN521_CPU0_NS
config BOARD_MPS2_AN521_CPU1
```

## boards/arm/mps3_an547/Kconfig.mps3_an547
```kconfig
config BOARD_MPS3_AN547
	bool
	default y
	select SOC_SERIES_MPS3
	select SOC_MPS3_AN547
```

## boards/arm/msp_exp432p401r_launchxl/Kconfig.msp_exp432p401r_launchxl
```kconfig
config BOARD_MSP_EXP432P401R_LAUNCHXL
	bool
	default y
	select SOC_SERIES_MSP432P4XX
	select SOC_MSP432P401R
```

## boards/arm/npcx7m6fb_evb/Kconfig.npcx7m6fb_evb
```kconfig
config BOARD_NPCX7M6FB_EVB
	bool
	default y
	select SOC_NPCX7M6FB
	select SOC_SERIES_NPCX7
```

## boards/arm/npcx9m6f_evb/Kconfig.npcx9m6f_evb
```kconfig
config BOARD_NPCX9M6F_EVB
	bool
	default y
	select SOC_NPCX9M6F
	select SOC_SERIES_NPCX9
```

## boards/arm/nrf21540dk_nrf52840/Kconfig.nrf21540dk_nrf52840
```kconfig
config BOARD_NRF21540DK_NRF52840
	bool
	default y
	select SOC_SERIES_NRF52X
	select SOC_NRF52840_QIAA
```

## boards/arm/nrf51_ble400/Kconfig.nrf51_ble400
```kconfig
config BOARD_NRF51_BLE400
	bool
	default y
	select SOC_SERIES_NRF51X
	select SOC_NRF51822_QFAC
```

## boards/arm/nrf51_blenano/Kconfig.nrf51_blenano
```kconfig
config BOARD_NRF51_BLENANO
	bool
	default y
	select SOC_SERIES_NRF51X
	select SOC_NRF51822_QFAA
```

## boards/arm/nrf51_vbluno51/Kconfig.nrf51_vbluno51
```kconfig
config BOARD_NRF51_VBLUNO51
	bool
	default y
	select SOC_SERIES_NRF51X
	select SOC_NRF51822_QFAC
```

## boards/arm/nrf51_vbluno51/nrf51_vbluno51_defconfig
```kconfig
# SPDX-License-Identifier: Apache-2.0

CONFIG_BOARD_NRF51_VBLUNO51=y

# enable GPIO
CONFIG_GPIO=y

# enable uart driver
CONFIG_SERIAL=y

# enable console
CONFIG_CONSOLE=y
CONFIG_UART_CONSOLE=y

CONFIG_PINCTRL=y
```

## boards/arm/nrf51dk_nrf51422/Kconfig.nrf51dk_nrf51422
```kconfig
config BOARD_NRF51DK_NRF51422
	bool
	default y
	select SOC_SERIES_NRF51X
	select SOC_NRF51822_QFAC
```

## boards/arm/nrf52833dk_nrf52820/Kconfig.nrf52833dk_nrf52820
```kconfig
config BOARD_NRF52833DK_NRF52820
	bool
	default y
	select SOC_SERIES_NRF52X
	select SOC_NRF52820_QDAA
```

## boards/arm/nrf52840_blip/Kconfig.nrf52840_blip
```kconfig
config BOARD_NRF52840_BLIP
	bool
	default y
	select SOC_SERIES_NRF52X
	select SOC_NRF52840_QIAA
```

## boards/arm/nrf52840_mdk_usb_dongle/Kconfig.nrf52840_mdk_usb_dongle
```kconfig
config BOARD_NRF52840_MDK_USB_DONGLE
	bool
	default y
	select SOC_SERIES_NRF52X
	select SOC_NRF52840_QIAA
```

## boards/arm/nrf52840_papyr/Kconfig.nrf52840_papyr
```kconfig
config BOARD_NRF52840_PAPYR
	bool
	default y
	select SOC_SERIES_NRF52X
	select SOC_NRF52840_QIAA
```

## boards/arm/nrf52840dk_nrf52811/Kconfig.nrf52840dk_nrf52811
```kconfig
config BOARD_NRF52840DK_NRF52811
	bool
	default y
	select SOC_SERIES_NRF52X
	select SOC_NRF52811_QFAA
```

## boards/arm/nrf52840dk_nrf52840/Kconfig.nrf52840dk_nrf52840
```kconfig
config BOARD_NRF52840DK_NRF52840
	bool
	default y
	select SOC_SERIES_NRF52X
	select SOC_NRF52840_QIAA
```

## boards/arm/nrf52_blenano2/Kconfig.nrf52_blenano2
```kconfig
config BOARD_NRF52_BLENANO2
	bool
	default y
	select SOC_SERIES_NRF52X
	select SOC_NRF52832_QFAA
```

## boards/arm/nrf52_sparkfun/Kconfig.nrf52_sparkfun
```kconfig
config BOARD_NRF52_SPARKFUN
	bool
	default y
	select SOC_SERIES_NRF52X
	select SOC_NRF52832_QFAA
```

## boards/arm/nrf52dk_nrf52805/Kconfig.board
```kconfig
# nRF52 DK nRF52805 board configuration

# Copyright (c) 2020 Nordic Semiconductor ASA
# SPDX-License-Identifier: Apache-2.0

config BOARD_NRF52DK_NRF52805
```

## boards/arm/nrf52dk_nrf52805/Kconfig.nrf52dk_nrf52805
```kconfig
config BOARD_NRF52DK_NRF52805
	bool
	default y
	select SOC_SERIES_NRF52X
	select SOC_NRF52805_CAAA
```

## boards/arm/nrf52dk_nrf52810/Kconfig.nrf52dk_nrf52810
```kconfig
config BOARD_NRF52DK_NRF52810
	bool
	default y
	select SOC_SERIES_NRF52X
	select SOC_NRF52810_QFAA
```

## boards/arm/nrf52dk_nrf52832/Kconfig.nrf52dk_nrf52832
```kconfig
config BOARD_NRF52DK_NRF52832
	bool
	default y
	select SOC_SERIES_NRF52X
	select SOC_NRF52832_QFAA
```
