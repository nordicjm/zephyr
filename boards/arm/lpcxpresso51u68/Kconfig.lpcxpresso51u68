## boards/arm/lpcxpresso51u68/Kconfig.lpcxpresso51u68
```kconfig
config BOARD_LPCXPRESSO51U68
	bool
	default y
	select SOC_SERIES_LPC51U68
	select SOC_LPC51U68
	select SOC_PART_NUMBER_LPC51U68JBD64
```

## boards/arm/lpcxpresso54114/Kconfig.board
```kconfig
# LPCXpresso54114 board

# Copyright (c) 2017, NXP
# SPDX-License-Identifier: Apache-2.0

config BOARD_LPCXPRESSO54114_M4
config BOARD_LPCXPRESSO54114_M0
```

## boards/arm/lpcxpresso54114/Kconfig.lpcxpresso54114_m4
```kconfig
config BOARD_LPCXPRESSO54114_M4
	bool
	default y
	select SOC_LPC54114_M4
	select SOC_SERIES_LPC54XXX
	select SOC_PART_NUMBER_LPC54114J256BD64
```

## boards/arm/lpcxpresso55s06/Kconfig.board
```kconfig
# LPCXpresso55S06 board

# Copyright (c) 2022 metraTec
# SPDX-License-Identifier: Apache-2.0

config BOARD_LPCXPRESSO55S06
```

## boards/arm/lpcxpresso55s06/Kconfig.lpcxpresso55s06
```kconfig
config BOARD_LPCXPRESSO55S06
	bool
	default y
	select SOC_SERIES_LPC55XXX
	select SOC_LPC55S06
	select SOC_PART_NUMBER_LPC55S06JBD64
```

## boards/arm/lpcxpresso55s16/Kconfig.board
```kconfig
# LPCXpresso55S16 board

# Copyright (c) 2020 Henrik Brix Andersen <henrik@brixandersen.dk>
# SPDX-License-Identifier: Apache-2.0

config BOARD_LPCXPRESSO55S16
```

## boards/arm/lpcxpresso55s16/Kconfig.lpcxpresso55s16
```kconfig
config BOARD_LPCXPRESSO55S16
	bool
	default y
	select SOC_SERIES_LPC55XXX
	select SOC_LPC55S16
	select SOC_PART_NUMBER_LPC55S16JBD100
```

## boards/arm/lpcxpresso55s28/Kconfig.board
```kconfig
# LPCXpresso55S28 board

# Copyright (c) 2020 Lemonbeat GmbH
# SPDX-License-Identifier: Apache-2.0

config BOARD_LPCXPRESSO55S28
```

## boards/arm/lpcxpresso55s28/Kconfig.lpcxpresso55s28
```kconfig
config BOARD_LPCXPRESSO55S28
	bool
	default y
	select SOC_SERIES_LPC55XXX
	select SOC_LPC55S28
	select SOC_PART_NUMBER_LPC55S28JBD100
```

## boards/arm/lpcxpresso55s36/Kconfig.board
```kconfig
# LPCXpresso55S36 board

# Copyright 2022 NXP
# SPDX-License-Identifier: Apache-2.0

config BOARD_LPCXPRESSO55S36
```

## boards/arm/lpcxpresso55s36/Kconfig.lpcxpresso55s36
```kconfig
config BOARD_LPCXPRESSO55S36
	bool
	default y
	select SOC_SERIES_LPC55XXX
	select SOC_LPC55S36
	select SOC_PART_NUMBER_LPC55S36JBD100
```

## boards/arm/lpcxpresso55s69/Kconfig.board
```kconfig
# LPCXpresso55S69 board

# Copyright (c) 2019, NXP
# SPDX-License-Identifier: Apache-2.0

config BOARD_LPCXPRESSO55S69_CPU0
config BOARD_LPCXPRESSO55S69_CPU1
```

## boards/arm/lpcxpresso55s69/Kconfig.lpcxpresso55s69_cpu0
```kconfig
config BOARD_LPCXPRESSO55S69_CPU0
	bool
	default y
	select SOC_SERIES_LPC55XXX
	select SOC_LPC55S69_CPU0
```

## boards/arm/lpcxpresso55s69/Kconfig.lpcxpresso55s69_cpu1
```kconfig
config BOARD_LPCXPRESSO55S69_CPU1
	bool
	default y
	select SOC_SERIES_LPC55XXX
	select SOC_LPC55S69_CPU1
	select SOC_PART_NUMBER_LPC55S69JBD100
```

## boards/arm/mec1501modular_assy6885/Kconfig.mec1501modular_assy6885
```kconfig
config BOARD_MEC1501MODULAR_ASSY6885
	bool
	default y
	select SOC_MEC1501_HSZ
	select SOC_SERIES_MEC1501X
	select SOC_MEC1501_VCI_PINS_AS_GPIOS
```

## boards/arm/mec15xxevb_assy6853/Kconfig.mec15xxevb_assy6853
```kconfig
config BOARD_MEC15XXEVB_ASSY6853
	bool
	default y
	select SOC_MEC1501_HSZ
	select SOC_SERIES_MEC1501X
```

## boards/arm/mec15xxevb_assy6853/mec15xxevb_assy6853_defconfig
```kconfig
#
# Copyright (c) 2019, Intel Corporation
#
# SPDX-License-Identifier: Apache-2.0
#

CONFIG_BOARD_MEC15XXEVB_ASSY6853=y
CONFIG_RTOS_TIMER=y

CONFIG_CONSOLE=y
CONFIG_UART_CONSOLE=y
CONFIG_SERIAL=y
CONFIG_PINMUX=y
CONFIG_GPIO=y

# power management stuff
CONFIG_PM=y
```

## boards/arm/mec172xevb_assy6906/Kconfig.mec172xevb_assy6906
```kconfig
config BOARD_MEC172XEVB_ASSY6906
	bool
	default y
	select SOC_MEC172X_NSZ
	select SOC_SERIES_MEC172X
```

## boards/arm/mec2016evb_assy6797/Kconfig.board
```kconfig
# Copyright (c) 2019, Intel Corporation
# SPDX-License-Identifier: Apache-2.0

config BOARD_MEC2016EVB_ASSY6797
```

## boards/arm/mec2016evb_assy6797/Kconfig.mec2016evb_assy6797
```kconfig
config BOARD_MEC2016EVB_ASSY6797
	bool
	default y
	select SOC_MEC1701_QSZ
	select SOC_SERIES_MEC1701X
```

## boards/arm/mercury_xu/Kconfig.board
```kconfig
# Copyright (c) 2020, Antmicro
# SPDX-License-Identifier: Apache-2.0
config BOARD_MERCURY_XU
```

## boards/arm/mikroe_clicker_2/Kconfig.mikroe_clicker_2
```kconfig
config BOARD_MIKROE_CLICKER_2
	bool
	default y
	select SOC_SERIES_STM32F4X
	select SOC_STM32F407XG
```

## boards/arm/mikroe_mini_m4_for_stm32/Kconfig.mikroe_mini_m4_for_stm32
```kconfig
config BOARD_MIKROE_MINI_M4_FOR_STM32
	bool
	default y
	select SOC_SERIES_STM32F4X
	select SOC_STM32F415XX
```

## boards/arm/mimx8mm_evk/Kconfig.board
```kconfig
# MIMX8MM EVK board

# Copyright (c) 2020, Manivannan Sadhasivam <mani@kernel.org>
# SPDX-License-Identifier: Apache-2.0

config BOARD_MIMX8MM_EVK
```
