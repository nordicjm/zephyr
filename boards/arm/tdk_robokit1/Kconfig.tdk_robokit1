## boards/arm/tdk_robokit1/Kconfig.tdk_robokit1
```kconfig
config BOARD_TDK_ROBOKIT1
	bool
	default y
	select SOC_SERIES_SAME70
	select SOC_PART_NUMBER_SAME70Q21
```

## boards/arm/tdk_robokit1/tdk_robokit1_defconfig
```kconfig
# SPDX-License-Identifier: Apache-2.0

CONFIG_ARM_MPU=y
CONFIG_CORTEX_M_SYSTICK=y
CONFIG_CONSOLE=y
CONFIG_UART_CONSOLE=y
CONFIG_SERIAL=y
CONFIG_BOARD_TDK_ROBOKIT1=y
CONFIG_WDT_DISABLE_AT_BOOT=y
CONFIG_BUILD_OUTPUT_HEX=y

# Enable HW stack protection
CONFIG_HW_STACK_PROTECTION=y
```

## boards/arm/teensy4/Kconfig.board
```kconfig
#
# Copyright (c) 2020, Bernhard Kraemer
#
# SPDX-License-Identifier: Apache-2.0
#

config BOARD_TEENSY40
config BOARD_TEENSY41
```

## boards/arm/teensy4/Kconfig.teensy40
```kconfig
config BOARD_TEENSY40
	bool
	default y
	select SOC_MIMXRT1062
	select SOC_SERIES_IMX_RT
	select SOC_PART_NUMBER_MIMXRT1062DVL6A
```

## boards/arm/teensy4/Kconfig.teensy41
```kconfig
config BOARD_TEENSY41
	bool
	default y
	select SOC_MIMXRT1062
	select SOC_SERIES_IMX_RT
	select SOC_PART_NUMBER_MIMXRT1062DVJ6A
```

## boards/arm/thingy53_nrf5340/Kconfig.board
```kconfig
# Thingy53 NRF5340 board configuration

# Copyright (c) 2021 Nordic Semiconductor ASA
# SPDX-License-Identifier: Apache-2.0

if SOC_NRF5340_CPUAPP_QKAA

config BOARD_THINGY53_NRF5340_CPUAPP
config BOARD_THINGY53_NRF5340_CPUAPP_NS
config BOARD_THINGY53_NRF5340_CPUNET
```

## boards/arm/thingy53_nrf5340/Kconfig.thingy53_nrf5340_cpuapp_ns
```kconfig
config BOARD_THINGY53_NRF5340_CPUAPP_NS
	bool
	default y
	select SOC_SERIES_NRF53X
	select SOC_NRF5340_CPUAPP_QKAA
```

## boards/arm/thingy53_nrf5340/Kconfig.thingy53_nrf5340_cpunet
```kconfig
config BOARD_THINGY53_NRF5340_CPUNET
	bool
	default y
	select SOC_SERIES_NRF53X
	select SOC_NRF5340_CPUNET_QKAA
```

## boards/arm/thingy53_nrf5340/thingy53_nrf5340_cpunet_defconfig
```kconfig
# SPDX-License-Identifier: Apache-2.0

CONFIG_BOARD_THINGY53_NRF5340_CPUNET=y

# Enable MPU
CONFIG_ARM_MPU=y

# Enable hardware stack protection
CONFIG_HW_STACK_PROTECTION=y

# Enable GPIO
CONFIG_GPIO=y

CONFIG_PINCTRL=y
```

## boards/arm/twr_ke18f/Kconfig.twr_ke18f
```kconfig
config BOARD_TWR_KE18F
	bool
	default y
	select SOC_SERIES_KINETIS_KE1XF
	select SOC_MKE18F16
	select SOC_PART_NUMBER_MKE18F512VLL16
```

## boards/arm/twr_ke18f/twr_ke18f_defconfig
```kconfig
# SPDX-License-Identifier: Apache-2.0

CONFIG_BOARD_TWR_KE18F=y
CONFIG_SERIAL=y
CONFIG_CONSOLE=y
CONFIG_UART_CONSOLE=y
CONFIG_UART_INTERRUPT_DRIVEN=y
CONFIG_PINCTRL=y
CONFIG_GPIO=y

# Enable MPU
CONFIG_ARM_MPU=y
```

## boards/arm/twr_kv58f220m/Kconfig.board
```kconfig
# TWR-KV58F220M board configuration

# Copyright (c) 2019 SEAL AG
# SPDX-License-Identifier: Apache-2.0

config BOARD_TWR_KV58F220M
```

## boards/arm/twr_kv58f220m/Kconfig.twr_kv58f220m
```kconfig
config BOARD_TWR_KV58F220M
	bool
	default y
	select SOC_SERIES_KINETIS_KV5X
	select SOC_MKV58F24
	select SOC_PART_NUMBER_MKV58F1M0VLQ24
```

## boards/arm/ubx_bmd300eval_nrf52832/Kconfig.ubx_bmd300eval_nrf52832
```kconfig
config BOARD_UBX_BMD300EVAL_NRF52832
	bool
	default y
	select SOC_SERIES_NRF52X
	select SOC_NRF52832_QFAA
```

## boards/arm/ubx_bmd330eval_nrf52810/Kconfig.ubx_bmd330eval_nrf52810
```kconfig
config BOARD_UBX_BMD330EVAL_NRF52810
	bool
	default y
	select SOC_SERIES_NRF52X
	select SOC_NRF52810_QFAA
```

## boards/arm/ubx_bmd345eval_nrf52840/Kconfig.ubx_bmd345eval_nrf52840
```kconfig
config BOARD_UBX_BMD345EVAL_NRF52840
	bool
	default y
	select SOC_SERIES_NRF52X
	select SOC_NRF52840_QIAA
```

## boards/arm/ubx_bmd360eval_nrf52811/Kconfig.ubx_bmd360eval_nrf52811
```kconfig
config BOARD_UBX_BMD360EVAL_NRF52811
	bool
	default y
	select SOC_SERIES_NRF52X
	select SOC_NRF52811_QFAA
```

## boards/arm/ubx_bmd380eval_nrf52840/Kconfig.board
```kconfig
# BMD-380-EVAL board configuration

# Copyright (c) 2021 u-blox AG
# SPDX-License-Identifier: Apache-2.0

config BOARD_UBX_BMD380EVAL_NRF52840
```

## boards/arm/ubx_bmd380eval_nrf52840/Kconfig.ubx_bmd380eval_nrf52840
```kconfig
config BOARD_UBX_BMD380EVAL_NRF52840
	bool
	default y
	select SOC_SERIES_NRF52X
	select SOC_NRF52840_QIAA
```

## boards/arm/ubx_evkninab4_nrf52833/Kconfig.ubx_evkninab4_nrf52833
```kconfig
config BOARD_UBX_EVKNINAB4_NRF52833
	bool
	default y
	select SOC_SERIES_NRF52X
	select SOC_NRF52833_QIAA
```

## boards/arm/udoo_neo_full_m4/Kconfig.board
```kconfig
# Copyright (c) 2018, NXP
# SPDX-License-Identifier: Apache-2.0

config BOARD_UDOO_NEO_FULL_M4
```

## boards/arm/udoo_neo_full_m4/Kconfig.udoo_neo_full_m4
```kconfig
config BOARD_UDOO_NEO_FULL_M4
	bool
	default y
	select SOC_MCIMX6X_M4
	select SOC_SERIES_IMX_6X_M4
	select SOC_PART_NUMBER_MCIMX6X4EVM10AB
```

## boards/arm/usb_kw24d512/Kconfig.board
```kconfig
# USB-KW24D512 board

# Copyright (c) 2017, Phytec Messtechnik GmbH
# SPDX-License-Identifier: Apache-2.0

config BOARD_USB_KW24D512
```

## boards/arm/usb_kw24d512/Kconfig.usb_kw24d512
```kconfig
config BOARD_USB_KW24D512
	bool
	default y
	select SOC_MKW24D5
	select SOC_SERIES_KINETIS_KWX
	select SOC_PART_NUMBER_MKW24D512VHA5
```

## boards/arm/v2m_beetle/Kconfig.v2m_beetle
```kconfig
config BOARD_V2M_BEETLE
	bool
	default y
	select SOC_BEETLE_R0
	select SOC_SERIES_BEETLE
```
