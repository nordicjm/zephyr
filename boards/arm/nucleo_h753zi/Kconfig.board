## boards/arm/nucleo_h753zi/Kconfig.board
```kconfig
# STM32H753ZI Nucleo board configuration

# Copyright (c) 2021 Blue Clover Devices
# SPDX-License-Identifier: Apache-2.0

config BOARD_NUCLEO_H753ZI
```

## boards/arm/nucleo_h753zi/Kconfig.nucleo_h753zi
```kconfig
config BOARD_NUCLEO_H753ZI
	bool
	default y
	select SOC_SERIES_STM32H7X
	select SOC_STM32H753XX
```

## boards/arm/nucleo_h7a3zi_q/Kconfig.board
```kconfig
# STM32H7A3ZI-Q Nucleo board configuration

# Copyright (c) 2021 Electrolance Solutions
# SPDX-License-Identifier: Apache-2.0

config BOARD_NUCLEO_H7A3ZI_Q
```

## boards/arm/nucleo_h7a3zi_q/Kconfig.nucleo_h7a3zi_q
```kconfig
config BOARD_NUCLEO_H7A3ZI_Q
	bool
	default y
	select SOC_SERIES_STM32H7X
	select SOC_STM32H7A3XXQ
```

## boards/arm/nucleo_l011k4/Kconfig.nucleo_l011k4
```kconfig
config BOARD_NUCLEO_L011K4
	bool
	default y
	select SOC_SERIES_STM32L0X
	select SOC_STM32L011XX
```

## boards/arm/nucleo_l031k6/Kconfig.nucleo_l031k6
```kconfig
config BOARD_NUCLEO_L031K6
	bool
	default y
	select SOC_SERIES_STM32L0X
	select SOC_STM32L031XX
```

## boards/arm/nucleo_l073rz/Kconfig.nucleo_l073rz
```kconfig
config BOARD_NUCLEO_L073RZ
	bool
	default y
	select SOC_SERIES_STM32L0X
	select SOC_STM32L073XX
```

## boards/arm/nucleo_l152re/Kconfig.nucleo_l152re
```kconfig
config BOARD_NUCLEO_L152RE
	bool
	default y
	select SOC_SERIES_STM32L1X
	select SOC_STM32L152XE
```

## boards/arm/nucleo_l412rb_p/Kconfig.nucleo_l412rb_p
```kconfig
config BOARD_NUCLEO_L412RB_P
	bool
	default y
	select SOC_SERIES_STM32L4X
	select SOC_STM32L412XX
```

## boards/arm/nucleo_l432kc/Kconfig.nucleo_l432kc
```kconfig
config BOARD_NUCLEO_L432KC
	bool
	default y
	select SOC_SERIES_STM32L4X
	select SOC_STM32L432XX
```

## boards/arm/nucleo_l452re/Kconfig.nucleo_l452re
```kconfig
config BOARD_NUCLEO_L452RE
	bool
	default y
	select SOC_SERIES_STM32L4X
	select SOC_STM32L452XX
```

## boards/arm/nucleo_l496zg/Kconfig.board
```kconfig
# STM32L496ZG Nucleo board configuration

# Copyright (c) 2018-2019 Centaur Analytics, Inc
# SPDX-License-Identifier: Apache-2.0

config BOARD_NUCLEO_L496ZG
```

## boards/arm/nucleo_l4r5zi/Kconfig.board
```kconfig
# STM32L4R5ZI Nucleo board configuration

# Copyright (c) 2018 Pushpal Sidhu
# SPDX-License-Identifier: Apache-2.0

config BOARD_NUCLEO_L4R5ZI
```

## boards/arm/nucleo_l4r5zi/Kconfig.nucleo_l4r5zi
```kconfig
config BOARD_NUCLEO_L4R5ZI
	bool
	default y
	select SOC_SERIES_STM32L4X
	select SOC_STM32L4R5XX
```

## boards/arm/nucleo_l552ze_q/Kconfig.board
```kconfig
# STM32L552ZE Q Nucleo board configuration

# Copyright (c) 2020 Linaro Limited
# SPDX-License-Identifier: Apache-2.0

config BOARD_NUCLEO_L552ZE_Q
```

## boards/arm/nucleo_l552ze_q/Kconfig.nucleo_l552ze_q
```kconfig
config BOARD_NUCLEO_L552ZE_Q
	bool
	default y
	select SOC_SERIES_STM32L5X
	select SOC_STM32L552XX
```

## boards/arm/nucleo_u575zi_q/Kconfig.board
```kconfig
# STM32U575ZI Q Nucleo board configuration

# Copyright (c) 2021 Linaro Limited
# SPDX-License-Identifier: Apache-2.0

config BOARD_NUCLEO_U575ZI_Q
```

## boards/arm/nucleo_u575zi_q/Kconfig.nucleo_u575zi_q
```kconfig
config BOARD_NUCLEO_U575ZI_Q
	bool
	default y
	select SOC_SERIES_STM32U5X
	select SOC_STM32U575XX
```

## boards/arm/nucleo_wb55rg/Kconfig.board
```kconfig
# STM32WB55RG Nucleo board configuration

# Copyright (c) 2019 Linaro Limited
# SPDX-License-Identifier: Apache-2.0

config BOARD_NUCLEO_WB55RG
```

## boards/arm/nucleo_wb55rg/Kconfig.nucleo_wb55rg
```kconfig
config BOARD_NUCLEO_WB55RG
	bool
	default y
	select SOC_SERIES_STM32WBX
	select SOC_STM32WB55XX
```

## boards/arm/nucleo_wl55jc/Kconfig.board
```kconfig
# STM32WL55JC Nucleo board configuration

# Copyright (c) 2020 STMicroelectronics
# SPDX-License-Identifier: Apache-2.0

config BOARD_NUCLEO_WL55JC
```

## boards/arm/nucleo_wl55jc/Kconfig.nucleo_wl55jc
```kconfig
config BOARD_NUCLEO_WL55JC
	bool
	default y
	select SOC_SERIES_STM32WLX
	select SOC_STM32WL55XX
```

## boards/arm/nuvoton_pfm_m487/Kconfig.board
```kconfig
# SPDX-License-Identifier: Apache-2.0
#
# Nuvoton PFM M487 board configuration
#
# Copyright (c) 2020 Linumiz
# Author: Saravanan Sekar <saravanan@linumiz.com>

config BOARD_NUVOTON_PFM_M487
```

## boards/arm/nuvoton_pfm_m487/Kconfig.nuvoton_pfm_m487
```kconfig
config BOARD_NUVOTON_PFM_M487
	bool
	default y
	select SOC_SERIES_M48X
	select SOC_M487
```

## boards/arm/olimex_lora_stm32wl_devkit/Kconfig.board
```kconfig
# Olimex LoRa STM32WL DevKit configuration

# Copyright (c) 2022 Martin Jäger <martin@libre.solar>
# SPDX-License-Identifier: Apache-2.0

config BOARD_OLIMEX_LORA_STM32WL_DEVKIT
```
