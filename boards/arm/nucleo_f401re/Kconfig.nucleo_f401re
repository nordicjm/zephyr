## boards/arm/nucleo_f401re/Kconfig.nucleo_f401re
```kconfig
config BOARD_NUCLEO_F401RE
	bool
	default y
	select SOC_SERIES_STM32F4X
	select SOC_STM32F401XE
```

## boards/arm/nucleo_f410rb/Kconfig.nucleo_f410rb
```kconfig
config BOARD_NUCLEO_F410RB
	bool
	default y
	select SOC_SERIES_STM32F4X
	select SOC_STM32F410RX
```

## boards/arm/nucleo_f412zg/Kconfig.nucleo_f412zg
```kconfig
config BOARD_NUCLEO_F412ZG
	bool
	default y
	select SOC_SERIES_STM32F4X
	select SOC_STM32F412ZX
```

## boards/arm/nucleo_f413zh/Kconfig.nucleo_f413zh
```kconfig
config BOARD_NUCLEO_F413ZH
	bool
	default y
	select SOC_SERIES_STM32F4X
	select SOC_STM32F413XX
```

## boards/arm/nucleo_f446re/Kconfig.nucleo_f446re
```kconfig
config BOARD_NUCLEO_F446RE
	bool
	default y
	select SOC_SERIES_STM32F4X
	select SOC_STM32F446XX
```

## boards/arm/nucleo_f446ze/Kconfig.board
```kconfig
# STM32F446ZE Nucleo board configuration

# Copyright (c) 2021 Tom Owen
# SPDX-License-Identifier: Apache-2.0

config BOARD_NUCLEO_F446ZE
```

## boards/arm/nucleo_f446ze/Kconfig.nucleo_f446ze
```kconfig
config BOARD_NUCLEO_F446ZE
	bool
	default y
	select SOC_SERIES_STM32F4X
	select SOC_STM32F446XX
```

## boards/arm/nucleo_f746zg/Kconfig.nucleo_f746zg
```kconfig
config BOARD_NUCLEO_F746ZG
	bool
	default y
	select SOC_SERIES_STM32F7X
	select SOC_STM32F746XX
```

## boards/arm/nucleo_f756zg/Kconfig.nucleo_f756zg
```kconfig
config BOARD_NUCLEO_F756ZG
	bool
	default y
	select SOC_SERIES_STM32F7X
	select SOC_STM32F756XX
```

## boards/arm/nucleo_f767zi/Kconfig.board
```kconfig
# STM32F767ZI Nucleo board configuration

# Copyright (c) 2019 Roland Ma
# SPDX-License-Identifier: Apache-2.0

config BOARD_NUCLEO_F767ZI
```

## boards/arm/nucleo_f767zi/Kconfig.nucleo_f767zi
```kconfig
config BOARD_NUCLEO_F767ZI
	bool
	default y
	select SOC_SERIES_STM32F7X
	select SOC_STM32F767XX
```

## boards/arm/nucleo_g031k8/Kconfig.nucleo_g031k8
```kconfig
config BOARD_NUCLEO_G031K8
	bool
	default y
	select SOC_SERIES_STM32G0X
	select SOC_STM32G031XX
```

## boards/arm/nucleo_g071rb/Kconfig.nucleo_g071rb
```kconfig
config BOARD_NUCLEO_G071RB
	bool
	default y
	select SOC_SERIES_STM32G0X
	select SOC_STM32G071XX
```

## boards/arm/nucleo_g0b1re/Kconfig.nucleo_g0b1re
```kconfig
config BOARD_NUCLEO_G0B1RE
	bool
	default y
	select SOC_SERIES_STM32G0X
	select SOC_STM32G0B1XX
```

## boards/arm/nucleo_g431rb/Kconfig.nucleo_g431rb
```kconfig
config BOARD_NUCLEO_G431RB
	bool
	default y
	select SOC_SERIES_STM32G4X
	select SOC_STM32G431XX
```

## boards/arm/nucleo_g474re/Kconfig.nucleo_g474re
```kconfig
config BOARD_NUCLEO_G474RE
	bool
	default y
	select SOC_SERIES_STM32G4X
	select SOC_STM32G474XX
```

## boards/arm/nucleo_h723zg/Kconfig.board
```kconfig
# STM32H723ZG Nucleo board configuration

# Copyright (c) 2020 Alexander Kozhinov <AlexanderKozhinov@yandex.com>
# SPDX-License-Identifier: Apache-2.0

config BOARD_NUCLEO_H723ZG
```

## boards/arm/nucleo_h723zg/Kconfig.nucleo_h723zg
```kconfig
config BOARD_NUCLEO_H723ZG
	bool
	default y
	select SOC_SERIES_STM32H7X
	select SOC_STM32H723XX
```

## boards/arm/nucleo_h723zg/nucleo_h723zg_defconfig
```kconfig
# SPDX-License-Identifier: Apache-2.0


CONFIG_BOARD_NUCLEO_H723ZG=y

# Enable MPU
CONFIG_ARM_MPU=y

# Enable HW stack protection
CONFIG_HW_STACK_PROTECTION=y

# Enable UART
CONFIG_SERIAL=y

# Console
CONFIG_CONSOLE=y
CONFIG_UART_CONSOLE=y

# Enable GPIO
CONFIG_GPIO=y

# Enable Clock
CONFIG_CLOCK_CONTROL=y

# enable pin controller
CONFIG_PINCTRL=y
```

## boards/arm/nucleo_h743zi/Kconfig.board
```kconfig
# STM32H743ZI Nucleo board configuration

# Copyright (c) 2020 Teslabs Engineering S.L.
# SPDX-License-Identifier: Apache-2.0

config BOARD_NUCLEO_H743ZI
```

## boards/arm/nucleo_h743zi/Kconfig.nucleo_h743zi
```kconfig
config BOARD_NUCLEO_H743ZI
	bool
	default y
	select SOC_SERIES_STM32H7X
	select SOC_STM32H743XX
```

## boards/arm/nucleo_h745zi_q/Kconfig.board
```kconfig
# STM32H745ZI Nucleo board configuration

# Copyright (c) 2020 Alexander Kozhinov <AlexanderKozhinov@yandex.com>
# SPDX-License-Identifier: Apache-2.0

config BOARD_NUCLEO_H745ZI_Q_M7
config BOARD_NUCLEO_H745ZI_Q_M4
```

## boards/arm/nucleo_h745zi_q/Kconfig.nucleo_h745zi_q_m4
```kconfig
config BOARD_NUCLEO_H745ZI_Q_M4
	bool
	default y
	select SOC_SERIES_STM32H7X
	select SOC_STM32H745XX
	select CPU_CORTEX_M4
```

## boards/arm/nucleo_h745zi_q/Kconfig.nucleo_h745zi_q_m7
```kconfig
config BOARD_NUCLEO_H745ZI_Q_M7
	bool
	default y
	select SOC_SERIES_STM32H7X
	select SOC_STM32H745XX
	select CPU_CORTEX_M7
```

## boards/arm/nucleo_h745zi_q/nucleo_h745zi_q_m4_defconfig
```kconfig
# SPDX-License-Identifier: Apache-2.0


# Board config should be specified since there are 2 possible targets
CONFIG_BOARD_NUCLEO_H745ZI_Q_M4=y

# Enable GPIO
CONFIG_GPIO=y

# Enable clock
CONFIG_CLOCK_CONTROL=y

# By default SERIAL peripherals are assigned to m7

# Enable uart driver
#CONFIG_SERIAL=y

# Console
#CONFIG_CONSOLE=y
#CONFIG_UART_CONSOLE=y

# enable pin controller
CONFIG_PINCTRL=y
```
