## boards/arm/gd32e103v_eval/Kconfig.gd32e103v_eval
```kconfig
config BOARD_GD32E103V_EVAL
	bool
	default y
	select SOC_SERIES_GD32E10X
	select SOC_GD32E103
```

## boards/arm/gd32e507v_start/Kconfig.board
```kconfig
# Copyright (c) 2022, Teslabs Engineering S.L.
# SPDX-License-Identifier: Apache-2.0

config BOARD_GD32E507V_START
```

## boards/arm/gd32e507v_start/Kconfig.gd32e507v_start
```kconfig
config BOARD_GD32E507V_START
	bool
	default y
	select SOC_SERIES_GD32E50X
	select SOC_GD32E507
```

## boards/arm/gd32e507z_eval/Kconfig.gd32e507z_eval
```kconfig
config BOARD_GD32E507Z_EVAL
	bool
	default y
	select SOC_SERIES_GD32E50X
	select SOC_GD32E507
```

## boards/arm/gd32e507z_eval/gd32e507z_eval_defconfig
```kconfig
# Copyright (c) 2022, Teslabs Engineering S.L.
# SPDX-License-Identifier: Apache-2.0

CONFIG_BOARD_GD32E507Z_EVAL=y

CONFIG_ARM_MPU=y
CONFIG_HW_STACK_PROTECTION=y
CONFIG_CORTEX_M_SYSTICK=y

CONFIG_CONSOLE=y
CONFIG_UART_CONSOLE=y
CONFIG_SERIAL=y

CONFIG_GPIO=y
```

## boards/arm/gd32f350r_eval/Kconfig.board
```kconfig
# Copyright (c) 2021 BrainCo Inc.
# SPDX-License-Identifier: Apache-2.0

config BOARD_GD32F350R_EVAL
```

## boards/arm/gd32f350r_eval/Kconfig.gd32f350r_eval
```kconfig
config BOARD_GD32F350R_EVAL
	bool
	default y
	select SOC_SERIES_GD32F3X0
	select SOC_GD32F350
```

## boards/arm/gd32f403z_eval/Kconfig.gd32f403z_eval
```kconfig
config BOARD_GD32F403Z_EVAL
	bool
	default y
	select SOC_SERIES_GD32F403
	select SOC_GD32F403
```

## boards/arm/gd32f407v_start/Kconfig.gd32f407v_start
```kconfig
config BOARD_GD32F407V_START
	bool
	default y
	select SOC_SERIES_GD32F4XX
	select SOC_GD32F407
```

## boards/arm/gd32f450i_eval/gd32f450i_eval_defconfig
```kconfig
# Copyright (c) 2021, Teslabs Engineering S.L.
# SPDX-License-Identifier: Apache-2.0

CONFIG_BOARD_GD32F450I_EVAL=y

CONFIG_ARM_MPU=y
CONFIG_HW_STACK_PROTECTION=y
CONFIG_CORTEX_M_SYSTICK=y

CONFIG_CONSOLE=y
CONFIG_UART_CONSOLE=y
CONFIG_SERIAL=y

CONFIG_GPIO=y
```

## boards/arm/gd32f450v_start/Kconfig.gd32f450v_start
```kconfig
config BOARD_GD32F450V_START
	bool
	default y
	select SOC_SERIES_GD32F4XX
	select SOC_GD32F450
```

## boards/arm/gd32f450z_eval/Kconfig.gd32f450z_eval
```kconfig
config BOARD_GD32F450Z_EVAL
	bool
	default y
	select SOC_SERIES_GD32F4XX
	select SOC_GD32F450
```

## boards/arm/google_kukui/Kconfig.board
```kconfig
# Google Kukui EC

# Copyright 2019 The Chromium OS Authors
# SPDX-License-Identifier: Apache-2.0

config BOARD_GOOGLE_KUKUI
```

## boards/arm/google_kukui/Kconfig.google_kukui
```kconfig
config BOARD_GOOGLE_KUKUI
	bool
	default y
	select SOC_SERIES_STM32F0X
	select SOC_STM32F098XX
```

## boards/arm/hexiwear_k64/Kconfig.board
```kconfig
# Hexiwear K64 board

# Copyright (c) 2016, Freescale Semiconductor, Inc.
# SPDX-License-Identifier: Apache-2.0

config BOARD_HEXIWEAR_K64
```

## boards/arm/hexiwear_kw40z/Kconfig.board
```kconfig
# Hexiwear KW40Z board

# Copyright (c) 2017, NXP
# SPDX-License-Identifier: Apache-2.0

config BOARD_HEXIWEAR_KW40Z
```

## boards/arm/hexiwear_kw40z/Kconfig.hexiwear_kw40z
```kconfig
config BOARD_HEXIWEAR_KW40Z
	bool
	default y
	select SOC_MKW40Z4
	select SOC_SERIES_KINETIS_KWX
	select SOC_PART_NUMBER_MKW40Z160VHT4
```

## boards/arm/holyiot_yj16019/Kconfig.board
```kconfig
# Holyiot YJ-16019 board configuration

# Copyright (c) 2019 Henrik Brix Andersen <henrik@brixandersen.dk>
# SPDX-License-Identifier: Apache-2.0

config BOARD_HOLYIOT_YJ16019
```

## boards/arm/ip_k66f/Kconfig.board
```kconfig
# Copyright (c) 2020 DENX Software Engineering GmbH
# SPDX-License-Identifier: Apache-2.0

config BOARD_IP_K66F
```

## boards/arm/ip_k66f/Kconfig.ip_k66f
```kconfig
config BOARD_IP_K66F
	bool
	default y
	select SOC_MK66F18
	select SOC_SERIES_KINETIS_K6X
	select SOC_PART_NUMBER_MK66FN2M0VMD18
```

## boards/arm/legend/Kconfig.legend
```kconfig
config BOARD_LEGEND
	bool
	default y
	select SOC_SERIES_STM32F0X
	select SOC_STM32F070XB
```

## boards/arm/lora_e5_dev_board/Kconfig.lora_e5_dev_board
```kconfig
config BOARD_LORA_E5_DEV_BOARD
	bool
	default y
	select SOC_SERIES_STM32WLX
	select SOC_STM32WLE5XX
```

## boards/arm/lpcxpresso11u68/Kconfig.board
```kconfig
# LPCXpresso11U68 board

# Copyright (c) 2020, Seagate
# SPDX-License-Identifier: Apache-2.0

config BOARD_LPCXPRESSO11U68
```

## boards/arm/lpcxpresso11u68/Kconfig.lpcxpresso11u68
```kconfig
config BOARD_LPCXPRESSO11U68
	bool
	default y
	select SOC_SERIES_LPC11U6X
	select SOC_PART_NUMBER_LPC11U68JBD100
```

## boards/arm/lpcxpresso51u68/Kconfig.board
```kconfig
# LPCXpresso51U68 board

# Copyright (c) 2021 metraTec GmbH
# SPDX-License-Identifier: Apache-2.0

config BOARD_LPCXPRESSO51U68
```
