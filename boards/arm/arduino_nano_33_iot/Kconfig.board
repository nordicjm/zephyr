## boards/arm/arduino_nano_33_iot/Kconfig.board
```kconfig
# Arduino Nano 33 IOT board configuration

# Copyright (c) 2020 Google LLC.
# SPDX-License-Identifier: Apache-2.0

config BOARD_ARDUINO_NANO_33_IOT
```

## boards/arm/arduino_nano_33_iot/arduino_nano_33_iot_defconfig
```kconfig
# SPDX-License-Identifier: Apache-2.0

CONFIG_BOARD_ARDUINO_NANO_33_IOT=y
CONFIG_CORTEX_M_SYSTICK=y
CONFIG_CONSOLE=y
CONFIG_UART_CONSOLE=y
CONFIG_UART_INTERRUPT_DRIVEN=y
CONFIG_SERIAL=y
CONFIG_BOOTLOADER_BOSSA=y
CONFIG_BOOTLOADER_BOSSA_ARDUINO=y
```

## boards/arm/arduino_nicla_sense_me/Kconfig.arduino_nicla_sense_me
```kconfig
config BOARD_ARDUINO_NICLA_SENSE_ME
	bool
	default y
	select SOC_SERIES_NRF52X
	select SOC_NRF52832_QFAA
```

## boards/arm/arduino_zero/Kconfig.arduino_zero
```kconfig
config BOARD_ARDUINO_ZERO
	bool
	default y
	select SOC_SERIES_SAMD21
	select SOC_PART_NUMBER_SAMD21G18A
```

## boards/arm/arduino_zero/arduino_zero_defconfig
```kconfig
# SPDX-License-Identifier: Apache-2.0

CONFIG_BOARD_ARDUINO_ZERO=y
CONFIG_BUILD_OUTPUT_HEX=y
CONFIG_CORTEX_M_SYSTICK=y
CONFIG_CONSOLE=y
CONFIG_UART_CONSOLE=y
CONFIG_UART_INTERRUPT_DRIVEN=y
CONFIG_SERIAL=y
```

## boards/arm/arty/Kconfig.board
```kconfig
# Digilent Arty board configuration

# Copyright (c) 2020 Henrik Brix Andersen <henrik@brixandersen.dk>
# SPDX-License-Identifier: Apache-2.0

config BOARD_ARTY_A7_ARM_DESIGNSTART_M1
config BOARD_ARTY_A7_ARM_DESIGNSTART_M3
```

## boards/arm/ast1030_evb/Kconfig.ast1030_evb
```kconfig
config BOARD_AST1030_EVB
	bool
	default y
	select SOC_SERIES_AST10X0
	select SOC_AST1030
```

## boards/arm/atsamd20_xpro/Kconfig.atsamd20_xpro
```kconfig
config BOARD_ATSAMD20_XPRO
	bool
	default y
	select SOC_SERIES_SAMD20
	select SOC_PART_NUMBER_SAMD20J18
```

## boards/arm/atsamd21_xpro/Kconfig.atsamd21_xpro
```kconfig
config BOARD_ATSAMD21_XPRO
	bool
	default y
	select SOC_SERIES_SAMD21
	select SOC_PART_NUMBER_SAMD21J18A
```

## boards/arm/atsamd21_xpro/atsamd21_xpro_defconfig
```kconfig
# Copyright (c) 2018 Bryan O'Donoghue
# SPDX-License-Identifier: Apache-2.0
CONFIG_BOARD_ATSAMD21_XPRO=y
CONFIG_BUILD_OUTPUT_HEX=y
CONFIG_CORTEX_M_SYSTICK=y
CONFIG_CONSOLE=y
CONFIG_UART_CONSOLE=y
CONFIG_SERIAL=y
CONFIG_UART_INTERRUPT_DRIVEN=y
CONFIG_GPIO=y
```

## boards/arm/atsame54_xpro/Kconfig.atsame54_xpro
```kconfig
config BOARD_ATSAME54_XPRO
	bool
	default y
	select SOC_SERIES_SAME54
	select SOC_PART_NUMBER_SAME54P20A
```

## boards/arm/atsame54_xpro/atsame54_xpro_defconfig
```kconfig
# Copyright (c) 2019 Benjamin Valentin
# SPDX-License-Identifier: Apache-2.0
CONFIG_BOARD_ATSAME54_XPRO=y
CONFIG_BUILD_OUTPUT_HEX=y
CONFIG_ARM_MPU=y
CONFIG_CORTEX_M_SYSTICK=y
CONFIG_CONSOLE=y
CONFIG_UART_CONSOLE=y
CONFIG_SERIAL=y
CONFIG_UART_INTERRUPT_DRIVEN=y
CONFIG_GPIO=y

# Enable HW stack protection
CONFIG_HW_STACK_PROTECTION=y
```

## boards/arm/atsaml21_xpro/Kconfig.atsaml21_xpro
```kconfig
config BOARD_ATSAML21_XPRO
	bool
	default y
	select SOC_SERIES_SAML21
	select SOC_PART_NUMBER_SAML21J18B
```

## boards/arm/atsaml21_xpro/atsaml21_xpro_defconfig
```kconfig
# Copyright (c) 2021 Argentum Systems Ltd.
# SPDX-License-Identifier: Apache-2.0
CONFIG_BOARD_ATSAML21_XPRO=y
CONFIG_BUILD_OUTPUT_HEX=y
CONFIG_CORTEX_M_SYSTICK=y
CONFIG_CONSOLE=y
CONFIG_UART_CONSOLE=y
CONFIG_SERIAL=y
CONFIG_UART_INTERRUPT_DRIVEN=y
CONFIG_GPIO=y
```

## boards/arm/atsamr21_xpro/Kconfig.atsamr21_xpro
```kconfig
config BOARD_ATSAMR21_XPRO
	bool
	default y
	select SOC_SERIES_SAMR21
	select SOC_PART_NUMBER_SAMR21G18A
```

## boards/arm/atsamr21_xpro/atsamr21_xpro_defconfig
```kconfig
# Copyright (c) 2019 Gerson Fernando Budke
# Copyright (c) 2019 Benjamin Valentin
# SPDX-License-Identifier: Apache-2.0
CONFIG_BOARD_ATSAMR21_XPRO=y
CONFIG_BUILD_OUTPUT_HEX=y
CONFIG_CORTEX_M_SYSTICK=y
CONFIG_CONSOLE=y
CONFIG_UART_CONSOLE=y
CONFIG_SERIAL=y
CONFIG_UART_INTERRUPT_DRIVEN=y
CONFIG_GPIO=y
```

## boards/arm/atsamr34_xpro/Kconfig.atsamr34_xpro
```kconfig
config BOARD_ATSAMR34_XPRO
	bool
	default y
	select SOC_SERIES_SAMR34
	select SOC_PART_NUMBER_SAMR34J18B
```

## boards/arm/atsamr34_xpro/atsamr34_xpro_defconfig
```kconfig
# Copyright (c) 2021 Argentum Systems Ltd.
# SPDX-License-Identifier: Apache-2.0
CONFIG_BOARD_ATSAMR34_XPRO=y
CONFIG_BUILD_OUTPUT_HEX=y
CONFIG_CORTEX_M_SYSTICK=y
CONFIG_CONSOLE=y
CONFIG_UART_CONSOLE=y
CONFIG_SERIAL=y
CONFIG_UART_INTERRUPT_DRIVEN=y
CONFIG_GPIO=y
```

## boards/arm/b_g474e_dpow1/Kconfig.b_g474e_dpow1
```kconfig
config BOARD_B_G474E_DPOW1
	bool
	default y
	select SOC_SERIES_STM32G4X
	select SOC_STM32G474XX
```

## boards/arm/b_g474e_dpow1/Kconfig.board
```kconfig
# B-G474E-DPOW1 Discovery board configuration

# Copyright 2022 The Chromium OS Authors
# SPDX-License-Identifier: Apache-2.0

config BOARD_B_G474E_DPOW1
```

## boards/arm/b_l072z_lrwan1/Kconfig.b_l072z_lrwan1
```kconfig
config BOARD_B_L072Z_LRWAN1
	bool
	default y
	select SOC_SERIES_STM32L0X
	select SOC_STM32L072XX
```

## boards/arm/b_l4s5i_iot01a/Kconfig.b_l4s5i_iot01a
```kconfig
config BOARD_B_L4S5I_IOT01A
	bool
	default y
	select SOC_SERIES_STM32L4X
	select SOC_STM32L4S5XX
```

## boards/arm/b_l4s5i_iot01a/Kconfig.board
```kconfig
# B_L4S5I_IOT01A discovery kit configuration

# Copyright (c) 2020 STMicroelectronics
# SPDX-License-Identifier: Apache-2.0

config BOARD_B_L4S5I_IOT01A
```

## boards/arm/b_u585i_iot02a/Kconfig.board
```kconfig
# B_U585I_IOT02A discovery kit configuration

# Copyright (c) 2021 STMicroelectronics
# SPDX-License-Identifier: Apache-2.0

config BOARD_B_U585I_IOT02A
```

## boards/arm/bbc_microbit/Kconfig.bbc_microbit
```kconfig
config BOARD_BBC_MICROBIT
	bool
	default y
	select SOC_SERIES_NRF51X
	select SOC_NRF51822_QFAA
```
