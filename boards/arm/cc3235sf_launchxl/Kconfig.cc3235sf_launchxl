## boards/arm/cc3235sf_launchxl/Kconfig.cc3235sf_launchxl
```kconfig
config BOARD_CC3235SF_LAUNCHXL
	bool
	default y
	select SOC_SERIES_CC32XX
	select SOC_CC3235SF
```

## boards/arm/circuitdojo_feather_nrf9160/Kconfig.circuitdojo_feather_nrf9160
```kconfig
config BOARD_CIRCUITDOJO_FEATHER_NRF9160
	bool
	default y
	select SOC_SERIES_NRF91X
	select SOC_NRF9160_SICA
```

## boards/arm/circuitdojo_feather_nrf9160/Kconfig.circuitdojo_feather_nrf9160_ns
```kconfig
config BOARD_CIRCUITDOJO_FEATHER_NRF9160_NS
	bool
	default y
	select SOC_SERIES_NRF91X
	select SOC_NRF9160_SICA
```

## boards/arm/colibri_imx7d_m4/colibri_imx7d_m4_defconfig
```kconfig
#
# Copyright (c) 2017, NXP
#
# SPDX-License-Identifier: Apache-2.0
#

CONFIG_BOARD_COLIBRI_IMX7D_M4=y
CONFIG_CORTEX_M_SYSTICK=y
CONFIG_UART_CONSOLE=y
CONFIG_SERIAL=y
CONFIG_UART_INTERRUPT_DRIVEN=y
CONFIG_CONSOLE=y
CONFIG_XIP=y
CONFIG_PINCTRL=y
```

## boards/arm/contextualelectronics_abc/Kconfig.contextelec_abc
```kconfig
config BOARD_CONTEXTELEC_ABC
	bool
	default y
	select SOC_SERIES_NRF52X
	select SOC_NRF52840_QIAA
```

## boards/arm/cy8ckit_062_ble/Kconfig.board
```kconfig
# PSoC6 BLE Pioneer Kit configuration

# Copyright (c) 2018 Cypress
# Copyright (c) 2020 ATL Electronics
# SPDX-License-Identifier: Apache-2.0

config BOARD_CY8CKIT_062_BLE_M0
config BOARD_CY8CKIT_062_BLE_M4
```

## boards/arm/cy8ckit_062_ble/Kconfig.cy8ckit_062_ble_m0
```kconfig
config BOARD_CY8CKIT_062_BLE_M0
	bool
	default y
	select SOC_SERIES_PSOC63
	select SOC_PSOC6_M0
	select SOC_PART_NUMBER_CY8C6347BZI_BLD53
```

## boards/arm/cy8ckit_062_ble/Kconfig.cy8ckit_062_ble_m4
```kconfig
config BOARD_CY8CKIT_062_BLE_M4
	bool
	default y
	select SOC_SERIES_PSOC63
	select SOC_PSOC6_M4
	select SOC_PART_NUMBER_CY8C6347BZI_BLD53
```

## boards/arm/cy8ckit_062_ble/cy8ckit_062_ble_m4_defconfig
```kconfig
#
# Copyright (c) 2018, Cypress
# Copyright (c) 2020, ATL Electronics
#
# SPDX-License-Identifier: Apache-2.0
#

CONFIG_BOARD_CY8CKIT_062_BLE_M4=y
CONFIG_CORTEX_M_SYSTICK=y
CONFIG_CONSOLE=y
CONFIG_UART_CONSOLE=y
CONFIG_BUILD_OUTPUT_HEX=y

# UART driver
CONFIG_SERIAL=y
```

## boards/arm/cy8ckit_062_wifi_bt/Kconfig.board
```kconfig
# PSoC6 WiFi-BT Pioneer Kit configuration

# Copyright (c) 2018 Cypress
# Copyright (c) 2020 ATL Electronics
# SPDX-License-Identifier: Apache-2.0

config BOARD_CY8CKIT_062_WIFI_BT_M0
config BOARD_CY8CKIT_062_WIFI_BT_M4
```

## boards/arm/cy8ckit_062_wifi_bt/Kconfig.cy8ckit_062_wifi_bt_m0
```kconfig
config BOARD_CY8CKIT_062_WIFI_BT_M0
	bool
	default y
	select SOC_SERIES_PSOC62
	select SOC_PSOC6_M0
	select SOC_PART_NUMBER_CY8C6247BZI_D54
```

## boards/arm/cy8ckit_062_wifi_bt/Kconfig.cy8ckit_062_wifi_bt_m4
```kconfig
config BOARD_CY8CKIT_062_WIFI_BT_M4
	bool
	default y
	select SOC_SERIES_PSOC62
	select SOC_PSOC6_M4
	select SOC_PART_NUMBER_CY8C6247BZI_D54
```

## boards/arm/cyclonev_socdk/Kconfig.board
```kconfig
# Copyright (c) 2022 Intel Corporation
# SPDX-License-Identifier: Apache-2.0
# Description:
# Cyclone V SoC development kit configuration option

config BOARD_CVSXDEVKIT
```

## boards/arm/cyclonev_socdk/Kconfig.cvsxdevkit
```kconfig
config BOARD_CVSXDEVKIT
	bool
	default y
	select SOC_SERIES_CYCLONE5
	select SOC_CYCLONE5
```

## boards/arm/cyclonev_socdk/Kconfig.cyclonev_socdk
```kconfig
config BOARD_CYCLONEV_SOCDK
	bool
	default y
	select SOC_SERIES_CYCLONE5
	select SOC_CYCLONE5
```

## boards/arm/da1469x_dk_pro/Kconfig.da1469x_dk_pro
```kconfig
config BOARD_DA1469X_DK_PRO
	bool
	default y
	select SOC_SERIES_DA1469X
	select SOC_DA14699
```

## boards/arm/decawave_dwm1001_dev/Kconfig.board
```kconfig
# DecaWave DWM1001 board configuration

# Copyright (c) 2019 Stéphane D'Alu
# SPDX-License-Identifier: Apache-2.0

config BOARD_DECAWAVE_DWM1001_DEV
```

## boards/arm/decawave_dwm1001_dev/Kconfig.decawave_dwm1001_dev
```kconfig
config BOARD_DECAWAVE_DWM1001_DEV
	bool
	default y
	select SOC_SERIES_NRF52X
	select SOC_NRF52832_QFAA
```

## boards/arm/degu_evk/Kconfig.degu_evk
```kconfig
config BOARD_DEGU_EVK
	bool
	default y
	select SOC_SERIES_NRF52X
	select SOC_NRF52840_QIAA
```

## boards/arm/disco_l475_iot1/Kconfig.board
```kconfig
# Discovery IoT L475 board configuration

# Copyright (c) 2017 Linaro Limited
# SPDX-License-Identifier: Apache-2.0

config BOARD_DISCO_L475_IOT1
```

## boards/arm/disco_l475_iot1/Kconfig.disco_l475_iot1
```kconfig
config BOARD_DISCO_L475_IOT1
	bool
	default y
	select SOC_SERIES_STM32L4X
	select SOC_STM32L475XX
```

## boards/arm/dragino_lsn50/Kconfig.board
```kconfig
# Dragino LSN50 LoRA Sensor Node board configuration

# Copyright (c) 2018 Endre Karlson <endre.karlson@gmail.com>
# SPDX-License-Identifier: Apache-2.0

config BOARD_DRAGINO_LSN50
```

## boards/arm/dragino_lsn50/Kconfig.dragino_lsn50
```kconfig
config BOARD_DRAGINO_LSN50
	bool
	default y
	select SOC_SERIES_STM32L0X
	select SOC_STM32L072XX
```

## boards/arm/dragino_nbsn95/Kconfig.dragino_nbsn95
```kconfig
config BOARD_DRAGINO_NBSN95
	bool
	default y
	select SOC_SERIES_STM32L0X
	select SOC_STM32L072XX
```

## boards/arm/ebyte_e73_tbb_nrf52832/Kconfig.board
```kconfig
# EBYTE-TBB board configuration

# Copyright (c) 2021 Michal Morsisko
# SPDX-License-Identifier: Apache-2.0

config BOARD_EBYTE_E73_TBB_NRF52832
```
