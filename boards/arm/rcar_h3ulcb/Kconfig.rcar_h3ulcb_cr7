## boards/arm/rcar_h3ulcb/Kconfig.rcar_h3ulcb_cr7
```kconfig
config BOARD_RCAR_H3ULCB_CR7
	bool
	default y
	select SOC_R8A77951
	select SOC_SERIES_RCAR_GEN3
```

## boards/arm/rddrone_fmuk66/Kconfig.board
```kconfig
# Copyright (c) 2021, Electromaticus LLC, 2021 NXP
# SPDX-License-Identifier: Apache-2.0

config BOARD_RDDRONE_FMUK66
```

## boards/arm/rddrone_fmuk66/Kconfig.rddrone_fmuk66
```kconfig
config BOARD_RDDRONE_FMUK66
	bool
	default y
	select SOC_MK66F18
	select SOC_SERIES_KINETIS_K6X
	select SOC_PART_NUMBER_MK66FN2M0VLQ18
```

## boards/arm/reel_board/Kconfig.board
```kconfig
# reel board configuration

# Copyright (c) 2018-2019 PHYTEC Messtechnik GmbH
# SPDX-License-Identifier: Apache-2.0

config BOARD_REEL_BOARD
config BOARD_REEL_BOARD_V2
```

## boards/arm/reel_board/Kconfig.reel_board
```kconfig
config BOARD_REEL_BOARD
	bool
	default y
	select SOC_SERIES_NRF52X
	select SOC_NRF52840_QIAA
```

## boards/arm/rm1xx_dvk/Kconfig.rm1xx_dvk
```kconfig
config BOARD_RM1XX_DVK
	bool
	default y
	select SOC_SERIES_NRF51X
	select SOC_NRF51822_QFAC
```

## boards/arm/ronoth_lodev/Kconfig.ronoth_lodev
```kconfig
config BOARD_RONOTH_LODEV
	bool
	default y
	select SOC_SERIES_STM32L0X
	select SOC_STM32L073XX
```

## boards/arm/rpi_pico/Kconfig.rpi_pico
```kconfig
config BOARD_RPI_PICO
	bool
	default y
	select SOC_SERIES_RP2XXX
	select SOC_RP2040
```

## boards/arm/ruuvi_ruuvitag/Kconfig.ruuvi_ruuvitag
```kconfig
config BOARD_RUUVI_RUUVITAG
	bool
	default y
	select SOC_SERIES_NRF52X
	select SOC_NRF52832_QFAA
```

## boards/arm/sam4e_xpro/Kconfig.sam4e_xpro
```kconfig
config BOARD_SAM4E_XPRO
	bool
	default y
	select SOC_SERIES_SAM4E
	select SOC_PART_NUMBER_SAM4E16E
```

## boards/arm/sam4l_ek/Kconfig.sam4l_ek
```kconfig
config BOARD_SAM4L_EK
	bool
	default y
	select SOC_SERIES_SAM4L
	select SOC_PART_NUMBER_SAM4LC4C
```

## boards/arm/sam4l_ek/sam4l_ek_defconfig
```kconfig
# SPDX-License-Identifier: Apache-2.0

CONFIG_ARM_MPU=y
CONFIG_CORTEX_M_SYSTICK=y
CONFIG_CONSOLE=y
CONFIG_UART_CONSOLE=y
CONFIG_SERIAL=y
CONFIG_BOARD_SAM4L_EK=y
CONFIG_GPIO=y

# Enable HW stack protection
CONFIG_HW_STACK_PROTECTION=y
```

## boards/arm/sam4s_xplained/Kconfig.sam4s_xplained
```kconfig
config BOARD_SAM4S_XPLAINED
	bool
	default y
	select SOC_SERIES_SAM4S
	select SOC_PART_NUMBER_SAM4S16C
```

## boards/arm/sam4s_xplained/sam4s_xplained_defconfig
```kconfig
# SPDX-License-Identifier: Apache-2.0

CONFIG_ARM_MPU=y
CONFIG_CORTEX_M_SYSTICK=y
CONFIG_CONSOLE=y
CONFIG_UART_CONSOLE=y
CONFIG_SERIAL=y
CONFIG_BOARD_SAM4S_XPLAINED=y
CONFIG_GPIO=y
CONFIG_WDT_DISABLE_AT_BOOT=y

# Enable SMC SRAM
CONFIG_MEMC=y

# Enable HW stack protection
CONFIG_HW_STACK_PROTECTION=y
```

## boards/arm/sam_e70_xplained/Kconfig.sam_e70_xplained
```kconfig
config BOARD_SAM_E70_XPLAINED
	bool
	default y
	select SOC_SERIES_SAME70
	select SOC_PART_NUMBER_SAME70Q21
```

## boards/arm/sam_e70_xplained/Kconfig.sam_e70b_xplained
```kconfig
config BOARD_SAM_E70B_XPLAINED
	bool
	default y
	select SOC_SERIES_SAME70
	select SOC_PART_NUMBER_SAME70Q21B
```

## boards/arm/sam_e70_xplained/sam_e70_xplained_defconfig
```kconfig
# SPDX-License-Identifier: Apache-2.0

CONFIG_ARM_MPU=y
CONFIG_CORTEX_M_SYSTICK=y
CONFIG_CONSOLE=y
CONFIG_UART_CONSOLE=y
CONFIG_SERIAL=y
CONFIG_USART_SAM=y
CONFIG_GPIO=y
CONFIG_BOARD_SAM_E70_XPLAINED=y
CONFIG_WDT_DISABLE_AT_BOOT=y
CONFIG_BUILD_OUTPUT_HEX=y

# Enable HW stack protection
CONFIG_HW_STACK_PROTECTION=y
```

## boards/arm/sam_v71_xult/Kconfig.sam_v71b_xult
```kconfig
config BOARD_SAM_V71B_XULT
	bool
	default y
	select SOC_SERIES_SAMV71
	select SOC_PART_NUMBER_SAMV71Q21B
```

## boards/arm/sam_v71_xult/sam_v71b_xult_defconfig
```kconfig
# SPDX-License-Identifier: Apache-2.0

CONFIG_ARM_MPU=y
CONFIG_CORTEX_M_SYSTICK=y
CONFIG_CONSOLE=y
CONFIG_UART_CONSOLE=y
CONFIG_SERIAL=y
CONFIG_USART_SAM=y
CONFIG_BOARD_SAM_V71_XULT=y
CONFIG_WDT_DISABLE_AT_BOOT=y
CONFIG_BUILD_OUTPUT_HEX=y
```

## boards/arm/scobc_module1/Kconfig.board
```kconfig
# Space Cubics OBC module 1 configuration

# Copyright (c) 2021 Space Cubics, LLC. <yashi@spacecubics.com>
# SPDX-License-Identifier: Apache-2.0

config BOARD_SCOBC_MODULE1
```

## boards/arm/seeeduino_xiao/Kconfig.seeeduino_xiao
```kconfig
config BOARD_SEEEDUINO_XIAO
	bool
	default y
	select SOC_SERIES_SAMD21
	select SOC_PART_NUMBER_SAMD21G18A
```

## boards/arm/segger_trb_stm32f407/Kconfig.board
```kconfig
# SEGGER-TRB-STM32F407 board configuration

# Copyright (c) 2020, Erwin Rol <erwin@erwinrol.com>
# SPDX-License-Identifier: Apache-2.0

config BOARD_SEGGER_TRB_STM32F407
```

## boards/arm/segger_trb_stm32f407/Kconfig.segger_trb_stm32f407
```kconfig
config BOARD_SEGGER_TRB_STM32F407
	bool
	default y
	select SOC_SERIES_STM32F4X
	select SOC_STM32F407XE
```

## boards/arm/sensortile_box/Kconfig.board
```kconfig
# SensorTile.box board configuration

# Copyright (c) 2019 STMicroelectronics
# SPDX-License-Identifier: Apache-2.0

config BOARD_SENSORTILE_BOX
```

## boards/arm/serpente/Kconfig.board
```kconfig
# Serpente board configuration
# Copyright (c) 2020 Alexander Falb <fal3xx@gmail.com>
# SPDX-License-Identifier: Apache-2.0

config BOARD_SERPENTE
```
