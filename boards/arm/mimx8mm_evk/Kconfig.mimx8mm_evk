## boards/arm/mimx8mm_evk/Kconfig.mimx8mm_evk
```kconfig
config BOARD_MIMX8MM_EVK
	bool
	default y
	select SOC_SERIES_IMX8MM_M4
	select SOC_MIMX8MM6
	select SOC_PART_NUMBER_MIMX8MM6DVTLZ
```

## boards/arm/mimx8mp_evk/Kconfig.board
```kconfig
# MIMX8MP EVK board

# Copyright (c) 2021, Laird Connectivity
# SPDX-License-Identifier: Apache-2.0

config BOARD_MIMX8MP_EVK
```

## boards/arm/mimx8mp_evk/Kconfig.mimx8mp_evk_ddr
```kconfig
config BOARD_MIMX8MP_EVK_DDR
	bool
	default y
	select SOC_SERIES_IMX8ML_M7
	select SOC_MIMX8ML8
```

## boards/arm/mimx8mp_evk/mimx8mp_evk_ddr_defconfig
```kconfig
#
# Copyright (c) 2021, Laird Connectivity
#
# SPDX-License-Identifier: Apache-2.0
#

CONFIG_BOARD_MIMX8MP_EVK=y
CONFIG_CORTEX_M_SYSTICK=y
CONFIG_CLOCK_CONTROL=y
CONFIG_UART_CONSOLE=y
CONFIG_SERIAL=y
CONFIG_UART_INTERRUPT_DRIVEN=y
CONFIG_CONSOLE=y
CONFIG_XIP=y
CONFIG_CODE_DDR=y
CONFIG_PINCTRL=y
```

## boards/arm/mimx8mq_evk/Kconfig.board
```kconfig
# MIMX8MQ EVK board

# Copyright (c) 2021, Kwon Tae-young <tykwon@m2i.co.kr>
# SPDX-License-Identifier: Apache-2.0

config BOARD_MIMX8MQ_EVK_CM4
```

## boards/arm/mimx8mq_evk/Kconfig.mimx8mq_evk_cm4
```kconfig
config BOARD_MIMX8MQ_EVK_CM4
	bool
	default y
	select SOC_SERIES_IMX8MQ_M4
	select SOC_MIMX8MQ6
	select SOC_PART_NUMBER_MIMX8MQ6DVAJZ
```

## boards/arm/mimxrt1010_evk/Kconfig.board
```kconfig
#
# Copyright (c) 2019, NXP
#
# SPDX-License-Identifier: Apache-2.0
#

config BOARD_MIMXRT1010_EVK
```

## boards/arm/mimxrt1010_evk/Kconfig.mimxrt1010_evk
```kconfig
config BOARD_MIMXRT1010_EVK
	bool
	default y
	select SOC_MIMXRT1011
	select SOC_SERIES_IMX_RT
	select SOC_PART_NUMBER_MIMXRT1011DAE5A
```

## boards/arm/mimxrt1020_evk/Kconfig.mimxrt1020_evk
```kconfig
config BOARD_MIMXRT1020_EVK
	bool
	default y
	select SOC_MIMXRT1021
	select SOC_SERIES_IMX_RT
	select SOC_PART_NUMBER_MIMXRT1021DAG5A
```

## boards/arm/mimxrt1024_evk/Kconfig.board
```kconfig
# Copyright (c) 2020, NXP
# SPDX-License-Identifier: Apache-2.0

config BOARD_MIMXRT1024_EVK
```

## boards/arm/mimxrt1024_evk/Kconfig.mimxrt1024_evk
```kconfig
config BOARD_MIMXRT1024_EVK
	bool
	default y
	select SOC_MIMXRT1024
	select SOC_SERIES_IMX_RT
	select SOC_PART_NUMBER_MIMXRT1024DAG5A
```

## boards/arm/mimxrt1050_evk/Kconfig.board
```kconfig
# Copyright (c) 2017, NXP
# SPDX-License-Identifier: Apache-2.0

config BOARD_MIMXRT1050_EVK
config BOARD_MIMXRT1050_EVK_QSPI
```

## boards/arm/mimxrt1050_evk/Kconfig.mimxrt1050_evk
```kconfig
config BOARD_MIMXRT1050_EVK
	bool
	default y
	select SOC_MIMXRT1052
	select SOC_SERIES_IMX_RT
	select SOC_PART_NUMBER_MIMXRT1052DVL6A
```

## boards/arm/mimxrt1060_evk/Kconfig.mimxrt1060_evk_hyperflash
```kconfig
config BOARD_MIMXRT1060_EVK_HYPERFLASH
	bool
	default y
	select SOC_MIMXRT1062
	select SOC_SERIES_IMX_RT
	select SOC_PART_NUMBER_MIMXRT1062DVL6A
```

## boards/arm/mimxrt1160_evk/Kconfig.board
```kconfig
# Copyright (c) 2021, NXP
# SPDX-License-Identifier: Apache-2.0

config BOARD_MIMXRT1160_EVK_CM7
config BOARD_MIMXRT1160_EVK_CM4
```

## boards/arm/mimxrt1160_evk/Kconfig.mimxrt1160_evk_cm4
```kconfig
config BOARD_MIMXRT1160_EVK_CM4
	bool
	default y
	select SOC_MIMXRT1166_CM4
	select SOC_SERIES_IMX_RT
```

## boards/arm/mimxrt1160_evk/Kconfig.mimxrt1160_evk_cm7
```kconfig
config BOARD_MIMXRT1160_EVK_CM7
	bool
	default y
	select SOC_MIMXRT1166_CM7
	select SOC_SERIES_IMX_RT
	select SOC_PART_NUMBER_MIMXRT1166DVM6A
	select SOC_MIMXRT1166_CM4
```

## boards/arm/mimxrt1170_evk/Kconfig.board
```kconfig
# Copyright (c) 2021, NXP
# SPDX-License-Identifier: Apache-2.0

config BOARD_MIMXRT1170_EVK_CM7
config BOARD_MIMXRT1170_EVK_CM4
```

## boards/arm/mimxrt1170_evk/Kconfig.mimxrt1170_evk_cm4
```kconfig
config BOARD_MIMXRT1170_EVK_CM4
	bool
	default y
	select SOC_MIMXRT1176_CM4
	select SOC_SERIES_IMX_RT
```

## boards/arm/mimxrt1170_evk/Kconfig.mimxrt1170_evk_cm7
```kconfig
config BOARD_MIMXRT1170_EVK_CM7
	bool
	default y
	select SOC_MIMXRT1176_CM7
	select SOC_SERIES_IMX_RT
	select SOC_PART_NUMBER_MIMXRT1176DVMAA
	select SOC_MIMXRT1176_CM4
```

## boards/arm/mimxrt595_evk/Kconfig.board
```kconfig
# Copyright (c) 2022, NXP
# SPDX-License-Identifier: Apache-2.0

config BOARD_MIMXRT595_EVK
```

## boards/arm/mimxrt595_evk/Kconfig.mimxrt595_evk_cm33
```kconfig
config BOARD_MIMXRT595_EVK_CM33
	bool
	default y
	select SOC_MIMXRT595S_CM33
	select SOC_SERIES_IMX_RT5XX
	select CODE_DATA_RELOCATION_SRAM
	select SOC_PART_NUMBER_MIMXRT595SFFOC
	select NXP_IMX_RT5XX_BOOT_HEADER if !BOOTLOADER_MCUBOOT
```

## boards/arm/mimxrt685_evk/Kconfig.board
```kconfig
# Copyright (c) 2020, NXP
# SPDX-License-Identifier: Apache-2.0

config BOARD_MIMXRT685_EVK
```

## boards/arm/mimxrt685_evk/Kconfig.mimxrt685_evk
```kconfig
config BOARD_MIMXRT685_EVK
	bool
	default y
	select SOC_MIMXRT685S_CM33
	select SOC_SERIES_IMX_RT6XX
	select SOC_PART_NUMBER_MIMXRT685SFVKB
	select NXP_IMX_RT6XX_BOOT_HEADER if !BOOTLOADER_MCUBOOT
```

## boards/arm/mm_feather/Kconfig.board
```kconfig
#
# Copyright (c) 2021, MADMACHINE LIMITED
#
# SPDX-License-Identifier: Apache-2.0
#

config BOARD_MM_FEATHER
```
