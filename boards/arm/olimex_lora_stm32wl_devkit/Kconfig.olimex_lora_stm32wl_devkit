## boards/arm/olimex_lora_stm32wl_devkit/Kconfig.olimex_lora_stm32wl_devkit
```kconfig
config BOARD_OLIMEX_LORA_STM32WL_DEVKIT
	bool
	default y
	select SOC_SERIES_STM32WLX
	select SOC_STM32WLE5XX
```

## boards/arm/olimex_stm32_h103/Kconfig.olimex_stm32_h103
```kconfig
config BOARD_OLIMEX_STM32_H103
	bool
	default y
	select SOC_SERIES_STM32F1X
	select SOC_STM32F103XB
```

## boards/arm/olimex_stm32_h405/Kconfig.board
```kconfig
# OLIMEX-STM32-H405 board configuration

# Copyright (c) 2020, 2021 Antony Pavlov <antonynpavlov@gmail.com>
# SPDX-License-Identifier: Apache-2.0

config BOARD_OLIMEX_STM32_H405
```

## boards/arm/olimex_stm32_p405/Kconfig.olimex_stm32_p405
```kconfig
config BOARD_OLIMEX_STM32_P405
	bool
	default y
	select SOC_SERIES_STM32F4X
	select SOC_STM32F405XG
```

## boards/arm/olimexino_stm32/Kconfig.olimexino_stm32
```kconfig
config BOARD_OLIMEXINO_STM32
	bool
	default y
	select SOC_SERIES_STM32F1X
	select SOC_STM32F103XB
```

## boards/arm/pan1770_evb/Kconfig.pan1770_evb
```kconfig
config BOARD_PAN1770_EVB
	bool
	default y
	select SOC_SERIES_NRF52X
	select SOC_NRF52840_QIAA
```

## boards/arm/pan1780_evb/Kconfig.pan1780_evb
```kconfig
config BOARD_PAN1780_EVB
	bool
	default y
	select SOC_SERIES_NRF52X
	select SOC_NRF52840_QIAA
```

## boards/arm/pan1781_evb/Kconfig.pan1781_evb
```kconfig
config BOARD_PAN1781_EVB
	bool
	default y
	select SOC_SERIES_NRF52X
	select SOC_NRF52820_QDAA
```

## boards/arm/pan1782_evb/Kconfig.pan1782_evb
```kconfig
config BOARD_PAN1782_EVB
	bool
	default y
	select SOC_SERIES_NRF52X
	select SOC_NRF52833_QIAA
```

## boards/arm/particle_xenon/Kconfig.particle_xenon
```kconfig
config BOARD_PARTICLE_XENON
	bool
	default y
	select SOC_SERIES_NRF52X
	select SOC_NRF52840_QIAA
```

## boards/arm/pico_pi_m4/Kconfig.board
```kconfig
# Pico-Pi iMX7D M4 board

# Copyright (c) 2019, Joris Offouga
# SPDX-License-Identifier: Apache-2.0

config BOARD_PICO_PI_M4
```

## boards/arm/pico_pi_m4/Kconfig.pico_pi_m4
```kconfig
config BOARD_PICO_PI_M4
	bool
	default y
	select SOC_SERIES_IMX7_M4
	select SOC_MCIMX7_M4
```

## boards/arm/pico_pi_m4/pico_pi_m4_defconfig
```kconfig
#
# Copyright (c) 2019, Joris Offouga
#
# SPDX-License-Identifier: Apache-2.0
#

CONFIG_BOARD_PICO_PI_M4=y
CONFIG_CORTEX_M_SYSTICK=y
CONFIG_UART_CONSOLE=y
CONFIG_SERIAL=y
CONFIG_UART_INTERRUPT_DRIVEN=y
CONFIG_CONSOLE=y
CONFIG_XIP=y
CONFIG_GPIO=n
CONFIG_PINCTRL=y
```

## boards/arm/pinetime_devkit0/Kconfig.pinetime_devkit0
```kconfig
config BOARD_PINETIME_DEVKIT0
	bool
	default y
	select SOC_SERIES_NRF52X
	select SOC_NRF52832_QFAA
```

## boards/arm/pinnacle_100_dvk/Kconfig.pinnacle_100_dvk
```kconfig
config BOARD_PINNACLE_100_DVK
	bool
	default y
	select SOC_SERIES_NRF52X
	select SOC_NRF52840_QIAA
```

## boards/arm/qemu_cortex_a9/Kconfig.qemu_cortex_a9
```kconfig
config BOARD_QEMU_CORTEX_A9
	bool
	default y
	select SOC_SERIES_XILINX_XC7ZXXXS
	select SOC_XILINX_XC7Z007S
	select QEMU_TARGET
```

## boards/arm/qemu_cortex_m0/Kconfig.qemu_cortex_m0
```kconfig
config BOARD_QEMU_CORTEX_M0
	bool
	default y
	select SOC_SERIES_NRF51X
	select SOC_NRF51822_QFAA
	select QEMU_TARGET
```

## boards/arm/qemu_cortex_m3/Kconfig.qemu_cortex_m3
```kconfig
config BOARD_QEMU_CORTEX_M3
	bool
	default y
	select SOC_TI_LM3S6965
	select QEMU_TARGET
```

## boards/arm/qemu_cortex_r5/Kconfig.qemu_cortex_r5
```kconfig
config BOARD_QEMU_CORTEX_R5
	bool
	default y
	select SOC_XILINX_ZYNQMP_RPU
	select QEMU_TARGET
```

## boards/arm/rak4631_nrf52840/Kconfig.board
```kconfig
# RAKWIRELESS RAK4631 selection

# Copyright (c) 2021 Guillaume Paquet <guillaume.paquet@smile.fr>
# SPDX-License-Identifier: Apache-2.0

config BOARD_RAK4631_NRF52840
```

## boards/arm/rak5010_nrf52840/Kconfig.rak5010_nrf52840
```kconfig
config BOARD_RAK5010_NRF52840
	bool
	default y
	select SOC_SERIES_NRF52X
	select SOC_NRF52840_QIAA
```

## boards/arm/rcar_h3_salvatorx/Kconfig.board
```kconfig
# Copyright (c) 2022 BayLibre, SAS
# SPDX-License-Identifier: Apache-2.0

config BOARD_RCAR_H3_SALVATORX_CR7
```

## boards/arm/rcar_h3_salvatorx/Kconfig.rcar_h3_salvatorx_cr7
```kconfig
config BOARD_RCAR_H3_SALVATORX_CR7
	bool
	default y
	select SOC_R8A77951
	select SOC_SERIES_RCAR_GEN3
```

## boards/arm/rcar_h3ulcb/Kconfig.board
```kconfig
# Copyright (c) 2021 IoT.bzh
# SPDX-License-Identifier: Apache-2.0

config BOARD_RCAR_H3ULCB_CR7
```
