## boards/arm/96b_nitrogen/Kconfig.96b_nitrogen
```kconfig
config BOARD_96B_NITROGEN
	bool
	default y
	select SOC_SERIES_NRF52X
	select SOC_NRF52832_QFAA
```

## boards/arm/96b_stm32_sensor_mez/Kconfig.96b_stm32_sensor_mez
```kconfig
config BOARD_96B_STM32_SENSOR_MEZ
	bool
	default y
	select SOC_SERIES_STM32F4X
	select SOC_STM32F446XX
```

## boards/arm/96b_wistrio/Kconfig.96b_wistrio
```kconfig
config BOARD_96B_WISTRIO
	bool
	default y
	select SOC_SERIES_STM32L1X
	select SOC_STM32L151XBA
```

## boards/arm/actinius_icarus/Kconfig.actinius_icarus
```kconfig
config BOARD_ACTINIUS_ICARUS
	bool
	default y
	select SOC_SERIES_NRF91X
	select SOC_NRF9160_SICA
```

## boards/arm/actinius_icarus/Kconfig.board
```kconfig
# Actinius Icarus board configuration

# Copyright (c) 2019 Actinius
# SPDX-License-Identifier: Apache-2.0

if SOC_NRF9160_SICA

config BOARD_ACTINIUS_ICARUS
config BOARD_ACTINIUS_ICARUS_NS
```

## boards/arm/actinius_icarus_bee/Kconfig.actinius_icarus_bee
```kconfig
config BOARD_ACTINIUS_ICARUS_BEE
	bool
	default y
	select SOC_SERIES_NRF91X
	select SOC_NRF9160_SICA
```

## boards/arm/actinius_icarus_bee/Kconfig.board
```kconfig
# Actinius Icarus Bee board configuration

# Copyright (c) 2021 Actinius
# SPDX-License-Identifier: Apache-2.0

if SOC_NRF9160_SICA

config BOARD_ACTINIUS_ICARUS_BEE
config BOARD_ACTINIUS_ICARUS_BEE_NS
```

## boards/arm/actinius_icarus_som/Kconfig.actinius_icarus_som_ns
```kconfig
config BOARD_ACTINIUS_ICARUS_SOM_NS
	bool
	default y
	select SOC_SERIES_NRF91X
	select SOC_NRF9160_SICA
```

## boards/arm/adafruit_feather_m0_basic_proto/Kconfig.adafruit_feather_m0_basic_proto
```kconfig
config BOARD_ADAFRUIT_FEATHER_M0_BASIC_PROTO
	bool
	default y
	select SOC_SERIES_SAMD21
	select SOC_PART_NUMBER_SAMD21G18A
```

## boards/arm/adafruit_feather_m0_basic_proto/adafruit_feather_m0_basic_proto_defconfig
```kconfig
# SPDX-License-Identifier: Apache-2.0

CONFIG_BOARD_ADAFRUIT_FEATHER_M0_BASIC_PROTO=y
CONFIG_CORTEX_M_SYSTICK=y
CONFIG_CONSOLE=y
CONFIG_UART_CONSOLE=y
CONFIG_SERIAL=y
CONFIG_UART_INTERRUPT_DRIVEN=y
CONFIG_GPIO=y
CONFIG_USE_DT_CODE_PARTITION=y
```

## boards/arm/adafruit_feather_nrf52840/Kconfig.adafruit_feather_nrf52840
```kconfig
config BOARD_ADAFRUIT_FEATHER_NRF52840
	bool
	default y
	select SOC_SERIES_NRF52X
	select SOC_NRF52840_QIAA
```

## boards/arm/adafruit_feather_stm32f405/Kconfig.adafruit_feather_stm32f405
```kconfig
config BOARD_ADAFRUIT_FEATHER_STM32F405
	bool
	default y
	select SOC_SERIES_STM32F4X
	select SOC_STM32F405XG
```

## boards/arm/adafruit_itsybitsy_m4_express/Kconfig.adafruit_itsybitsy_m4_express
```kconfig
config BOARD_ADAFRUIT_ITSYBITSY_M4_EXPRESS
	bool
	default y
	select SOC_SERIES_SAMD51
	select SOC_PART_NUMBER_SAMD51G19A
```

## boards/arm/adafruit_itsybitsy_m4_express/Kconfig.board
```kconfig
# Adafruit ItsyBitsy M4 Express board configuration

# Copyright (c) 2020 Google LLC.
# SPDX-License-Identifier: Apache-2.0

config BOARD_ADAFRUIT_ITSYBITSY_M4_EXPRESS
```

## boards/arm/adafruit_itsybitsy_m4_express/adafruit_itsybitsy_m4_express_defconfig
```kconfig
# SPDX-License-Identifier: Apache-2.0

CONFIG_BOARD_ADAFRUIT_ITSYBITSY_M4_EXPRESS=y
CONFIG_CORTEX_M_SYSTICK=y
CONFIG_ARM_MPU=y
CONFIG_CONSOLE=y
CONFIG_UART_CONSOLE=y
CONFIG_UART_INTERRUPT_DRIVEN=y
CONFIG_SERIAL=y
CONFIG_BOOTLOADER_BOSSA=y
CONFIG_BOOTLOADER_BOSSA_ADAFRUIT_UF2=y
```

## boards/arm/adafruit_trinket_m0/Kconfig.adafruit_trinket_m0
```kconfig
config BOARD_ADAFRUIT_TRINKET_M0
	bool
	default y
	select SOC_SERIES_SAMD21
	select SOC_PART_NUMBER_SAMD21E18A
```

## boards/arm/adafruit_trinket_m0/Kconfig.board
```kconfig
# Adafruit Trinket M0 board configuration

# Copyright (c) 2018 Google LLC.
# SPDX-License-Identifier: Apache-2.0

config BOARD_ADAFRUIT_TRINKET_M0
```

## boards/arm/adafruit_trinket_m0/adafruit_trinket_m0_defconfig
```kconfig
# SPDX-License-Identifier: Apache-2.0

CONFIG_BOARD_ADAFRUIT_TRINKET_M0=y
CONFIG_CORTEX_M_SYSTICK=y
CONFIG_CONSOLE=y
CONFIG_UART_CONSOLE=y
CONFIG_UART_INTERRUPT_DRIVEN=y
CONFIG_SERIAL=y
CONFIG_USE_DT_CODE_PARTITION=y
CONFIG_BOOTLOADER_BOSSA=y
CONFIG_BOOTLOADER_BOSSA_ADAFRUIT_UF2=y
```

## boards/arm/arduino_due/Kconfig.arduino_due
```kconfig
config BOARD_ARDUINO_DUE
	bool
	default y
	select SOC_SERIES_SAM3X
	select SOC_PART_NUMBER_SAM3X8E
```

## boards/arm/arduino_due/Kconfig.board
```kconfig
# Arduino Due Board configuration

# Copyright (c) 2017 Justin Watson
# SPDX-License-Identifier: Apache-2.0

config BOARD_ARDUINO_DUE
```

## boards/arm/arduino_due/arduino_due_defconfig
```kconfig
# SPDX-License-Identifier: Apache-2.0

CONFIG_BOARD_ARDUINO_DUE=y
CONFIG_CORTEX_M_SYSTICK=y
CONFIG_ARM_MPU=y
CONFIG_CONSOLE=y
CONFIG_UART_CONSOLE=y
CONFIG_SERIAL=y
CONFIG_WDT_DISABLE_AT_BOOT=y

# Enable HW stack protection
CONFIG_HW_STACK_PROTECTION=y
```

## boards/arm/arduino_mkrzero/Kconfig.arduino_mkrzero
```kconfig
config BOARD_ARDUINO_MKRZERO
	bool
	default y
	select SOC_SERIES_SAMD21
	select SOC_PART_NUMBER_SAMD21G18A
```

## boards/arm/arduino_mkrzero/arduino_mkrzero_defconfig
```kconfig
# SPDX-License-Identifier: Apache-2.0

CONFIG_BOARD_ARDUINO_MKRZERO=y
CONFIG_CORTEX_M_SYSTICK=y
CONFIG_CONSOLE=y
CONFIG_UART_CONSOLE=y
CONFIG_UART_INTERRUPT_DRIVEN=y
CONFIG_SERIAL=y
CONFIG_BOOTLOADER_BOSSA=y
CONFIG_BOOTLOADER_BOSSA_ARDUINO=y
CONFIG_GPIO=y
```

## boards/arm/arduino_nano_33_ble/Kconfig.arduino_nano_33_ble
```kconfig
config BOARD_ARDUINO_NANO_33_BLE
	bool
	default y
	select SOC_SERIES_NRF52X
	select SOC_NRF52840_QIAA
```

## boards/arm/arduino_nano_33_iot/Kconfig.arduino_nano_33_iot
```kconfig
config BOARD_ARDUINO_NANO_33_IOT
	bool
	default y
	select SOC_SERIES_SAMD21
	select SOC_PART_NUMBER_SAMD21G18A
```
