## boards/arm/nrf5340dk_nrf5340/Kconfig.board
```kconfig
# nRF5340 DK NRF5340 board configuration

# Copyright (c) 2019-2020 Nordic Semiconductor ASA
# SPDX-License-Identifier: Apache-2.0

if SOC_NRF5340_CPUAPP_QKAA

config BOARD_NRF5340DK_NRF5340_CPUAPP
config BOARD_NRF5340DK_NRF5340_CPUAPP_NS
config BOARD_NRF5340DK_NRF5340_CPUNET
```

## boards/arm/nrf5340dk_nrf5340/Kconfig.nrf5340dk_nrf5340_cpuapp
```kconfig
config BOARD_NRF5340DK_NRF5340_CPUAPP
	bool
	default y
	select SOC_SERIES_NRF53X
	select SOC_NRF5340_CPUAPP_QKAA
```

## boards/arm/nrf5340dk_nrf5340/Kconfig.nrf5340dk_nrf5340_cpunet
```kconfig
config BOARD_NRF5340DK_NRF5340_CPUNET
	bool
	default y
	select SOC_SERIES_NRF53X
	select SOC_NRF5340_CPUNET_QKAA
```

## boards/arm/nrf5340dk_nrf5340/Kconfig.v2.nrf5340dk_nrf5340_cpuapp_ns
```kconfig
# nRF5340 DK NRF5340 board configuration

# Copyright (c) 2019-2023 Nordic Semiconductor ASA
# SPDX-License-Identifier: Apache-2.0

config BOARD_NRF5340DK_NRF5340_CPUAPP_NS
	bool "nRF5340 DK nRF5340 Application MCU non-secure"
	default y
	select SOC_SERIES_NRF53X
	select SOC_NRF5340_CPUAPP_QKAA
	imply CONFIG_TRUSTED_EXECUTION_NONSECURE
```

## boards/arm/nrf5340dk_nrf5340/Kconfig.v2.nrf5340dk_nrf5340_cpunet
```kconfig
# nRF5340 DK NRF5340 board configuration

# Copyright (c) 2019-2023 Nordic Semiconductor ASA
# SPDX-License-Identifier: Apache-2.0

config BOARD_NRF5340DK_NRF5340_CPUNET
	bool "nRF5340 DK NRF5340 Network MCU"
	default y
	select SOC_SERIES_NRF53X
	select SOC_NRF5340_CPUNET_QKAA
```

## boards/arm/nrf9160_innblue21/Kconfig.board
```kconfig
# nRF9160 innblue V2.1 board configuration

# Copyright (c) 2020 InnBlue
# SPDX-License-Identifier: Apache-2.0

if SOC_NRF9160_SICA

config BOARD_NRF9160_INNBLUE21
config BOARD_NRF9160_INNBLUE21_NS
```

## boards/arm/nrf9160_innblue21/Kconfig.nrf9160_innblue21
```kconfig
config BOARD_NRF9160_INNBLUE21
	bool
	default y
	select SOC_SERIES_NRF91X
	select SOC_NRF9160_SICA
```

## boards/arm/nrf9160_innblue21/Kconfig.nrf9160_innblue21_ns
```kconfig
config BOARD_NRF9160_INNBLUE21_NS
	bool
	default y
	select SOC_SERIES_NRF91X
	select SOC_NRF9160_SICA
```

## boards/arm/nrf9160_innblue22/Kconfig.nrf9160_innblue22
```kconfig
config BOARD_NRF9160_INNBLUE22
	bool
	default y
	select SOC_SERIES_NRF91X
	select SOC_NRF9160_SICA
```

## boards/arm/nrf9160_innblue22/Kconfig.nrf9160_innblue22_ns
```kconfig
config BOARD_NRF9160_INNBLUE22_NS
	bool
	default y
	select SOC_SERIES_NRF91X
	select SOC_NRF9160_SICA
```

## boards/arm/nrf9160dk_nrf52840/Kconfig.board
```kconfig
# nRF9160 DK NRF52840 board configuration

# Copyright (c) 2018-2020 Nordic Semiconductor ASA
# SPDX-License-Identifier: Apache-2.0

config BOARD_NRF9160DK_NRF52840
```

## boards/arm/nrf9160dk_nrf9160/Kconfig.nrf9160dk_nrf9160_ns
```kconfig
config BOARD_NRF9160DK_NRF9160_NS
        bool
	default y
	select SOC_NRF9160_SICA
	select SOC_SERIES_NRF91X  
	select SOC_NRF9160_SICA
```

## boards/arm/nucleo_f030r8/Kconfig.nucleo_f030r8
```kconfig
config BOARD_NUCLEO_F030R8
	bool
	default y
	select SOC_SERIES_STM32F0X
	select SOC_STM32F030X8
```

## boards/arm/nucleo_f031k6/Kconfig.nucleo_f031k6
```kconfig
config BOARD_NUCLEO_F031K6
	bool
	default y
	select SOC_SERIES_STM32F0X
	select SOC_STM32F031X6
```

## boards/arm/nucleo_f070rb/Kconfig.board
```kconfig
# NUCLEO_F070RB board configuration

# Copyright (c) 2018 qianfan Zhao
# SPDX-License-Identifier: Apache-2.0

config BOARD_NUCLEO_F070RB
```

## boards/arm/nucleo_f070rb/Kconfig.nucleo_f070rb
```kconfig
config BOARD_NUCLEO_F070RB
	bool
	default y
	select SOC_SERIES_STM32F0X
	select SOC_STM32F070XB
```

## boards/arm/nucleo_f091rc/Kconfig.nucleo_f091rc
```kconfig
config BOARD_NUCLEO_F091RC
	bool
	default y
	select SOC_SERIES_STM32F0X
	select SOC_STM32F091XC
```

## boards/arm/nucleo_f103rb/Kconfig.board
```kconfig
# NUCLEO-64 F103RB board configuration

# Copyright (c) 2016 Open-RnD Sp. z o.o.
# SPDX-License-Identifier: Apache-2.0

config BOARD_NUCLEO_F103RB
```

## boards/arm/nucleo_f103rb/Kconfig.nucleo_f103rb
```kconfig
config BOARD_NUCLEO_F103RB
	bool
	default y
	select SOC_SERIES_STM32F1X
	select SOC_STM32F103XB
```

## boards/arm/nucleo_f207zg/Kconfig.board
```kconfig
# NUCLEO-144 F207ZG board configuration

# Copyright (c) 2018 qianfan Zhao
# SPDX-License-Identifier: Apache-2.0

config BOARD_NUCLEO_F207ZG
```

## boards/arm/nucleo_f302r8/Kconfig.board
```kconfig
# NUCLEO-64 F302R8 board configuration

# Copyright (c) 2018 Seitz & Associates
# SPDX-License-Identifier: Apache-2.0

config BOARD_NUCLEO_F302R8
```

## boards/arm/nucleo_f302r8/Kconfig.nucleo_f302r8
```kconfig
config BOARD_NUCLEO_F302R8
	bool
	default y
	select SOC_SERIES_STM32F3X
	select SOC_STM32F302X8
```

## boards/arm/nucleo_f303k8/Kconfig.nucleo_f303k8
```kconfig
config BOARD_NUCLEO_F303K8
	bool
	default y
	select SOC_SERIES_STM32F3X
	select SOC_STM32F303X8
```

## boards/arm/nucleo_f303re/Kconfig.nucleo_f303re
```kconfig
config BOARD_NUCLEO_F303RE
	bool
	default y
	select SOC_SERIES_STM32F3X
	select SOC_STM32F303XE
```

## boards/arm/nucleo_f334r8/Kconfig.nucleo_f334r8
```kconfig
config BOARD_NUCLEO_F334R8
	bool
	default y
	select SOC_SERIES_STM32F3X
	select SOC_STM32F334X8
```
