## boards/arm/v2m_musca_b1/Kconfig.board
```kconfig
# Copyright (c) 2019 Linaro Limited
# SPDX-License-Identifier: Apache-2.0

config BOARD_MUSCA_B1
```

## boards/arm/v2m_musca_b1/Kconfig.v2m_musca_b1
```kconfig
config BOARD_V2M_MUSCA_B1
	bool
	default y
	select SOC_SERIES_MUSCA_B1
	select SOC_V2M_MUSCA_B1
```

## boards/arm/v2m_musca_b1/Kconfig.v2m_musca_b1_ns
```kconfig
config BOARD_V2M_MUSCA_B1_NS
	bool
	default y
	select SOC_SERIES_MUSCA_B1
	select SOC_V2M_MUSCA_B1
```

## boards/arm/v2m_musca_s1/Kconfig.board
```kconfig
# Copyright (c) 2019-2020 Linaro Limited
# SPDX-License-Identifier: Apache-2.0

config BOARD_MUSCA_S1
```

## boards/arm/v2m_musca_s1/Kconfig.v2m_musca_s1
```kconfig
config BOARD_V2M_MUSCA_S1
	bool
	default y
	select SOC_SERIES_MUSCA_S1
	select SOC_V2M_MUSCA_S1
```

## boards/arm/v2m_musca_s1/Kconfig.v2m_musca_s1_ns
```kconfig
config BOARD_V2M_MUSCA_S1_NS
	bool
	default y
	select SOC_SERIES_MUSCA_S1
	select SOC_V2M_MUSCA_S1
```

## boards/arm/warp7_m4/Kconfig.board
```kconfig
# WaRP7 iMX7S M4 board

# Copyright (c) 2018, Diego Sueiro
# SPDX-License-Identifier: Apache-2.0

config BOARD_WARP7_M4
```

## boards/arm/warp7_m4/Kconfig.warp7_m4
```kconfig
config BOARD_WARP7_M4
	bool
	default y
	select SOC_SERIES_IMX7_M4
	select SOC_MCIMX7_M4
	select SOC_PART_NUMBER_MCIMX7S3DVK08SA
```

## boards/arm/waveshare_open103z/Kconfig.board
```kconfig
# Waveshare Open103Z board configuration

# Copyright (c) 2020 Stefano Manni
# SPDX-License-Identifier: Apache-2.0

config BOARD_WAVESHARE_OPEN103Z
```

## boards/arm/waveshare_open103z/Kconfig.waveshare_open103z
```kconfig
config BOARD_WAVESHARE_OPEN103Z
	bool
	default y
	select SOC_SERIES_STM32F1X
	select SOC_STM32F103XE
```

## boards/arm/we_proteus2ev_nrf52832/Kconfig.we_proteus2ev_nrf52832
```kconfig
config BOARD_WE_PROTEUS2EV_NRF52832
	bool
	default y
	select SOC_SERIES_NRF52X
	select SOC_NRF52832_CIAA
```

## boards/arm/we_proteus3ev_nrf52840/Kconfig.we_proteus3ev_nrf52840
```kconfig
config BOARD_WE_PROTEUS3EV_NRF52840
	bool
	default y
	select SOC_SERIES_NRF52X
	select SOC_NRF52840_QIAA
```

## boards/arm/xmc45_relax_kit/Kconfig.board
```kconfig
# SPDX-License-Identifier: Apache-2.0
#
# Copyright (c) 2020 Linumiz
# Author: Parthiban Nallathambi <parthiban@linumiz.com>

config BOARD_XMC45_RELAX_KIT
```

## boards/arm/xmc45_relax_kit/Kconfig.xmc45_relax_kit
```kconfig
config BOARD_XMC45_RELAX_KIT
	bool
	default y
	select SOC_SERIES_XMC_4XXX
	select SOC_XMC4500
	select SOC_PART_NUMBER_F100X1024
```

## boards/arm/zybo/Kconfig.zybo
```kconfig
config BOARD_ZYBO
	bool
	default y
	select SOC_SERIES_XILINX_XC7ZXXX
	select SOC_XILINX_XC7Z010
```

## boards/arm64/bcm958402m2_a72/Kconfig.bcm958402m2_a72
```kconfig
config BOARD_BCM958402M2_A72
	bool
	default y
	select SOC_SERIES_VIPER
	select SOC_BCM58402_A72
```

## boards/arm64/bcm958402m2_a72/Kconfig.board
```kconfig
# Copyright 2020 Broadcom
# SPDX-License-Identifier: Apache-2.0

config BOARD_BCM958402M2_A72
```

## boards/arm64/fvp_base_revc_2xaemv8a/Kconfig.fvp_base_revc_2xaemv8a
```kconfig
config BOARD_FVP_BASE_REVC_2XAEMV8A
	bool
	default y
	select SOC_SERIES_FVP_AEMV8A
	select SOC_FVP_BASE_REVC_2XAEMV8A
```

## boards/arm64/fvp_base_revc_2xaemv8a/Kconfig.fvp_base_revc_2xaemv8a_smp_ns
```kconfig
config BOARD_FVP_BASE_REVC_2XAEMV8A_SMP_NS
	bool
	default y
	select SOC_SERIES_FVP_AEMV8A
	select SOC_FVP_BASE_REVC_2XAEMV8A
```

## boards/arm64/fvp_baser_aemv8r/Kconfig.board
```kconfig
# Copyright (c) 2021 Arm Limited (or its affiliates). All rights reserved.
# SPDX-License-Identifier: Apache-2.0

config BOARD_FVP_BASER_AEMV8R
```

## boards/arm64/fvp_baser_aemv8r/Kconfig.fvp_baser_aemv8r
```kconfig
config BOARD_FVP_BASER_AEMV8R
	bool
	default y
	select SOC_SERIES_FVP_AEMV8R
	select SOC_FVP_AEMV8R_AARCH64
```

## boards/arm64/mimx8mm_evk/Kconfig.board
```kconfig
# Copyright 2021-2022 NXP
# SPDX-License-Identifier: Apache-2.0

config BOARD_MIMX8MM_EVK_A53
```

## boards/arm64/mimx8mm_evk/Kconfig.mimx8mm_evk_a53_smp
```kconfig
config BOARD_MIMX8MM_EVK_A53_SMP
	bool
	default y
	select SOC_SERIES_MIMX8M_A53
	select SOC_MIMX8MM_A53
```

## boards/arm64/mimx8mn_evk/Kconfig.board
```kconfig
# Copyright 2022 NXP
# SPDX-License-Identifier: Apache-2.0

config BOARD_MIMX8MN_EVK_A53
```

## boards/arm64/mimx8mn_evk/Kconfig.mimx8mn_evk_a53
```kconfig
config BOARD_MIMX8MN_EVK_A53
	bool
	default y
	select SOC_SERIES_MIMX8M_A53
	select SOC_MIMX8MN_A53
```
