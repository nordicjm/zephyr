## boards/arm/stm32f769i_disco/Kconfig.board
```kconfig
# STM32F769I Discovery board configuration

# Copyright (c) 2018 Yong Jin
# SPDX-License-Identifier: Apache-2.0

config BOARD_STM32F769I_DISCO
```

## boards/arm/stm32f769i_disco/Kconfig.stm32f769i_disco
```kconfig
config BOARD_STM32F769I_DISCO
	bool
	default y
	select SOC_SERIES_STM32F7X
	select SOC_STM32F769XX
```

## boards/arm/stm32g0316_disco/Kconfig.board
```kconfig
# STM32G0316 Discovery board configuration

# Copyright (c) 2019 SEAL AG
# SPDX-License-Identifier: Apache-2.0

config BOARD_STM32G0316_DISCO
```

## boards/arm/stm32g0316_disco/Kconfig.stm32g0316_disco
```kconfig
config BOARD_STM32G0316_DISCO
	bool
	default y
	select SOC_SERIES_STM32G0X
	select SOC_STM32G031XX
```

## boards/arm/stm32g071b_disco/Kconfig.stm32g071b_disco
```kconfig
config BOARD_STM32G071B_DISCO
	bool
	default y
	select SOC_SERIES_STM32G0X
	select SOC_STM32G071XX
```

## boards/arm/stm32g081b_eval/Kconfig.board
```kconfig
# STM32G081B Evaluation board configuration

# Copyright 2021 The Chromium OS Authors
# SPDX-License-Identifier: Apache-2.0

config BOARD_STM32G081B_EVAL
```

## boards/arm/stm32g081b_eval/Kconfig.stm32g081b_eval
```kconfig
config BOARD_STM32G081B_EVAL
	bool
	default y
	select SOC_SERIES_STM32G0X
	select SOC_STM32G081XX
```

## boards/arm/stm32h735g_disco/Kconfig.board
```kconfig
# STM32H735G Discovery board configuration

# Copyright (c) 2021 SILA Embedded Solutions GmbH
# SPDX-License-Identifier: Apache-2.0

config BOARD_STM32H735G_DISCO
```

## boards/arm/stm32h735g_disco/Kconfig.stm32h735g_disco
```kconfig
config BOARD_STM32H735G_DISCO
	bool
	default y
	select SOC_SERIES_STM32H7X
	select SOC_STM32H735XX
```

## boards/arm/stm32h747i_disco/Kconfig.board
```kconfig
# STM32H747I Discovery board configuration

# Copyright (c) 2019 Linaro Limited
# SPDX-License-Identifier: Apache-2.0

config BOARD_STM32H747I_DISCO_M7
config BOARD_STM32H747I_DISCO_M4
```

## boards/arm/stm32h747i_disco/Kconfig.stm32h747i_disco_m4
```kconfig
config BOARD_STM32H747I_DISCO_M4
	bool
	default y
	select SOC_SERIES_STM32H7X
	select SOC_STM32H747XX
	select CPU_CORTEX_M4
```

## boards/arm/stm32h7b3i_dk/Kconfig.board
```kconfig
# STM32H7B3I Discovery kit board configuration

# Copyright (c) 2022 Byte-Lab d.o.o. <dev@byte-lab.com>
# SPDX-License-Identifier: Apache-2.0

config BOARD_STM32H7B3I_DK
```

## boards/arm/stm32h7b3i_dk/Kconfig.stm32h7b3i_dk
```kconfig
config BOARD_STM32H7B3I_DK
	bool
	default y
	select SOC_SERIES_STM32H7X
	select SOC_STM32H7B3XXQ
```

## boards/arm/stm32l1_disco/Kconfig.stm32l1_disco
```kconfig
config BOARD_STM32L1_DISCO
	bool
	default y
	select SOC_SERIES_STM32L1X
	select SOC_STM32L151XB
```

## boards/arm/stm32l476g_disco/Kconfig.board
```kconfig
# STM32L476G Discovery board configuration

# Copyright (c) 2017 Arthur Sfez
# SPDX-License-Identifier: Apache-2.0

config BOARD_STM32L476G_DISCO
```

## boards/arm/stm32l476g_disco/Kconfig.stm32l476g_disco
```kconfig
config BOARD_STM32L476G_DISCO
	bool
	default y
	select SOC_SERIES_STM32L4X
	select SOC_STM32L476XX
```

## boards/arm/stm32l496g_disco/Kconfig.stm32l496g_disco
```kconfig
config BOARD_STM32L496G_DISCO
	bool
	default y
	select SOC_SERIES_STM32L4X
	select SOC_STM32L496XX
```

## boards/arm/stm32l562e_dk/Kconfig.stm32l562e_dk
```kconfig
config BOARD_STM32L562E_DK
	bool
	default y
	select SOC_SERIES_STM32L5X
	select SOC_STM32L562XX
```

## boards/arm/stm32l562e_dk/Kconfig.stm32l562e_dk_ns
```kconfig
config BOARD_STM32L562E_DK_NS
	bool
	default y
	select SOC_SERIES_STM32L5X
	select SOC_STM32L562XX
```

## boards/arm/stm32mp157c_dk2/Kconfig.board
```kconfig
# STM32MP157C Discovery board configuration

# Copyright (c) 2019 STMicroelectronics
# SPDX-License-Identifier: Apache-2.0

config BOARD_STM32MP157C_DK2
```

## boards/arm/stm32mp157c_dk2/Kconfig.stm32mp157c_dk2
```kconfig
config BOARD_STM32MP157C_DK2
	bool
	default y
	select SOC_SERIES_STM32MP1X
	select SOC_STM32MP15_M4
```

## boards/arm/stm32vl_disco/Kconfig.stm32vl_disco
```kconfig
config BOARD_STM32VL_DISCO
	bool
	default y
	select SOC_SERIES_STM32F1X
	select SOC_STM32F100XB
```

## boards/arm/swan_r5/Kconfig.board
```kconfig
# Blues Wireless Swan board configuration

# Copyright (c) 2022 Blues Inc.
# SPDX-License-Identifier: Apache-2.0

config BOARD_SWAN_R5
```

## boards/arm/swan_r5/Kconfig.swan_r5
```kconfig
config BOARD_SWAN_R5
	bool
	default y
	select SOC_SERIES_STM32L4X
	select SOC_STM32L4R5XX
```

## boards/arm/tdk_robokit1/Kconfig.board
```kconfig
# TDK RoboKit 1 Board Options

# Copyright (c) 2022 Intel Corporation
# SPDX-License-Identifier: Apache-2.0

config BOARD_TDK_ROBOKIT1
	depends on SOC_PART_NUMBER_SAME70Q21 || SOC_PART_NUMBER_SAME70Q21B
```
