## boards/arm/ebyte_e73_tbb_nrf52832/Kconfig.ebyte_e73_tbb_nrf52832
```kconfig
config BOARD_EBYTE_E73_TBB_NRF52832
	bool
	default y
	select SOC_SERIES_NRF52X
	select SOC_NRF52832_QFAA
```

## boards/arm/efm32gg_slwstk6121a/Kconfig.efm32gg_slwstk6121a
```kconfig
config BOARD_EFM32GG_SLWSTK6121A
	bool
	default y
	select SOC_SERIES_EFM32GG11B
	select SOC_PART_NUMBER_EFM32GG11B820F2048GM64
```

## boards/arm/efm32gg_stk3701a/Kconfig.efm32gg_stk3701a
```kconfig
config BOARD_EFM32GG_STK3701A
	bool
	default y
	select SOC_SERIES_EFM32GG11B
	select SOC_PART_NUMBER_EFM32GG11B820F2048GL192
```

## boards/arm/efm32pg_stk3401a/Kconfig.efm32pg_stk3401a
```kconfig
config BOARD_EFM32PG_STK3401A
	bool
	default y
	select SOC_SERIES_EFM32PG1B
	select SOC_PART_NUMBER_EFM32PG1B200F256GM48
```

## boards/arm/efm32pg_stk3402a/Kconfig.board
```kconfig
# EFM32PG STK3402A board

# Copyright (c) 2018, Christian Taedcke
# Copyright (c) 2019  Lemonbeat GmbH
# SPDX-License-Identifier: Apache-2.0

config BOARD_EFM32PG_STK3402A
config BOARD_EFM32PG_STK3402A_JG
```

## boards/arm/efm32pg_stk3402a/Kconfig.efm32pg_stk3402a
```kconfig
config BOARD_EFM32PG_STK3402A
	bool
	default y
	select SOC_SERIES_EFM32PG12B
	select SOC_PART_NUMBER_EFM32PG12B500F1024GL125
```

## boards/arm/efm32wg_stk3800/Kconfig.board
```kconfig
# EFM32WG STK3800 board

# Copyright (c) 2017, Christian Taedcke
# SPDX-License-Identifier: Apache-2.0

config BOARD_EFM32WG_STK3800
```

## boards/arm/efr32_radio/Kconfig.board
```kconfig
# EFR32BG13 BRD4104A / EFR32MG21 BRD4180A /
# EFR32FG1P BRD4250B / EFR32FG13P BRD4255A board

# Copyright (c) 2020 Piotr Mienkowski
# Copyright (c) 2020 TriaGnoSys GmbH
# SPDX-License-Identifier: Apache-2.0

config BOARD_EFR32_RADIO_BRD4104A
config BOARD_EFR32_RADIO_BRD4250B
config BOARD_EFR32_RADIO_BRD4180A
config BOARD_EFR32_RADIO_BRD4255A
```

## boards/arm/efr32_radio/Kconfig.efr32_radio_brd4104a
```kconfig
config BOARD_EFR32_RADIO_BRD4104A
	bool
	default y
	select SOC_SERIES_EFR32BG13P
	select BOARD_EFR32_RADIO
	select SOC_PART_NUMBER_EFR32BG13P632F512GM48
```

## boards/arm/efr32_radio/Kconfig.efr32_radio_brd4180a
```kconfig
config BOARD_EFR32_RADIO_BRD4180A
	bool
	default y
	select SOC_SERIES_EFR32MG21
	select BOARD_EFR32_RADIO
	select SOC_PART_NUMBER_EFR32MG21A020F1024IM32
```

## boards/arm/efr32mg_sltb004a/Kconfig.board
```kconfig
# EFR32MG SLTB004A board

# Copyright (c) 2018, Diego Sueiro
# SPDX-License-Identifier: Apache-2.0

config BOARD_EFR32MG_SLTB004A
```

## boards/arm/efr32mg_sltb004a/Kconfig.efr32mg_sltb004a
```kconfig
config BOARD_EFR32MG_SLTB004A
	bool
	default y
	select SOC_SERIES_EFR32MG12P
	select SOC_PART_NUMBER_EFR32MG12P332F1024GL125
```

## boards/arm/faze/Kconfig.board
```kconfig
# Seagate FireCuda Gaming SSD (FaZe) board

# Copyright (c) 2020, Seagate Technology LLC
# SPDX-License-Identifier: Apache-2.0

config BOARD_FAZE
```

## boards/arm/faze/Kconfig.faze
```kconfig
config BOARD_FAZE
	bool
	default y
	select SOC_SERIES_LPC11U6X
	select SOC_LPC11U67
	select SOC_PART_NUMBER_LPC11U67JBD48
```

## boards/arm/frdm_k22f/Kconfig.board
```kconfig
# FRDM-K22F board

# Copyright (c) 2018, Prevas A/S
# SPDX-License-Identifier: Apache-2.0

config BOARD_FRDM_K22F
```

## boards/arm/frdm_k22f/Kconfig.frdm_k22f
```kconfig
config BOARD_FRDM_K22F
	bool
	default y
	select SOC_MK22F51212
	select SOC_SERIES_KINETIS_K2X
	select SOC_PART_NUMBER_MK22FN512VLH12
```

## boards/arm/frdm_k82f/Kconfig.board
```kconfig
# FRDM-K82F board configuration

# Copyright (c) 2019 SEAL AG
# SPDX-License-Identifier: Apache-2.0

config BOARD_FRDM_K82F
```

## boards/arm/frdm_k82f/Kconfig.frdm_k82f
```kconfig
config BOARD_FRDM_K82F
	bool
	default y
	select SOC_SERIES_KINETIS_K8X
	select SOC_MK82F25615
	select SOC_PART_NUMBER_MK82FN256VLL15
```

## boards/arm/frdm_kl25z/Kconfig.frdm_kl25z
```kconfig
config BOARD_FRDM_KL25Z
	bool
	default y
	select SOC_SERIES_KINETIS_KL2X
	select SOC_PART_NUMBER_MKL25Z128VLK4
```

## boards/arm/frdm_kw41z/Kconfig.board
```kconfig
# FRDM-KW41Z board

# Copyright (c) 2017, NXP
# SPDX-License-Identifier: Apache-2.0

config BOARD_FRDM_KW41Z
```

## boards/arm/frdm_kw41z/Kconfig.frdm_kw41z
```kconfig
config BOARD_FRDM_KW41Z
	bool
	default y
	select SOC_MKW41Z4
	select SOC_SERIES_KINETIS_KWX
	select SOC_PART_NUMBER_MKW41Z512VHT4
```

## boards/arm/fvp_baser_aemv8r_aarch32/Kconfig.board
```kconfig
# Copyright (c) 2021 Arm Limited (or its affiliates). All rights reserved.
# Copyright (c) 2022 IoT.bzh
# SPDX-License-Identifier: Apache-2.0

config BOARD_FVP_BASER_AEMV8R_AARCH32
```

## boards/arm/fvp_baser_aemv8r_aarch32/Kconfig.fvp_baser_aemv8r_aarch32
```kconfig
config BOARD_FVP_BASER_AEMV8R_AARCH32
	bool
	default y
	select SOC_SERIES_FVP_AEMV8R_AARCH32
	select SOC_FVP_AEMV8R_AARCH32
```

## boards/arm/gd32e103v_eval/Kconfig.board
```kconfig
# Copyright (c) 2021, YuLong Yao <feilongphone@gmail.com>
# SPDX-License-Identifier: Apache-2.0

config BOARD_GD32E103V_EVAL
```
