## boards/riscv/hifive1/Kconfig.hifive1
```kconfig
config BOARD_HIFIVE1
	bool
	default y
	select SOC_SERIES_RISCV_SIFIVE_FREEDOM
	select SOC_RISCV_SIFIVE_FREEDOM
```

## boards/riscv/hifive1_revb/Kconfig.board
```kconfig
# Copyright (c) 2019 SiFive Inc.
# SPDX-License-Identifier: Apache-2.0

config BOARD_HIFIVE1_REVB
```

## boards/riscv/hifive1_revb/Kconfig.hifive1_revb
```kconfig
config BOARD_HIFIVE1_REVB
	bool
	default y
	select SOC_SERIES_RISCV_SIFIVE_FREEDOM
	select SOC_RISCV_SIFIVE_FREEDOM
```

## boards/riscv/hifive_unleashed/Kconfig.hifive_unleashed
```kconfig
config BOARD_HIFIVE_UNLEASHED
	bool
	default y
	select SOC_SERIES_RISCV_SIFIVE_FREEDOM
	select SOC_RISCV_SIFIVE_FU540
```

## boards/riscv/hifive_unmatched/Kconfig.hifive_unmatched
```kconfig
config BOARD_HIFIVE_UNMATCHED
	bool
	default y
	select SOC_SERIES_RISCV_SIFIVE_FREEDOM
	select SOC_RISCV_SIFIVE_FU740
```

## boards/riscv/it8xxx2_evb/Kconfig.it8xxx2_evb
```kconfig
config BOARD_IT8XXX2_EVB
	bool
	default y
	select SOC_SERIES_RISCV32_IT8XXX2
	select SOC_IT8XXX2
```

## boards/riscv/longan_nano/Kconfig.board
```kconfig
# Copyright (c) 2021 Tokita, Hiroshi <tokita.hiroshi@gmail.com>
# SPDX-License-Identifier: Apache-2.0

config BOARD_LONGAN_NANO
config BOARD_LONGAN_NANO_LITE
```

## boards/riscv/longan_nano/Kconfig.longan_nano
```kconfig
config BOARD_LONGAN_NANO
	bool
	default y
	select SOC_SERIES_GD32VF103
	select SOC_GD32VF103
```

## boards/riscv/longan_nano/Kconfig.longan_nano_lite
```kconfig
config BOARD_LONGAN_NANO_LITE
	bool
	default y
	select SOC_SERIES_GD32VF103
	select SOC_GD32VF103
```

## boards/riscv/m2gl025_miv/Kconfig.m2gl025_miv
```kconfig
config BOARD_M2GL025_MIV
	bool
	default y
	select SOC_SERIES_RISCV32_MIV
	select SOC_RISCV32_MIV
```

## boards/riscv/neorv32/Kconfig.neorv32
```kconfig
config BOARD_NEORV32
	bool
	default y
	select SOC_SERIES_NEORV32
	select SOC_NEORV32_ISA_C
```

## boards/riscv/qemu_riscv32e/Kconfig.board
```kconfig
# Copyright (c) 2022 Carlo Caione <ccaione@baylibre.com>
# SPDX-License-Identifier: Apache-2.0

config BOARD_QEMU_RISCV32E
```

## boards/riscv/qemu_riscv64/Kconfig.board
```kconfig
# Copyright (c) 2019 BayLibre SAS
# SPDX-License-Identifier: Apache-2.0

config BOARD_QEMU_RISCV64
config BOARD_QEMU_RISCV64_SMP
```

## boards/riscv/qemu_riscv64/Kconfig.qemu_riscv64
```kconfig
config BOARD_QEMU_RISCV64
	bool
	default y
	select SOC_SERIES_RISCV_VIRT
	select SOC_RISCV_VIRT
```

## boards/seeed_studio/96b_carbon/board.yml
```yaml
board:
  name: 96b_carbon
  vendor: Seeed Studio
  socs:
    - name: stm32f401xe
    - name: nrf51822
```

## boards/sifive/hifive1/Kconfig.defconfig
```kconfig
# SPDX-License-Identifier: Apache-2.0

if BOARD_HIFIVE1_E340_A

config SYS_CLOCK_TICKS_PER_SEC
	default 128

endif # BOARD_HIFIVE1_E340_A

if BOARD_HIFIVE1_E340_B

config HAS_FLASH_LOAD_OFFSET
	default y

config FLASH_BASE_ADDRESS
	default $(dt_node_reg_addr_hex,/soc/spi@10014000,1)

config FLASH_LOAD_OFFSET
	default 0x0

config SYS_CLOCK_TICKS_PER_SEC
	default 128

endif # BOARD_HIFIVE1_E340_B
```

## boards/sifive/hifive1/Kconfig.hifive1
```kconfig
# SPDX-License-Identifier: Apache-2.0

config BOARD_HIFIVE1
	select SOC_SIFIVE_FREEDOM_E340
	select RISCV_CORE_E31 if BOARD_HIFIVE1_E340_B
```

## boards/sifive/hifive1/board.yml
```yaml
board:
  name: hifive1
  vendor: SiFive
  revision:
    format: letter
    default: "A"
    revisions:
      - name: "A"
      - name: "B"
  socs:
  - name: e340
```

## boards/sifive/hifive1/hifive1_e340_A_defconfig
```kconfig
# SPDX-License-Identifier: Apache-2.0

CONFIG_QEMU_ICOUNT_SHIFT=6
CONFIG_BUILD_OUTPUT_HEX=y
```
