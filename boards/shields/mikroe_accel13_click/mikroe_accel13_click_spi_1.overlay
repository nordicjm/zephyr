
#define MIKROE_DEVICE mikrobus_1_spi
#define MIKROE_ALIAS iis2dlpc_mikroe_accel13_click_spi_1
#define MIKROE_SPI

#include "mikroe_accel13_click_common.overlay"

#undef MIKROE_DEVICE
#undef MIKROE_ALIAS
#undef MIKROE_SPI
