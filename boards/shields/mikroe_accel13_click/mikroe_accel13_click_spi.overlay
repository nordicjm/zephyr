
#define MIKROE_DEVICE mikrobus_spi
#define MIKROE_ALIAS iis2dlpc_mikroe_accel13_click_spi
#define MIKROE_DRDY_GPIO 7
#define MIKROE_SPI

#include "mikroe_accel13_click_common.overlay"

#undef MIKROE_DEVICE
#undef MIKROE_ALIAS
#undef MIKROE_DRDY_GPIO
#undef MIKROE_SPI
