/*
 * Copyright (c) 2023 Mark Olsson <mark@markolsson.se>
 *
 * SPDX-License-Identifier: Apache-2.0
 */

/ {
	aliases {
		accel0 = &MIKROE_ALIAS;
	};
};


&MIKROE_DEVICE {
	status = "okay";

	MIKROE_ALIAS: iis2dlpc@18 {
		compatible = "st,iis2dlpc";
		reg = <0x18>;
#if MIKROE_DRDY_GPIO
		drdy-gpios =  <&mikrobus_header MIKROE_DRDY_GPIO GPIO_ACTIVE_HIGH>;
#endif
#ifdef MIKROE_SPI
		spi-max-frequency = <1000000>;
#endif
		drdy-int =  <2>;
		status = "okay";
	};
};
