## samples/subsys/mgmt/mcumgr/smp_svr/boards/nrf52840dk_nrf52840.conf
```kconfig
#
# Copyright (c) 2023 Nordic Semiconductor ASA
#
# SPDX-License-Identifier: Apache-2.0
#
CONFIG_RETAINED_MEM_NRF_GPREGRET=n
CONFIG_RETAINED_MEM_ZEPHYR_RAM=y
CONFIG_RETAINED_MEM=y
CONFIG_RETENTION=y
CONFIG_SETTINGS=y
CONFIG_SETTINGS_RUNTIME=y
CONFIG_RETENTION_BOOTLOADER_INFO=y
CONFIG_RETENTION_BOOTLOADER_INFO_TYPE_MCUBOOT=y
CONFIG_SHELL_BACKEND_DUMMY=y
CONFIG_MCUMGR_GRP_FS_MAX_FILE_SIZE_4GB=y
CONFIG_MCUMGR_GRP_FS_CHECKSUM_HASH=y
CONFIG_MCUMGR_GRP_FS_CHECKSUM_HASH_SUPPORTED_CMD=y
CONFIG_TINYCRYPT_SHA256=y
CONFIG_MCUMGR_GRP_FS_HASH_SHA256=y
CONFIG_MCUMGR_GRP_IMG_ALLOW_CONFIRM_NON_ACTIVE_IMAGE_ANY=y
CONFIG_MCUMGR_GRP_IMG_ALLOW_ERASE_PENDING=y
CONFIG_MCUMGR_GRP_IMG_DIRECT_UPLOAD=y
CONFIG_MCUMGR_GRP_OS_TASKSTAT_STACK_INFO=y
CONFIG_MCUMGR_GRP_OS_INFO=y
CONFIG_MCUMGR_GRP_OS_INFO_BUILD_DATE_TIME=y
CONFIG_MCUMGR_GRP_OS_BOOTLOADER_INFO=y
CONFIG_MCUMGR_GRP_SHELL=y
CONFIG_MCUMGR_GRP_SETTINGS=y
CONFIG_RETENTION_BOOTLOADER_INFO_OUTPUT_SETTINGS=y
CONFIG_RETENTION_BOOTLOADER_INFO_OUTPUT_FUNCTION=n
CONFIG_RETENTION_MUTEX_FORCE_DISABLE=y
CONFIG_RETAINED_MEM_MUTEX_FORCE_DISABLE=y
CONFIG_BT=n
CONFIG_SPEED_OPTIMIZATIONS=y
```

## share/sysbuild/Kconfig
```kconfig
# Copyright (c) 2021 Nordic Semiconductor
#
# SPDX-License-Identifier: Apache-2.0

rsource "Kconfig.$(HWM_SCHEME)"

comment "Sysbuild image configuration"

osource "$(BOARD_DIR)/Kconfig.sysbuild"

menu "Modules"

source "modules/Kconfig.sysbuild"

endmenu

config EXPERIMENTAL
	bool
	help
	  Symbol that must be selected by a feature if it is considered to be
	  at an experimental implementation stage.

config WARN_EXPERIMENTAL
	bool
	prompt "Warn on experimental usage"
	help
	  Print a warning when the Kconfig tree is parsed if any experimental
	  features are enabled.

config DEPRECATED
	bool
	help
	  Symbol that must be selected by a feature or module if it is
	  considered to be deprecated.

config WARN_DEPRECATED
	bool
	default y
	prompt "Warn on deprecated usage"
	help
	  Print a warning when the Kconfig tree is parsed if any deprecated
	  features are enabled.

config COMPILER_WARNINGS_AS_ERRORS
	bool "Treat warnings as errors"
	help
	  Turn on "warning as error" toolchain flags for all images if set.

rsource "images/Kconfig"
```

## share/sysbuild/Kconfig.image.template
```kconfig
# This is a Kconfig @template@ file used for passing sysbuild controlled Kconfig
# settings from sysbuild to images.

config SYSBUILD_CONTROLLED
	bool
	default y
	help
	  Setting that can be used to indicate this setting is controlled by
	  sysbuild when sysbuild is used as high level build system.

config SYSBUILD_BOARD
	string
	default "@BOARD@"
	help
	  High-level board defined in sysbuild.

if BOARD = SYSBUILD_BOARD

config BOOTLOADER_MCUBOOT
	default y if "@SB_CONFIG_BOOTLOADER_MCUBOOT@" && !MCUBOOT

config MCUBOOT_SIGNATURE_KEY_FILE
	default "@SB_CONFIG_BOOT_SIGNATURE_KEY_FILE@"

endif

orsource "Kconfig.sysbuild.*.image"
```

## share/sysbuild/bootloader/Kconfig.image.mcuboot.template
```kconfig
choice BOOT_SIGNATURE_TYPE
	default BOOT_SIGNATURE_TYPE_@SB_CONFIG_SIGNATURE_TYPE@
endchoice
```

## share/sysbuild/testcase.yaml
```yaml
tests:
  sysbuild.go:
    tags: sysbuild
    arch_allow: arc arm arm64 mips nios2 posix riscv sparc x86 xtensa
```

## soc/arm/nordic_nrf/Kconfig.base
```kconfig
config SOC_FAMILY_NRF
	select SOC_COMPATIBLE_NRF
	select PLATFORM_SPECIFIC_INIT
	bool

if SOC_FAMILY_NRF
config SOC_FAMILY
	string
	default "nordic_nrf"

source "soc/arm/nordic_nrf/*/Kconfig.base.soc"

endif # SOC_FAMILY_NRF
```

## soc/arm/nordic_nrf/nrf51/Kconfig.base.soc
```kconfig
# Nordic Semiconductor nRF51 MCU line

# Copyright (c) 2016 Linaro Limited
# SPDX-License-Identifier: Apache-2.0

config SOC_NRF51822_QFAA
	bool

config SOC_NRF51822_QFAB
	bool

config SOC_NRF51822_QFAC
	bool
```

## soc/arm/nordic_nrf/nrf52/Kconfig.base.soc
```kconfig
config SOC_NRF52805
	depends on SOC_SERIES_NRF52X
	bool

config SOC_NRF52810
	depends on SOC_SERIES_NRF52X
	bool

config SOC_NRF52811
	depends on SOC_SERIES_NRF52X
	bool

config SOC_NRF52820
	depends on SOC_SERIES_NRF52X
	bool

config SOC_NRF52832
	depends on SOC_SERIES_NRF52X
	bool
	select SOC_COMPATIBLE_NRF52832
	select CPU_CORTEX_M_HAS_DWT
	select CPU_HAS_FPU

config SOC_NRF52833
	depends on SOC_SERIES_NRF52X
	bool
	select CPU_CORTEX_M_HAS_DWT
	select CPU_HAS_FPU

config SOC_NRF52840
	depends on SOC_SERIES_NRF52X
	bool
	select CPU_CORTEX_M_HAS_DWT
	select CPU_HAS_FPU

config SOC_NRF52805_CAAA
	bool
	select SOC_NRF52805

config SOC_NRF52810_QFAA
	bool
	select SOC_NRF52810

config SOC_NRF52811_QFAA
	bool
	select SOC_NRF52811

config SOC_NRF52820_QDAA
	bool
	select SOC_NRF52820

config SOC_NRF52832_CIAA
	bool
	select SOC_NRF52832

config SOC_NRF52832_QFAA
	bool
	select SOC_NRF52832

config SOC_NRF52832_QFAB
	bool
	select SOC_NRF52832

config SOC_NRF52833_QIAA
	bool
	select SOC_NRF52833

config SOC_NRF52840_QIAA
	bool
	select SOC_NRF52840
```

## soc/arm/nordic_nrf/nrf53/Kconfig.base.soc
```kconfig
#if SOC_SERIES_NRF53X

config SOC_NRF5340_CPUAPP
	bool
	select CPU_HAS_NRF_IDAU
	select CPU_HAS_FPU
	select ARMV8_M_DSP

config SOC_NRF5340_CPUNET
	bool
	select HAS_NO_PM

#choice
#	prompt "nRF53x MCU Selection"

config SOC_NRF5340_CPUAPP_QKAA
	bool "NRF5340_CPUAPP_QKAA"
	select SOC_NRF5340_CPUAPP

config SOC_NRF5340_CPUNET_QKAA
	bool "NRF5340_CPUNET_QKAA"
	select SOC_NRF5340_CPUNET

#endchoice

#endif # SOC_SERIES_NRF53X
```

## soc/arm/nordic_nrf/nrf53/Kconfig.soc.names
```kconfig
# Nordic Semiconductor nRF53 MCU line SoC names.

# Copyright (c) 2023 Nordic Semiconductor ASA
# SPDX-License-Identifier: Apache-2.0

# This file contains SoC names and is shared between SoC scheme v1 and v2.

config SOC
	default "nRF5340_CPUAPP_QKAA"
	depends on SOC_NRF5340_CPUAPP_QKAA

config SOC
	default "nRF5340_CPUNET_QKAA"
	depends on SOC_NRF5340_CPUNET_QKAA
```

## soc/arm/nordic_nrf/nrf53/Kconfig.soc.v2
```kconfig
# Nordic Semiconductor nRF52 MCU line

# Copyright (c) 2023 Nordic Semiconductor ASA
# SPDX-License-Identifier: Apache-2.0

config SOC_NRF5340
	bool
	depends on SOC_SERIES_NRF53X

config SOC_NRF5340_CPUAPP
	bool
	depends on SOC_SERIES_NRF53X

config SOC_NRF5340_CPUNET
	bool
	depends on SOC_SERIES_NRF53X

config SOC_NRF5340_CPUAPP_QKAA
	bool "NRF5340_CPUAPP_QKAA"
	select SOC_NRF5340
	select SOC_NRF5340_CPUAPP

config SOC_NRF5340_CPUNET_QKAA
	bool "NRF5340_CPUNET_QKAA"
	select SOC_NRF5340
	select SOC_NRF5340_CPUNET

rsource "Kconfig.soc.names"
```

## soc/espressif/esp32/common/Kconfig.soc
```kconfig
# Copyright (c) 2023 Espressif Systems (Shanghai) Co., Ltd.
# SPDX-License-Identifier: Apache-2.0

config ESPTOOLPY_FLASHFREQ_80M
	bool

config FLASH_SIZE
	int

config FLASH_BASE_ADDRESS
	hex
```

## soc/espressif/esp32c3/Kconfig.soc
```kconfig
# Copyright (c) 2023 Espressif Systems (Shanghai) Co., Ltd.
# SPDX-License-Identifier: Apache-2.0

config SOC_SERIES_ESP32C3
	bool
	select SOC_FAMILY_ESPRESSIF_ESP32
	help
	  ESP32C3

config SOC_ESP32C3
	bool
	select SOC_SERIES_ESP32C3
	help
	  ESP32C3

config SOC_ESP32C3_FX4
	bool
	select SOC_SERIES_ESP32C3
	help
	  ESP32C3_FX4

config SOC_ESP32C3_MINI_N4
	bool
	select SOC_SERIES_ESP32C3
	help
	  ESP32C3_MINI_N4

config SOC_ESP32C3_WROOM_02_N4
	bool
	select SOC_SERIES_ESP32C3
	help
	  ESP32C3_WROOM_02_N4

config SOC_ESP32C3_WROOM_02_N8
	bool
	select SOC_SERIES_ESP32C3
	help
	  ESP32C3_WROOM_02_N8

config SOC_SERIES
	default "esp32c3" if SOC_SERIES_ESP32C3

config SOC
	default "esp32c3" if SOC_SERIES_ESP32C3

config SOC_PART_NUMBER
	default "esp32c3_fx4" if SOC_ESP32C3_FX4
	default "esp32c3_mini_n4" if SOC_ESP32C3_MINI_N4
	default "esp32c3_wroom_02_n4" if SOC_ESP32C3_WROOM_02_N4
	default "esp32c3_wroom_02_n8" if SOC_ESP32C3_WROOM_02_N8
	default "esp32c3" if SOC_ESP32C3
```
