## boards/xtensa/qemu_xtensa/Kconfig.qemu_xtensa
```kconfig
config BOARD_QEMU_XTENSA
	bool
	default y
	select SOC_XTENSA_SAMPLE_CONTROLLER
	select QEMU_TARGET
```

## boards/xtensa/xt-sim/Kconfig.xt_sim
```kconfig
config BOARD_XT_SIM
	bool
	default y
	select SOC_XTENSA_SAMPLE_CONTROLLER
	select SIMULATOR_XTENSA
```

## samples/bluetooth/peripheral_ht/Kconfig
```kconfig
# Copyright (c) 2021 Nordic Semiconductor ASA
# SPDX-License-Identifier: Apache-2.0

mainmenu "Bluetooth: Peripheral HT"

if HAS_HW_NRF_TEMP

config SENSOR
	default y

config TEMP_NRF5
	default y

endif # HAS_HW_NRF_TEMP

config COOL_IMAGE
    bool "Coolest 5340 image on earth"
    depends on SOC_NRF5340_CPUAPP

source "Kconfig.zephyr"
```

## samples/hello_world/boards/nrf52840dk_nrf52840.conf
```kconfig
#
# Copyright (c) 2023 Nordic Semiconductor ASA
#
# SPDX-License-Identifier: Apache-2.0
#
CONFIG_RETAINED_MEM_NRF_GPREGRET=n
CONFIG_RETAINED_MEM_ZEPHYR_RAM=y
CONFIG_RETAINED_MEM=y
CONFIG_RETAINED_MEM_MUTEX_FORCE_DISABLE=y
CONFIG_RETENTION=y
CONFIG_RETENTION_MUTEX_FORCE_DISABLE=y
CONFIG_BOOTLOADER_MCUBOOT=y
CONFIG_MCUBOOT_SIGNATURE_KEY_FILE="/tmp/aa/bootloader/mcuboot/root-rsa-2048.pem"
CONFIG_RETENTION_BOOTLOADER_INFO=y
CONFIG_RETENTION_BOOTLOADER_INFO_TYPE_MCUBOOT=y
```

## samples/subsys/mgmt/mcumgr/smp_svr/_AA/Kconfig/soc/Kconfig.defconfig
```kconfig
# Load Zephyr SoC Kconfig defconfig.
osource "/tmp/aa/zephyr/soc/xlnx/zynqmp/Kconfig.defconfig"
osource "/tmp/aa/zephyr/soc/xlnx/zynq7000/Kconfig.defconfig"
osource "/tmp/aa/zephyr/soc/xen/Kconfig.defconfig"
osource "/tmp/aa/zephyr/soc/ti/simplelink/Kconfig.defconfig"
osource "/tmp/aa/zephyr/soc/ti/lm3s6965/Kconfig.defconfig"
osource "/tmp/aa/zephyr/soc/ti/k3/Kconfig.defconfig"
osource "/tmp/aa/zephyr/soc/telink/tlsr/Kconfig.defconfig"
osource "/tmp/aa/zephyr/soc/synopsys/qemu_arc/Kconfig.defconfig"
osource "/tmp/aa/zephyr/soc/synopsys/nsim/Kconfig.defconfig"
osource "/tmp/aa/zephyr/soc/synopsys/hsdk4xd/Kconfig.defconfig"
osource "/tmp/aa/zephyr/soc/synopsys/hsdk/Kconfig.defconfig"
osource "/tmp/aa/zephyr/soc/synopsys/emsk/Kconfig.defconfig"
osource "/tmp/aa/zephyr/soc/synopsys/emsdp/Kconfig.defconfig"
osource "/tmp/aa/zephyr/soc/synopsys/arc_iot/Kconfig.defconfig"
osource "/tmp/aa/zephyr/soc/starfive/jh71xx/Kconfig.defconfig"
osource "/tmp/aa/zephyr/soc/st/stm32/Kconfig.defconfig"
osource "/tmp/aa/zephyr/soc/silabs/Kconfig.defconfig"
osource "/tmp/aa/zephyr/soc/sifive/sifive_freedom/Kconfig.defconfig"
osource "/tmp/aa/zephyr/soc/rockchip/Kconfig.defconfig"
osource "/tmp/aa/zephyr/soc/riscv/qemu_virt_riscv/Kconfig.defconfig"
osource "/tmp/aa/zephyr/soc/renode/riscv_virtual/Kconfig.defconfig"
osource "/tmp/aa/zephyr/soc/renesas/smartbond/Kconfig.defconfig"
osource "/tmp/aa/zephyr/soc/renesas/rzt2m/Kconfig.defconfig"
osource "/tmp/aa/zephyr/soc/renesas/rcar/Kconfig.defconfig"
osource "/tmp/aa/zephyr/soc/renesas/ra/Kconfig.defconfig"
osource "/tmp/aa/zephyr/soc/raspberrypi/Kconfig.defconfig"
osource "/tmp/aa/zephyr/soc/quicklogic/eos_s3/Kconfig.defconfig"
osource "/tmp/aa/zephyr/soc/qemu_malta/Kconfig.defconfig"
osource "/tmp/aa/zephyr/soc/openisa/rv32m1/Kconfig.defconfig"
osource "/tmp/aa/zephyr/soc/nxp/s32/Kconfig.defconfig"
osource "/tmp/aa/zephyr/soc/nxp/rw/Kconfig.defconfig"
osource "/tmp/aa/zephyr/soc/nxp/mcx/Kconfig.defconfig"
osource "/tmp/aa/zephyr/soc/nxp/lpc/Kconfig.defconfig"
osource "/tmp/aa/zephyr/soc/nxp/layerscape/Kconfig.defconfig"
osource "/tmp/aa/zephyr/soc/nxp/kinetis/Kconfig.defconfig"
osource "/tmp/aa/zephyr/soc/nxp/imxrt/Kconfig.defconfig"
osource "/tmp/aa/zephyr/soc/nxp/imx/Kconfig.defconfig"
osource "/tmp/aa/zephyr/soc/nuvoton/numicro/Kconfig.defconfig"
osource "/tmp/aa/zephyr/soc/nuvoton/numaker/Kconfig.defconfig"
osource "/tmp/aa/zephyr/soc/nuvoton/npcx/Kconfig.defconfig"
osource "/tmp/aa/zephyr/soc/nordic/Kconfig.defconfig"
osource "/tmp/aa/zephyr/soc/neorv32/Kconfig.defconfig"
osource "/tmp/aa/zephyr/soc/native/inf_clock/Kconfig.defconfig"
osource "/tmp/aa/zephyr/soc/microchip/miv/Kconfig.defconfig"
osource "/tmp/aa/zephyr/soc/microchip/mec/Kconfig.defconfig"
osource "/tmp/aa/zephyr/soc/lowrisc/opentitan/Kconfig.defconfig"
osource "/tmp/aa/zephyr/soc/litex/litex_vexriscv/Kconfig.defconfig"
osource "/tmp/aa/zephyr/soc/ite/ec/Kconfig.defconfig"
osource "/tmp/aa/zephyr/soc/intel/raptor_lake/Kconfig.defconfig"
osource "/tmp/aa/zephyr/soc/intel/lakemont/Kconfig.defconfig"
osource "/tmp/aa/zephyr/soc/intel/intel_socfpga_std/Kconfig.defconfig"
osource "/tmp/aa/zephyr/soc/intel/intel_socfpga/Kconfig.defconfig"
osource "/tmp/aa/zephyr/soc/intel/intel_niosv/Kconfig.defconfig"
osource "/tmp/aa/zephyr/soc/intel/intel_ish/Kconfig.defconfig"
osource "/tmp/aa/zephyr/soc/intel/intel_adsp/Kconfig.defconfig"
osource "/tmp/aa/zephyr/soc/intel/elkhart_lake/Kconfig.defconfig"
osource "/tmp/aa/zephyr/soc/intel/atom/Kconfig.defconfig"
osource "/tmp/aa/zephyr/soc/intel/apollo_lake/Kconfig.defconfig"
osource "/tmp/aa/zephyr/soc/intel/alder_lake/Kconfig.defconfig"
osource "/tmp/aa/zephyr/soc/infineon/xmc/Kconfig.defconfig"
osource "/tmp/aa/zephyr/soc/gd/gd32/Kconfig.defconfig"
osource "/tmp/aa/zephyr/soc/gaisler/leon3/Kconfig.defconfig"
osource "/tmp/aa/zephyr/soc/gaisler/gr716a/Kconfig.defconfig"
osource "/tmp/aa/zephyr/soc/espressif/Kconfig.defconfig"
osource "/tmp/aa/zephyr/soc/ene/kb1200/Kconfig.defconfig"
osource "/tmp/aa/zephyr/soc/efinix/sapphire/Kconfig.defconfig"
osource "/tmp/aa/zephyr/soc/cypress/Kconfig.defconfig"
osource "/tmp/aa/zephyr/soc/cdns/xtensa_sample_controller/Kconfig.defconfig"
osource "/tmp/aa/zephyr/soc/cdns/dc233c/Kconfig.defconfig"
osource "/tmp/aa/zephyr/soc/brcm/bcmvk/Kconfig.defconfig"
osource "/tmp/aa/zephyr/soc/brcm/bcm2711/Kconfig.defconfig"
osource "/tmp/aa/zephyr/soc/atmel/sam0/Kconfig.defconfig"
osource "/tmp/aa/zephyr/soc/atmel/sam/Kconfig.defconfig"
osource "/tmp/aa/zephyr/soc/aspeed/Kconfig.defconfig"
osource "/tmp/aa/zephyr/soc/arm/Kconfig.defconfig"
osource "/tmp/aa/zephyr/soc/arm/beetle/Kconfig.defconfig"
osource "/tmp/aa/zephyr/soc/andestech/Kconfig.defconfig"
osource "/tmp/aa/zephyr/soc/ambiq/Kconfig.defconfig"
osource "/tmp/aa/zephyr/soc/altr/zephyr_nios2f/Kconfig.defconfig"
osource "/tmp/aa/zephyr/soc/altr/qemu_nios2/Kconfig.defconfig"
```

## samples/subsys/mgmt/mcumgr/smp_svr/_AA/mcuboot/Kconfig/arch/Kconfig
```kconfig
# Load arch Kconfig descriptions.
osource "/tmp/aa/zephyr/arch/x86/Kconfig"
osource "/tmp/aa/zephyr/arch/xtensa/Kconfig"
osource "/tmp/aa/zephyr/arch/sparc/Kconfig"
osource "/tmp/aa/zephyr/arch/riscv/Kconfig"
osource "/tmp/aa/zephyr/arch/posix/Kconfig"
osource "/tmp/aa/zephyr/arch/nios2/Kconfig"
osource "/tmp/aa/zephyr/arch/mips/Kconfig"
osource "/tmp/aa/zephyr/arch/arm64/Kconfig"
osource "/tmp/aa/zephyr/arch/arm/Kconfig"
osource "/tmp/aa/zephyr/arch/arc/Kconfig"
```

## samples/subsys/mgmt/mcumgr/smp_svr/_AA/mcuboot/Kconfig/soc/Kconfig
```kconfig
# Load Zephyr SoC Kconfig descriptions.
osource "/tmp/aa/zephyr/soc/xlnx/zynqmp/Kconfig"
osource "/tmp/aa/zephyr/soc/xlnx/zynq7000/Kconfig"
osource "/tmp/aa/zephyr/soc/xen/Kconfig"
osource "/tmp/aa/zephyr/soc/ti/simplelink/Kconfig"
osource "/tmp/aa/zephyr/soc/ti/lm3s6965/Kconfig"
osource "/tmp/aa/zephyr/soc/ti/k3/Kconfig"
osource "/tmp/aa/zephyr/soc/telink/tlsr/Kconfig"
osource "/tmp/aa/zephyr/soc/synopsys/qemu_arc/Kconfig"
osource "/tmp/aa/zephyr/soc/synopsys/nsim/Kconfig"
osource "/tmp/aa/zephyr/soc/synopsys/hsdk4xd/Kconfig"
osource "/tmp/aa/zephyr/soc/synopsys/hsdk/Kconfig"
osource "/tmp/aa/zephyr/soc/synopsys/emsk/Kconfig"
osource "/tmp/aa/zephyr/soc/synopsys/emsdp/Kconfig"
osource "/tmp/aa/zephyr/soc/synopsys/arc_iot/Kconfig"
osource "/tmp/aa/zephyr/soc/starfive/jh71xx/Kconfig"
osource "/tmp/aa/zephyr/soc/st/stm32/Kconfig"
osource "/tmp/aa/zephyr/soc/silabs/Kconfig"
osource "/tmp/aa/zephyr/soc/sifive/sifive_freedom/Kconfig"
osource "/tmp/aa/zephyr/soc/rockchip/Kconfig"
osource "/tmp/aa/zephyr/soc/riscv/qemu_virt_riscv/Kconfig"
osource "/tmp/aa/zephyr/soc/renode/riscv_virtual/Kconfig"
osource "/tmp/aa/zephyr/soc/renesas/smartbond/Kconfig"
osource "/tmp/aa/zephyr/soc/renesas/rzt2m/Kconfig"
osource "/tmp/aa/zephyr/soc/renesas/rcar/Kconfig"
osource "/tmp/aa/zephyr/soc/renesas/ra/Kconfig"
osource "/tmp/aa/zephyr/soc/raspberrypi/Kconfig"
osource "/tmp/aa/zephyr/soc/quicklogic/eos_s3/Kconfig"
osource "/tmp/aa/zephyr/soc/qemu_malta/Kconfig"
osource "/tmp/aa/zephyr/soc/openisa/rv32m1/Kconfig"
osource "/tmp/aa/zephyr/soc/nxp/s32/Kconfig"
osource "/tmp/aa/zephyr/soc/nxp/rw/Kconfig"
osource "/tmp/aa/zephyr/soc/nxp/mcx/Kconfig"
osource "/tmp/aa/zephyr/soc/nxp/lpc/Kconfig"
osource "/tmp/aa/zephyr/soc/nxp/layerscape/Kconfig"
osource "/tmp/aa/zephyr/soc/nxp/kinetis/Kconfig"
osource "/tmp/aa/zephyr/soc/nxp/imxrt/Kconfig"
osource "/tmp/aa/zephyr/soc/nxp/imx/Kconfig"
osource "/tmp/aa/zephyr/soc/nuvoton/numicro/Kconfig"
osource "/tmp/aa/zephyr/soc/nuvoton/numaker/Kconfig"
osource "/tmp/aa/zephyr/soc/nuvoton/npcx/Kconfig"
osource "/tmp/aa/zephyr/soc/nordic/Kconfig"
osource "/tmp/aa/zephyr/soc/neorv32/Kconfig"
osource "/tmp/aa/zephyr/soc/native/inf_clock/Kconfig"
osource "/tmp/aa/zephyr/soc/microchip/miv/Kconfig"
osource "/tmp/aa/zephyr/soc/microchip/mec/Kconfig"
osource "/tmp/aa/zephyr/soc/lowrisc/opentitan/Kconfig"
osource "/tmp/aa/zephyr/soc/litex/litex_vexriscv/Kconfig"
osource "/tmp/aa/zephyr/soc/ite/ec/Kconfig"
osource "/tmp/aa/zephyr/soc/intel/raptor_lake/Kconfig"
osource "/tmp/aa/zephyr/soc/intel/lakemont/Kconfig"
osource "/tmp/aa/zephyr/soc/intel/intel_socfpga_std/Kconfig"
osource "/tmp/aa/zephyr/soc/intel/intel_socfpga/Kconfig"
osource "/tmp/aa/zephyr/soc/intel/intel_niosv/Kconfig"
osource "/tmp/aa/zephyr/soc/intel/intel_ish/Kconfig"
osource "/tmp/aa/zephyr/soc/intel/intel_adsp/Kconfig"
osource "/tmp/aa/zephyr/soc/intel/elkhart_lake/Kconfig"
osource "/tmp/aa/zephyr/soc/intel/atom/Kconfig"
osource "/tmp/aa/zephyr/soc/intel/apollo_lake/Kconfig"
osource "/tmp/aa/zephyr/soc/intel/alder_lake/Kconfig"
osource "/tmp/aa/zephyr/soc/infineon/xmc/Kconfig"
osource "/tmp/aa/zephyr/soc/gd/gd32/Kconfig"
osource "/tmp/aa/zephyr/soc/gaisler/leon3/Kconfig"
osource "/tmp/aa/zephyr/soc/gaisler/gr716a/Kconfig"
osource "/tmp/aa/zephyr/soc/espressif/Kconfig"
osource "/tmp/aa/zephyr/soc/ene/kb1200/Kconfig"
osource "/tmp/aa/zephyr/soc/efinix/sapphire/Kconfig"
osource "/tmp/aa/zephyr/soc/cypress/Kconfig"
osource "/tmp/aa/zephyr/soc/cdns/xtensa_sample_controller/Kconfig"
osource "/tmp/aa/zephyr/soc/cdns/dc233c/Kconfig"
osource "/tmp/aa/zephyr/soc/brcm/bcmvk/Kconfig"
osource "/tmp/aa/zephyr/soc/brcm/bcm2711/Kconfig"
osource "/tmp/aa/zephyr/soc/atmel/sam0/Kconfig"
osource "/tmp/aa/zephyr/soc/atmel/sam/Kconfig"
osource "/tmp/aa/zephyr/soc/aspeed/Kconfig"
osource "/tmp/aa/zephyr/soc/arm/Kconfig"
osource "/tmp/aa/zephyr/soc/arm/beetle/Kconfig"
osource "/tmp/aa/zephyr/soc/andestech/Kconfig"
osource "/tmp/aa/zephyr/soc/ambiq/Kconfig"
osource "/tmp/aa/zephyr/soc/altr/zephyr_nios2f/Kconfig"
osource "/tmp/aa/zephyr/soc/altr/qemu_nios2/Kconfig"
```

## samples/subsys/mgmt/mcumgr/smp_svr/_AA/mcuboot/Kconfig/soc/Kconfig.soc
```kconfig
# Load SoC Kconfig descriptions.
osource "/tmp/aa/zephyr/soc/xlnx/zynqmp/Kconfig.soc"
osource "/tmp/aa/zephyr/soc/xlnx/zynq7000/Kconfig.soc"
osource "/tmp/aa/zephyr/soc/xen/Kconfig.soc"
osource "/tmp/aa/zephyr/soc/ti/simplelink/Kconfig.soc"
osource "/tmp/aa/zephyr/soc/ti/lm3s6965/Kconfig.soc"
osource "/tmp/aa/zephyr/soc/ti/k3/Kconfig.soc"
osource "/tmp/aa/zephyr/soc/telink/tlsr/Kconfig.soc"
osource "/tmp/aa/zephyr/soc/synopsys/qemu_arc/Kconfig.soc"
osource "/tmp/aa/zephyr/soc/synopsys/nsim/Kconfig.soc"
osource "/tmp/aa/zephyr/soc/synopsys/hsdk4xd/Kconfig.soc"
osource "/tmp/aa/zephyr/soc/synopsys/hsdk/Kconfig.soc"
osource "/tmp/aa/zephyr/soc/synopsys/emsk/Kconfig.soc"
osource "/tmp/aa/zephyr/soc/synopsys/emsdp/Kconfig.soc"
osource "/tmp/aa/zephyr/soc/synopsys/arc_iot/Kconfig.soc"
osource "/tmp/aa/zephyr/soc/starfive/jh71xx/Kconfig.soc"
osource "/tmp/aa/zephyr/soc/st/stm32/Kconfig.soc"
osource "/tmp/aa/zephyr/soc/silabs/Kconfig.soc"
osource "/tmp/aa/zephyr/soc/sifive/sifive_freedom/Kconfig.soc"
osource "/tmp/aa/zephyr/soc/rockchip/Kconfig.soc"
osource "/tmp/aa/zephyr/soc/riscv/qemu_virt_riscv/Kconfig.soc"
osource "/tmp/aa/zephyr/soc/renode/riscv_virtual/Kconfig.soc"
osource "/tmp/aa/zephyr/soc/renesas/smartbond/Kconfig.soc"
osource "/tmp/aa/zephyr/soc/renesas/rzt2m/Kconfig.soc"
osource "/tmp/aa/zephyr/soc/renesas/rcar/Kconfig.soc"
osource "/tmp/aa/zephyr/soc/renesas/ra/Kconfig.soc"
osource "/tmp/aa/zephyr/soc/raspberrypi/Kconfig.soc"
osource "/tmp/aa/zephyr/soc/quicklogic/eos_s3/Kconfig.soc"
osource "/tmp/aa/zephyr/soc/qemu_malta/Kconfig.soc"
osource "/tmp/aa/zephyr/soc/openisa/rv32m1/Kconfig.soc"
osource "/tmp/aa/zephyr/soc/nxp/s32/Kconfig.soc"
osource "/tmp/aa/zephyr/soc/nxp/rw/Kconfig.soc"
osource "/tmp/aa/zephyr/soc/nxp/mcx/Kconfig.soc"
osource "/tmp/aa/zephyr/soc/nxp/lpc/Kconfig.soc"
osource "/tmp/aa/zephyr/soc/nxp/layerscape/Kconfig.soc"
osource "/tmp/aa/zephyr/soc/nxp/kinetis/Kconfig.soc"
osource "/tmp/aa/zephyr/soc/nxp/imxrt/Kconfig.soc"
osource "/tmp/aa/zephyr/soc/nxp/imx/Kconfig.soc"
osource "/tmp/aa/zephyr/soc/nuvoton/numicro/Kconfig.soc"
osource "/tmp/aa/zephyr/soc/nuvoton/numaker/Kconfig.soc"
osource "/tmp/aa/zephyr/soc/nuvoton/npcx/Kconfig.soc"
osource "/tmp/aa/zephyr/soc/nordic/Kconfig.soc"
osource "/tmp/aa/zephyr/soc/neorv32/Kconfig.soc"
osource "/tmp/aa/zephyr/soc/native/inf_clock/Kconfig.soc"
osource "/tmp/aa/zephyr/soc/microchip/miv/Kconfig.soc"
osource "/tmp/aa/zephyr/soc/microchip/mec/Kconfig.soc"
osource "/tmp/aa/zephyr/soc/lowrisc/opentitan/Kconfig.soc"
osource "/tmp/aa/zephyr/soc/litex/litex_vexriscv/Kconfig.soc"
osource "/tmp/aa/zephyr/soc/ite/ec/Kconfig.soc"
osource "/tmp/aa/zephyr/soc/intel/raptor_lake/Kconfig.soc"
osource "/tmp/aa/zephyr/soc/intel/lakemont/Kconfig.soc"
osource "/tmp/aa/zephyr/soc/intel/intel_socfpga_std/Kconfig.soc"
osource "/tmp/aa/zephyr/soc/intel/intel_socfpga/Kconfig.soc"
osource "/tmp/aa/zephyr/soc/intel/intel_niosv/Kconfig.soc"
osource "/tmp/aa/zephyr/soc/intel/intel_ish/Kconfig.soc"
osource "/tmp/aa/zephyr/soc/intel/intel_adsp/Kconfig.soc"
osource "/tmp/aa/zephyr/soc/intel/elkhart_lake/Kconfig.soc"
osource "/tmp/aa/zephyr/soc/intel/atom/Kconfig.soc"
osource "/tmp/aa/zephyr/soc/intel/apollo_lake/Kconfig.soc"
osource "/tmp/aa/zephyr/soc/intel/alder_lake/Kconfig.soc"
osource "/tmp/aa/zephyr/soc/infineon/xmc/Kconfig.soc"
osource "/tmp/aa/zephyr/soc/gd/gd32/Kconfig.soc"
osource "/tmp/aa/zephyr/soc/gaisler/leon3/Kconfig.soc"
osource "/tmp/aa/zephyr/soc/gaisler/gr716a/Kconfig.soc"
osource "/tmp/aa/zephyr/soc/espressif/Kconfig.soc"
osource "/tmp/aa/zephyr/soc/ene/kb1200/Kconfig.soc"
osource "/tmp/aa/zephyr/soc/efinix/sapphire/Kconfig.soc"
osource "/tmp/aa/zephyr/soc/cypress/Kconfig.soc"
osource "/tmp/aa/zephyr/soc/cdns/xtensa_sample_controller/Kconfig.soc"
osource "/tmp/aa/zephyr/soc/cdns/dc233c/Kconfig.soc"
osource "/tmp/aa/zephyr/soc/brcm/bcmvk/Kconfig.soc"
osource "/tmp/aa/zephyr/soc/brcm/bcm2711/Kconfig.soc"
osource "/tmp/aa/zephyr/soc/atmel/sam0/Kconfig.soc"
osource "/tmp/aa/zephyr/soc/atmel/sam/Kconfig.soc"
osource "/tmp/aa/zephyr/soc/aspeed/Kconfig.soc"
osource "/tmp/aa/zephyr/soc/arm/Kconfig.soc"
osource "/tmp/aa/zephyr/soc/arm/beetle/Kconfig.soc"
osource "/tmp/aa/zephyr/soc/andestech/Kconfig.soc"
osource "/tmp/aa/zephyr/soc/ambiq/Kconfig.soc"
osource "/tmp/aa/zephyr/soc/altr/zephyr_nios2f/Kconfig.soc"
osource "/tmp/aa/zephyr/soc/altr/qemu_nios2/Kconfig.soc"
```
