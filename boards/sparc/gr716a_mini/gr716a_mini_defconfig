## boards/sparc/gr716a_mini/gr716a_mini_defconfig
```kconfig
# SPDX-License-Identifier: Apache-2.0

CONFIG_BOARD_GR716A_MINI=y
CONFIG_CONSOLE=y
CONFIG_SERIAL=y
CONFIG_UART_CONSOLE=y
CONFIG_LEON_GPTIMER=y
```

## boards/sparc/qemu_leon3/Kconfig.qemu_leon3
```kconfig
config BOARD_QEMU_LEON3
	bool
	default y
	select SOC_LEON3
	select QEMU_TARGET
	select CPU_HAS_FPU
```

## boards/x86/ehl_crb/Kconfig.board
```kconfig
# Copyright (c) 2020 Intel Corporation
# SPDX-License-Identifier: Apache-2.0

config BOARD_EHL_CRB
config BOARD_EHL_CRB_SBL
```

## boards/x86/ehl_crb/Kconfig.ehl_crb_sbl
```kconfig
config BOARD_EHL_CRB_SBL
	bool
	default y
	select SOC_ELKHART_LAKE
	select X86_64
```

## boards/x86/qemu_x86/Kconfig.board
```kconfig
# SPDX-License-Identifier: Apache-2.0

config BOARD_QEMU_X86
config BOARD_QEMU_X86_64
config BOARD_QEMU_X86_LAKEMONT
config BOARD_QEMU_X86_TINY
```

## boards/xtensa/esp32/Kconfig.board
```kconfig
# ESP32 board configuration

# Copyright (c) 2017 Intel Corporation
# SPDX-License-Identifier: Apache-2.0

config BOARD_ESP32
```

## boards/xtensa/esp_wrover_kit/Kconfig.board
```kconfig
# ESP-WROVER-KIT board configuration

# Copyright (c) 2021 Espressif Systems (Shanghai) Co., Ltd.
# SPDX-License-Identifier: Apache-2.0

config BOARD_ESP_WROVER_KIT
```

## boards/xtensa/heltec_wifi_lora32_v2/Kconfig.board
```kconfig
# HELTEC ESP32 board configuration

# Copyright (c) 2021 Instituto de Pesquisas Eldorado (eldorado.org.br)
# SPDX-License-Identifier: Apache-2.0

config BOARD_HELTEC_WIFI_LORA32
```

## boards/xtensa/intel_adsp_ace15_mtpm/Kconfig.intel_adsp_ace15_mtpm
```kconfig
config BOARD_INTEL_ADSP_ACE15_MTPM
	bool
	default y
	select SOC_SERIES_INTEL_ACE=y
	select SOC_INTEL_ACE15_MTPM=y
```

## boards/xtensa/intel_adsp_cavs20/Kconfig.intel_adsp_cavs20
```kconfig
config BOARD_INTEL_ADSP_CAVS20
	bool
	default y
	select SOC_INTEL_CAVS_V20
	select SOC_SERIES_INTEL_ADSP_CAVS
```

## boards/xtensa/intel_adsp_cavs20/Kconfig.intel_adsp_cavs20_jsl
```kconfig
config BOARD_INTEL_ADSP_CAVS20_JSL
	bool
	default y
	select SOC_INTEL_CAVS_V20
	select SOC_SERIES_INTEL_ADSP_CAVS
```

## boards/xtensa/intel_adsp_cavs25/Kconfig.intel_adsp_cavs25
```kconfig
config BOARD_INTEL_ADSP_CAVS25
	bool
	default y
	select SOC_SERIES_INTEL_ADSP_CAVS
	select SOC_INTEL_CAVS_V25
```

## boards/xtensa/intel_adsp_cavs25/Kconfig.intel_adsp_cavs25_tgph
```kconfig
config BOARD_INTEL_ADSP_CAVS25_TGPH
	bool
	default y
	select SOC_INTEL_CAVS_V25
	select SOC_SERIES_INTEL_ADSP_CAVS
```
