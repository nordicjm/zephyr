## boards/nordic/nrf7120dk/Kconfig.sysbuild
```kconfig
choice BOOTLOADER
	default BOOTLOADER_MCUBOOT if BOARD_NRF7120DK_NRF7120_CPUAPP_NS
endchoice
```

## dts/bindings/mtd/soc-nv-flash.yaml
```yaml
description: Flash node

compatible: "soc-nv-flash"

include: base.yaml

properties:
  erase-block-size:
    type: int
    description: address alignment required by flash erase operations

  write-block-size:
    type: int
    description: address alignment required by flash write operations

  flash-peripheral-dev:
    type: phandle
    description: |
      Phandle to the flash peripheral whose driver functions are used to interact with this flash
      node.
```

## dts/bindings/mtd/zephyr,mapped-partition.yaml
```yaml
description: |
  Memory-mapped partition of a flash (or other non-volatile storage) memory.

  The ``zephyr,mapped-partition`` node should be children of the NVM memory node. Note also that
  the NVM memory node is usually different from the node representing the NVM controller IP block,
  and the NVM memory node should have a ``flash-peripheral-dev`` phandle property specifying the
  NVM peripheral device and a ``ranges`` property specifying the full range of the NVM area
  (usually the same as the ``reg`` property with a 0x0 prepended before the offset value). Nested
  ``zephyr,mapped-partition`` nodes are supported, and should have ``ranges`` properties set to
  indicate their range to their child nodes.

compatible: "zephyr,mapped-partition"

properties:
  "#address-cells":
    type: int
    default: 1
    description: |
      Number of cells required to represent a child node's reg property address. This must be
      large enough to represent the start offset of each partition. Default is chosen to support
      a 32-bit address.

  "#size-cells":
    type: int
    default: 1
    description: |
      Number of cells required to represent a child node's reg property address. This must be
      large enough to represent the size of each partition in bytes. Default is chosen to support
      a 32-bit address.

  label:
    type: string
    description: Human readable string describing the NVM partition.

  read-only:
    type: boolean
    description: Set this property if the partition is read-only

  reg:
    type: array
    required: true
    description: |
      This should be in the format <OFFSET SIZE>, where OFFSET is the offset of the flash
      partition relative to the base address of the parent memory, and SIZE is the size of the
      partition in bytes.

examples:
  - |
    &flash0 {
            flash-peripheral-dev = <&flash_interface>;
            reg = <0x00000000 DT_SIZE_K(1024)>;
            ranges = <0x0 0x00000000 DT_SIZE_K(1024)>;

            /*
             * Offsets are relative to the flash0 node, if flash0 has an address of 0x10000000 then
             * the below offset of 0x0 means address 0x10000000
             */
            boot_partition: partition@0 {
                    compatible = "zephyr,mapped-partition";
                    label = "mcuboot";
                    reg = <0x00000000 0x0000C000>;
            };

            slot0_partition: partition@c000 {
                    compatible = "zephyr,mapped-partition";
                    label = "image-0";
                    reg = <0x0000C000 0x00076000>;
            };

            slot1_partition: partition@82000 {
                    compatible = "zephyr,mapped-partition";
                    label = "image-1";
                    reg = <0x00082000 0x00076000>;
            };

            /*
             * Below example disables an NVM partition, if using the flash map subsystem
             * with the default mappings then the below partition will not be present in
             * the flash map
             */
            storage_partition: partition@f8000 {
                    compatible = "zephyr,mapped-partition";
                    label = "storage";
                    reg = <0x000f8000 0x00008000>;
                    status = "disabled";
            };
    };

    &flash1 {
            flash-peripheral-dev = <&other_flash_interface>;
            reg = <0x10000000 DT_SIZE_K(256)>;
            ranges = <0x0 0x10000000 DT_SIZE_K(256)>;

            /*
             * The 'partitions' grouping is optional, it allows for clearing all partitions in a
             * device (e.g. using a dtc overlay file) but is not required. If used, then it needs
             * a `ranges;` property and to specify the #address-cells and #size-cells properties
             */
            partitions {
                    ranges;
                    #address-cells = <1>;
                    #size-cells = <1>;

                    external_partition: partition@0 {
                            compatible = "zephyr,mapped-partition";
                            reg = <0x00000000 0x00010000>;
                    };
            };
    };
```

## dts/bindings/mtd/zephyr,xip-partition.yaml
```yaml
description: |
  XIP partition of a flash (or other non-volatile storage) memory.

  This should be the binding of children of ``zephyr,xip-partitions`` nodes, and specifies a
  partition in an NVM device which is memory-mapped (as opposed to ``fixed-partitions`` which is
  not memory mapped).

  See the ``zephyr,xip-partitions`` binding for an example of how to use ``zephyr,xip-partition``.

compatible: "zephyr,xip-partition"

properties:
#  description: |
#    Each child node of the fixed-partitions node represents
#    an individual flash partition. These should usually
#    look like this:
#
#      partition_nodelabel: partition@START_OFFSET {
#              label = "human-readable-name";
#              reg = <0xSTART_OFFSET 0xSIZE>;
#      };
  label:
    type: string
    description: Human readable string describing the NVM partition.
  read-only:
    type: boolean
    description: Set this property if the partition is read-only
  reg:
    type: array
    required: true
    description: |
      This should be in the format <OFFSET SIZE>, where OFFSET is the offset of the flash
      partition relative to the base address of the parent memory, and SIZE is the size of the
      partition in bytes.
```

## dts/bindings/mtd/zephyr,xip-partitions.yaml
```yaml
description: |
  XIP partitions of a flash (or other non-volatile storage) memory.

  Note that the usual name for this node is 'partitions'. The zephyr,xip-partitions node should be
  a child of the NVM memory node. Note also that the NVM memory node is usually different from the
  node representing the NVM controller IP block, and the NVM memory node should have a
  ``flash-peripheral-dev`` phandle property specifying the NVM peripheral device.

compatible: "zephyr,xip-partitions"

properties:
  "#address-cells":
    type: int
    default: 1
    description: |
      Number of cells required to represent a child node's reg property address. This must be
      large enough to represent the start offset of each partition. Default is chosen to support
      a 32-bit address.

  "#size-cells":
    type: int
    default: 1
    description: |
      Number of cells required to represent a child node's reg property address. This must be
      large enough to represent the size of each partition in bytes. Default is chosen to support
      a 32-bit address.

examples:
  - |
    &flash0 {
            flash-peripheral-dev = <&flash_interface>;

            partitions {
                    compatible = "zephyr,xip-partitions";

                    /*
                     * Offsets are relative to the grandparent's flash0 node, if flash0 has an
                     * address of 0x10000000 then the below offset of 0x0 means address 0x10000000
                     */
                    boot_partition: partition@0 {
                            compatible = "zephyr,xip-partition";
                            label = "mcuboot";
                            reg = <0x00000000 0x0000C000>;
                    };

                    slot0_partition: partition@c000 {
                            compatible = "zephyr,xip-partition";
                            label = "image-0";
                            reg = <0x0000C000 0x00076000>;
                    };

                    slot1_partition: partition@82000 {
                            compatible = "zephyr,xip-partition";
                            label = "image-1";
                            reg = <0x00082000 0x00076000>;
                    };

                    /*
                     * Below example disables an NVM partition, if using the flash map subsystem
                     * with the default mappings then the below partition will not be present in
                     * the flash map
                     */
                    storage_partition: partition@f8000 {
                            compatible = "zephyr,xip-partition";
                            label = "storage";
                            reg = <0x000f8000 0x00008000>;
                            status = "disabled";
                    };
            };
    };
```

## subsys/mgmt/mcumgr/grp/transport_mgmt/Kconfig
```kconfig
# Copyright Nordic Semiconductor ASA 2025. All rights reserved.
# SPDX-License-Identifier: Apache-2.0

menuconfig MCUMGR_GRP_TRANSPORT
	bool "MCUmgr handlers for transport management"
	depends on SMP_CLIENT
#	select MCUMGR_SMP_CBOR_MIN_DECODING_LEVEL_2
#	select MCUMGR_SMP_CBOR_MIN_ENCODING_LEVEL_2 if ZCBOR_CANONICAL
#	select MCUMGR_SMP_CBOR_MIN_ENCODING_LEVEL_1
	help
	  Enables MCUmgr handlers for transport manipulation.

if MCUMGR_GRP_TRANSPORT

config MCUMGR_GRP_TRANSPORT_LOCKING
	bool "Semaphore locking"
	default y
	help
	  If enabled, will prevent concurrent access of bridge variables with a semaphore. Can be
	  disabled to reduce resource usage on systems where there will not be any concurrent
	  resource usage.

config MCUMGR_GRP_TRANSPORT_MAX_BRIDGES
	int "Maximum bridges"
	range 1 128
	help
	  The maximum number of concurrent bridges to support.

	  Note that this is for the bridge infrastructe itself, individual transports may have
	  lower limits on maximum numbers of concurrent bridges.

choice MCUMGR_GRP_TRANSPORT_GROUP_ID_TYPE
	prompt "Group ID type"
	default MCUMGR_GRP_TRANSPORT_GROUP_ID_DEFAULT
	help
	  todo

config MCUMGR_GRP_TRANSPORT_GROUP_ID_DEFAULT
	bool "Default"
	help
	  Uses the global default transport group ID, which is universally compatible.

config MCUMGR_GRP_TRANSPORT_GROUP_ID_CUSTOM_VALUE
	bool "Specify custom value"
	help
	  A Kconfig value will be used to set the transport group ID, which is custom to an
	  application or device.

if MCUMGR_GRP_TRANSPORT_GROUP_ID_CUSTOM_VALUE

config MCUMGR_GRP_TRANSPORT_GROUP_ID_CUSTOM_VALUE_GROUP_ID
	int "Group ID"
	range 64 65535
	help
	  The group index to use for the transport management group.

endif # MCUMGR_GRP_TRANSPORT_GROUP_ID_CUSTOM_VALUE

config MCUMGR_GRP_TRANSPORT_GROUP_ID_CUSTOM_FUNCTION
	bool "Get from custom function"
	help
	  A function's return value will be used to set the transport group ID, which is custom
	  to an application or device.

endchoice

config MCUMGR_GRP_TRANSPORT_INFO_FUNCTIONS
	bool
	prompt "Info functions" if !MCUMGR_GRP_TRANSPORT_GROUP_ID_DEFAULT
	default y
	help
	  Disabling this will remove the information functions which frees up resources on
	  devices where the transport layout is static or already known, meaning that this will no
	  longer comply with the transport management group specification, hence why it can only
	  be disabled when using a custom group ID.

config MCUMGR_GRP_TRANSPORT_INFO_FUNCTIONS
	bool
	prompt "Info functions" if !MCUMGR_GRP_TRANSPORT_GROUP_ID_DEFAULT
	default y
	help
	  Disabling this will remove the information functions which frees up resources on
	  devices where the transport layout is static or already known, meaning that this will no
	  longer comply with the transport management group specification, hence why it can only
	  be disabled when using a custom group ID.

config MCUMGR_GRP_TRANSPORT_HOOKS
	bool "Callback hooks"
	depends on MCUMGR_MGMT_NOTIFICATION_HOOKS
	help
	  Allows applications to get notification hooks on a transport bridge being connected or
	  disconnected.

endif # MCUMGR_GRP_TRANSPORT
```
