## boards/arm64/mimx8mp_evk/Kconfig.board
```kconfig
# Copyright 2021-2022 NXP
# SPDX-License-Identifier: Apache-2.0

config BOARD_MIMX8MP_EVK_A53
```

## boards/arm64/mimx8mp_evk/Kconfig.mimx8mp_evk_a53_smp
```kconfig
config BOARD_MIMX8MP_EVK_A53
	bool
	default y
	select SOC_SERIES_MIMX8M_A53
	select SOC_MIMX8MP_A53
```

## boards/arm64/nxp_ls1046ardb/Kconfig.board
```kconfig
#
# Copyright 2021 NXP
# SPDX-License-Identifier: Apache-2.0
#

config BOARD_NXP_LS1046ARDB
```

## boards/arm64/nxp_ls1046ardb/Kconfig.nxp_ls1046ardb
```kconfig
config BOARD_NXP_LS1046ARDB
	bool
	default y
	select SOC_SERIES_LS1046A
	select SOC_LS1046A
```

## boards/arm64/nxp_ls1046ardb/Kconfig.nxp_ls1046ardb_smp_2cores
```kconfig
config BOARD_NXP_LS1046ARDB_SMP_2CORES
	bool
	default y
	select SOC_SERIES_LS1046A
	select SOC_LS1046A
```

## boards/arm64/nxp_ls1046ardb/Kconfig.nxp_ls1046ardb_smp_4cores
```kconfig
config BOARD_NXP_LS1046ARDB_SMP_4CORES
	bool
	default y
	select SOC_SERIES_LS1046A
	select SOC_LS1046A
```

## boards/espressif/esp32_devkitc_wroom/Kconfig.esp32_devkitc_wroom
```kconfig
# Copyright (c) 2023 Espressif Systems (Shanghai) Co., Ltd.
# SPDX-License-Identifier: Apache-2.0

config BOARD_ESP32_DEVKITC_WROOM
	select SOC_SERIES_ESP32
	select SOC_ESP32_CPUPRO if BOARD_ESP32_DEVKITC_WROOM_ESP32_CPUPRO
	select SOC_ESP32_CPUAPP if BOARD_ESP32_DEVKITC_WROOM_ESP32_CPUAPP
```

## boards/espressif/esp32_devkitc_wrover/Kconfig.esp32_devkitc_wrover
```kconfig
# Copyright (c) 2023 Espressif Systems (Shanghai) Co., Ltd.
# SPDX-License-Identifier: Apache-2.0

config BOARD_ESP32_DEVKITC_WROVER
	bool
	default y
	select SOC_SERIES_ESP32

config BOARD_ESP32_DEVKITC_WROVER_APPCPU
	bool
	default y
	select SOC_SERIES_ESP32

choice SOC_PART_NUMBER
	default SOC_ESP32_WROVER_E_N4R8
endchoice
```

## boards/espressif/esp32_devkitc_wrover/board.yml
```yaml
board:
  name: esp32_devkitc_wrover
  vendor: Espressif
  socs:
  - name: esp32_wrover_e_n4r8
```

## boards/espressif/esp32_ethernet_kit/board.yml
```yaml
board:
  name: esp32_ethernet_kit
  vendor: Espressif
  socs:
  - name: esp32_wrover_e_n4r8
```

## boards/espressif/esp32c3_luatos_core/board.yml
```yaml
board:
  name: esp32c3_luatos_core
  vendor: Espressif
  socs:
  - name: esp32c3
```

## boards/espressif/esp32s2_franzininho/board.yml
```yaml
board:
  name: esp32s2_franzininho
  vendor: Espressif
  socs:
  - name: esp32s2_wroom
```

## boards/espressif/esp32s2_lolin_mini/board.yml
```yaml
board:
  name: esp32s2_lolin_mini
  vendor: Espressif
  socs:
  - name: esp32s2_fn4r2
```

## boards/espressif/esp32s2_saola/board.yml
```yaml
board:
  name: esp32s2_saola
  vendor: Espressif
  socs:
  - name: esp32s2_wrover_n4r2
```

## boards/espressif/esp32s3_devkitm/board.yml
```yaml
board:
  name: esp32s3_devkitm
  vendor: Espressif
  socs:
  - name: esp32s3_mini_n8
```

## boards/espressif/esp32s3_luatos_core/Kconfig.esp32s3_luatos_core
```kconfig
# Copyright (c) 2023 YuLong Yao <feilongphone@gmail.com>
# SPDX-License-Identifier: Apache-2.0

# ESP32S3 Core board configuration
config BOARD_ESP32S3_LUATOS_CORE
	bool
	default y
	select SOC_SERIES_ESP32S3

config BOARD_ESP32S3_LUATOS_CORE_USB
	bool
	default y
	select SOC_SERIES_ESP32S3

choice SOC_PART_NUMBER
	default SOC_ESP32S3_MINI_N8
endchoice
```

## boards/espressif/esp32s3_luatos_core/board.yml
```yaml
board:
  name: esp32s3_luatos_core
  vendor: Espressif
  socs:
  - name: esp32s3_mini_n8
```

## boards/espressif/esp_wrover_kit/board.yml
```yaml
board:
  name: esp_wrover_kit
  vendor: Espressif
  socs:
  - name: esp32_wrover_e_n4r8
```
