## boards/Kconfig.v2
```kconfig
# Copyright (c) 2022-2024 Nordic Semiconductor ASA

# SPDX-License-Identifier: Apache-2.0

BOARD_STRING := $(sanitize_upper,$(BOARD))
BOARD_FULL_STRING := $(sanitize_upper,$(BOARD)$(BOARD_IDENTIFIER))
BOARD_QUALIFIERS := $(substring,$(BOARD_IDENTIFIER),1)

config BOARD_$(BOARD_STRING)
	def_bool y
	help
	  Kconfig symbol identifying the board.

config BOARD_$(BOARD_FULL_STRING)
	def_bool y
	help
	  Kconfig symbol identifying the board including full board identifier.

config BOARD_QUALIFIERS
	string
	default "$(BOARD_QUALIFIERS)"
	help
	  Contains the qualifiers of the board being used without the name of the board itself.

	  For example, if building for ``nrf5340dk/nrf5340/cpuapp`` then this will contain the
	  value ``nrf5340/cpuapp``.

config BOARD_TARGET
	string
	default "$(BOARD)@$(BOARD_REVISION)$(BOARD_IDENTIFIER)" if "$(BOARD_REVISION)" != ""
	default "$(BOARD)$(BOARD_IDENTIFIER)"
	help
	  Contains the board target (full string including name, revision, soc, cluster and
	  variant) of the board being used.

	  For example, if building for ``nrf5340dk/nrf5340/cpuapp`` then this will contain the
	  value ``nrf5340dk/nrf5340/cpuapp``.

osource "$(BOARD_DIR)/Kconfig.$(BOARD)"
```

## boards/arc/em_starterkit/Kconfig.em_starterkit_em11d
```kconfig
#TODO: dumb name needs fixing, does not fit the filename, has other kconfigs...
config BOARD_EM_STARTERKIT_R23
	bool
	default y
	select SOC_EMSK
	select SOC_EMSK_EM11D
```

## boards/arc/emsdp/Kconfig.emsdp
```kconfig
config BOARD_EMSDP
	bool
	default y
	select SOC_ARC_EMSDP
	select SOC_EMSDP_EM11D
```

## boards/arc/emsdp/Kconfig.emsdp_em4
```kconfig
config BOARD_EMSDP_EM4
	bool
	default y
	select SOC_ARC_EMSDP
	select SOC_EMSDP_EM4
```

## boards/arc/emsdp/Kconfig.emsdp_em6
```kconfig
config BOARD_EMSDP_EM6
	bool
	default y
	select SOC_ARC_EMSDP
	select SOC_EMSDP_EM6
```

## boards/arc/emsdp/Kconfig.emsdp_em7d
```kconfig
config BOARD_EMSDP_EM7D
	bool
	default y
	select SOC_ARC_EMSDP
	select SOC_EMSDP_EM7D
```

## boards/arc/hsdk/Kconfig.board
```kconfig
# DesignWare ARC HS Development Kit board configuration

# Copyright (c) 2019 Synopsys, Inc. All rights reserved.
# SPDX-License-Identifier: Apache-2.0

config BOARD_HSDK
```

## boards/arc/nsim/Kconfig.nsim_sem
```kconfig
config BOARD_NSIM_SEM
	bool
	default y
	select SOC_NSIM
	select SOC_NSIM_SEM
	select HAS_COVERAGE_SUPPORT
```

## boards/arc/nsim/Kconfig.nsim_sem_mpu_stack_guard
```kconfig
config BOARD_NSIM_SEM_MPU_STACK_GUARD
	bool
	default y
	select SOC_NSIM
	select SOC_NSIM_SEM
	select HAS_COVERAGE_SUPPORT
```

## boards/arc/qemu_arc/Kconfig.board
```kconfig
# Copyright (c) 2020 Synopsys, Inc. All rights reserved.
#
# SPDX-License-Identifier: Apache-2.0

config BOARD_QEMU_ARC
```

## boards/arc/qemu_arc/Kconfig.qemu_arc_em
```kconfig
config BOARD_QEMU_ARC_EM
	bool
	default y
	select SOC_QEMU_ARC
	select SOC_QEMU_ARC_EM
```

## boards/arc/qemu_arc/Kconfig.qemu_arc_hs5x
```kconfig
config BOARD_QEMU_ARC_HS5X
	bool
	default y
	select SOC_QEMU_ARC
	select SOC_QEMU_ARC_HS5X
```

## boards/arc/qemu_arc/Kconfig.qemu_arc_hs6x
```kconfig
config BOARD_QEMU_ARC_HS6X
	bool
	default y
	select SOC_QEMU_ARC
	select SOC_QEMU_ARC_HS6X
```

## boards/arm/96b_aerocore2/Kconfig.96b_aerocore2
```kconfig
config BOARD_96B_AEROCORE2
	bool
	default y
	select SOC_SERIES_STM32F4X
	select SOC_STM32F427XX
```

## boards/arm/96b_argonkey/Kconfig.96b_argonkey
```kconfig
config BOARD_96B_ARGONKEY
	bool
	default y
	select SOC_SERIES_STM32F4X
	select SOC_STM32F412CX
```

## boards/arm/96b_avenger96/Kconfig.96b_avenger96
```kconfig
config BOARD_96B_AVENGER96
	bool
	default y
	select SOC_SERIES_STM32MP1X
	select SOC_STM32MP15_M4
```

## boards/arm/96b_carbon/Kconfig.96b_carbon
```kconfig
config BOARD_96B_CARBON
	bool
	default y
	select SOC_SERIES_STM32F4X
	select SOC_STM32F401XE
```

## boards/arm/96b_carbon_nrf51/Kconfig.96b_carbon_nrf51
```kconfig
config BOARD_96B_CARBON_NRF51
	bool
	default y
	select SOC_SERIES_NRF51X
	select SOC_NRF51822_QFAC
```

## boards/arm/96b_meerkat96/96b_meerkat96_defconfig
```kconfig
#
# Copyright (c) 2019, Linaro Ltd.
#
# SPDX-License-Identifier: Apache-2.0
#

CONFIG_BOARD_96B_MEERKAT96=y
CONFIG_CORTEX_M_SYSTICK=y

# enable uart driver
CONFIG_SERIAL=y
CONFIG_UART_INTERRUPT_DRIVEN=y

# console
CONFIG_CONSOLE=y
CONFIG_UART_CONSOLE=y

# pinctrl
CONFIG_PINCTRL=y

CONFIG_XIP=y
```

## boards/arm/96b_meerkat96/Kconfig.96b_meerkat96
```kconfig
config BOARD_96B_MEERKAT96
	bool
	default y
	select SOC_SERIES_IMX7_M4
	select SOC_MCIMX7_M4
	select SOC_PART_NUMBER_MCIMX7D5EVM10SC
```

## boards/arm/96b_neonkey/Kconfig.96b_neonkey
```kconfig
config BOARD_96B_NEONKEY
	bool
	default y
	select SOC_SERIES_STM32F4X
	select SOC_STM32F411XE
```
