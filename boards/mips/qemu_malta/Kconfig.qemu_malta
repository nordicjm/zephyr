## boards/mips/qemu_malta/Kconfig.qemu_malta
```kconfig
config BOARD_QEMU_MALTA
	bool
	default y
	select SOC_QEMU_MALTA
	select QEMU_TARGET
	select BIG_ENDIAN
```

## boards/native/bsim/Kconfig.bsim
```kconfig
# SPDX-License-Identifier: Apache-2.0

config BOARD_BSIM
	select SOC_POSIX
	select NRF_RTC_TIMER
	select CLOCK_CONTROL

config BOARD_BSIM_POSIX_NRF52833
	bool
	select SOC_SERIES_BSIM_NRF52X
	select SOC_COMPATIBLE_NRF52833
	help
	  Will produce a console Linux process which can be executed natively.
	  It needs the BabbleSim simulator both in compile time and to execute

config BOARD_BSIM_POSIX_NRF5340_CPUNET
	bool
	select SOC_SERIES_BSIM_NRF53X
	select SOC_COMPATIBLE_NRF5340_CPUNET
	help
	  Will produce a console Linux process which can be executed natively.
	  It needs the BabbleSim simulator both in compile time and to execute

config BOARD_BSIM_POSIX_NRF5340_CPUAPP
	bool
	select SOC_SERIES_BSIM_NRF53X
	select SOC_COMPATIBLE_NRF5340_CPUAPP
	help
	  Will produce a console Linux process which can be executed natively.
	  It needs the BabbleSim simulator both in compile time and to execute
```

## boards/native/bsim/board.yml
```yaml
board:
  name: bsim
  vendor: native
  socs:
  - name: posix
    variants:
    - name: nrf52833
    - name: nrf5340
      variants:
      - name: cpuapp
      - name: cpunet
```

## boards/native/bsim/bsim_posix_nrf52833_defconfig
```kconfig
# SPDX-License-Identifier: Apache-2.0

CONFIG_CONSOLE=y
CONFIG_NO_OPTIMIZATIONS=y
CONFIG_LOG_BACKEND_UART=n
```

## boards/native/native_sim/Kconfig.native_sim
```kconfig
# Copyright (c) 2023 Nordic Semiconductor ASA
# SPDX-License-Identifier: Apache-2.0

config BOARD_NATIVE_SIM_POSIX_64
	bool
	select 64BIT
	help
	  Will produce a console Linux process which can be executed natively
	  as a 64-bit executable.
```

## boards/native/native_sim/board.yml
```yaml
board:
  name: native_sim
  vendor: native
  socs:
  - name: posix
    variants:
    - name: '64'
```

## boards/nios2/qemu_nios2/Kconfig.qemu_nios2
```kconfig
config BOARD_QEMU_NIOS2
	bool
	default y
	select SOC_NIOS2_QEMU
	select QEMU_TARGET
```

## boards/posix/native_posix/Kconfig.board
```kconfig
# SPDX-License-Identifier: Apache-2.0

config BOARD_NATIVE_POSIX_32BIT
config BOARD_NATIVE_POSIX_64BIT
```

## boards/posix/native_posix/Kconfig.native_posix_32bit
```kconfig
config BOARD_NATIVE_POSIX_32BIT
	bool
	default y
	select SOC_POSIX
	select BOARD_NATIVE_POSIX
```

## boards/posix/native_posix/Kconfig.native_posix_64bit
```kconfig
config BOARD_NATIVE_POSIX_64BIT
	bool
	default y
	select SOC_POSIX
	select BOARD_NATIVE_POSIX
	select 64BIT
```

## boards/riscv/adp_xc7k_ae350/Kconfig.adp_xc7k_ae350
```kconfig
config BOARD_ADP_XC7K_AE350
	bool
	default y
	select SOC_SERIES_RISCV_ANDES_V5
	select SOC_RISCV_ANDES_AE350
```

## boards/riscv/beaglev_starlight_jh7100/Kconfig.beaglev_starlight_jh7100
```kconfig
config BOARD_BEAGLEV_STARLIGHT_JH7100
	bool
	default y
	select SOC_SERIES_STARFIVE_JH71XX
	select SOC_JH7100
	select 64BIT
```

## boards/riscv/beaglev_starlight_jh7100/Kconfig.board
```kconfig
# Copyright (c) 2021 Rajnesh Kanwal <rajnesh.kanwal49@gmail.com>
# SPDX-License-Identifier: Apache-2.0

config BOARD_BEAGLEV_STARLIGHT_JH7100
```

## boards/riscv/esp32c3_devkitm/Kconfig.esp32c3_devkitm
```kconfig
config BOARD_ESP32C3_DEVKITM
	bool
	default y
	select SOC_ESP32C3
	select CONSOLE_HAS_DRIVER
```

## boards/riscv/gd32vf103c_starter/Kconfig.gd32vf103c_starter
```kconfig
config BOARD_GD32VF103C_STARTER
	bool
	default y
	select SOC_SERIES_GD32VF103
	select SOC_GD32VF103
```

## boards/riscv/gd32vf103c_starter/gd32vf103c_starter_defconfig
```kconfig
# Copyright (c) 2022 YuLong Yao <feilongphone@gmail.com>
# SPDX-License-Identifier: Apache-2.0

CONFIG_BOARD_GD32VF103C_STARTER=y

CONFIG_GD32_HXTAL_8MHZ=y
CONFIG_RISCV_MACHINE_TIMER=y
```

## boards/riscv/gd32vf103v_eval/Kconfig.gd32vf103v_eval
```kconfig
config BOARD_GD32VF103V_EVAL
	bool
	default y
	select SOC_SERIES_GD32VF103
	select SOC_GD32VF103
```
