/*
 * Copyright (c) 2024 Nordic Semiconductor ASA
 *
 * SPDX-License-Identifier: Apache-2.0
 */

#include "nrf54l_05_10_15.dtsi"

&cpuapp_sram {
	reg = <0x20000000 DT_SIZE_K(192)>;
	ranges = <0x0 0x20000000 DT_SIZE_K(192)>;
};

&rram_controller {
	reg = <0x5004b000 0x1000>, <0x0 DT_SIZE_K(1012)>;
};

&cpuapp_rram {
	reg = <0x0 DT_SIZE_K(1012)>;
	ranges = <0x0 0x0 DT_SIZE_K(1012)>;
};
