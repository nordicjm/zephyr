## soc/nordic_nrf/nrf52/Kconfig.defconfig.series
```kconfig
# Nordic Semiconductor nRF52 MCU line

# Copyright (c) 2016-2018 Nordic Semiconductor ASA
# SPDX-License-Identifier: Apache-2.0

if SOC_SERIES_NRF52X

rsource "Kconfig.defconfig.nrf52*"

endif # SOC_SERIES_NRF52X
```

## soc/nordic_nrf/nrf53/Kconfig.defconfig.series
```kconfig
# Nordic Semiconductor nRF53 MCU line

# Copyright (c) 2019 Nordic Semiconductor ASA
# SPDX-License-Identifier: Apache-2.0

if SOC_SERIES_NRF53X

rsource "Kconfig.defconfig.nrf53*"

endif # SOC_SERIES_NRF53X
```

## soc/sifive/freedom/e300/Kconfig
```kconfig
# RISCV_SIFIVE_FREEDOM SOC implementation

# Copyright (c) 2017 Jean-Paul Etienne <fractalclone@gmail.com>
# SPDX-License-Identifier: Apache-2.0

config SOC_SERIES_SIFIVE_FREEDOM_E300
	select RISCV
	select RISCV_PRIVILEGED
	select RISCV_HAS_PLIC

config SOC_SIFIVE_FREEDOM_E340
	select ATOMIC_OPERATIONS_C
	select INCLUDE_RESET_VECTOR
	select RISCV_ISA_RV32I
	select RISCV_ISA_EXT_M
	select RISCV_ISA_EXT_A
	select RISCV_ISA_EXT_ZICSR
	select RISCV_ISA_EXT_ZIFENCEI
```

## soc/sifive/freedom/e300/Kconfig.soc
```kconfig
# RISCV_SIFIVE_FREEDOM SOC implementation

# Copyright (c) 2017 Jean-Paul Etienne <fractalclone@gmail.com>
# SPDX-License-Identifier: Apache-2.0

config SOC_SERIES_SIFIVE_FREEDOM_E300
	bool
	select SOC_FAMILY_SIFIVE_FREEDOM
	help
	  SiFive Freedom E300 SOC implementation

config SOC_SIFIVE_FREEDOM_E340
	bool
	select SOC_SERIES_SIFIVE_FREEDOM_E300
	help
	  SiFive Freedom SOC implementation

config SOC_SERIES
	default "e300" if SOC_SERIES_SIFIVE_FREEDOM_E300

config SOC
	default "e340" if SOC_SIFIVE_FREEDOM_E340
```

## soc/sifive/freedom/u500/Kconfig.soc
```kconfig
# RISCV_SIFIVE_FREEDOM SOC implementation

# Copyright (c) 2017 Jean-Paul Etienne <fractalclone@gmail.com>
# SPDX-License-Identifier: Apache-2.0

config SOC_SERIES_SIFIVE_FREEDOM_U500
	bool
	select SOC_FAMILY_SIFIVE_FREEDOM
	help
	  SiFive Freedom U500 SOC implementation

config SOC_SIFIVE_FREEDOM_U540
	bool
	select SOC_SERIES_SIFIVE_FREEDOM_U500
	help
	  SiFive Freedom U540 SOC implementation

config SOC_SERIES
	default "u500" if SOC_SERIES_SIFIVE_FREEDOM_U500

config SOC
	default "u540" if SOC_SIFIVE_FREEDOM_U540
```

## soc/sifive/freedom/u700/Kconfig.soc
```kconfig
# RISCV_SIFIVE_FREEDOM SOC implementation

# Copyright (c) 2017 Jean-Paul Etienne <fractalclone@gmail.com>
# SPDX-License-Identifier: Apache-2.0

config SOC_SERIES_SIFIVE_FREEDOM_U700
	bool
	select SOC_FAMILY_SIFIVE_FREEDOM
	help
	  SiFive Freedom SOC U700 implementation

config SOC_SIFIVE_FREEDOM_U740
	bool
	select SOC_SERIES_SIFIVE_FREEDOM_U700
	help
	  SiFive Freedom U740 SOC implementation

config SOC_SERIES
	default "u700" if SOC_SERIES_SIFIVE_FREEDOM_U700

config SOC
	default "u740" if SOC_SIFIVE_FREEDOM_U740
```

## subsys/mgmt/mcumgr/grp/settings_mgmt/Kconfig
```kconfig
# Copyright Nordic Semiconductor ASA 2023. All rights reserved.
# SPDX-License-Identifier: Apache-2.0

menuconfig MCUMGR_GRP_SETTINGS
	bool "MCUmgr handlers for settings management"
	depends on SETTINGS
	depends on SETTINGS_RUNTIME
	select MCUMGR_SMP_CBOR_MIN_DECODING_LEVEL_2
	select MCUMGR_SMP_CBOR_MIN_ENCODING_LEVEL_2 if ZCBOR_CANONICAL
	select MCUMGR_SMP_CBOR_MIN_ENCODING_LEVEL_1
	help
	  Enables MCUmgr handlers for settings manipulation.

if MCUMGR_GRP_SETTINGS

menu "Supported commands"

config MCUMGR_GRP_SETTINGS_CMD_READ
	bool "Read"
	default y
	help
	  Enables reading from settings (command ID 0, read op-code).

config MCUMGR_GRP_SETTINGS_CMD_WRITE
	bool "Write"
	default y
	help
	  Enables writing to settings (command ID 0, write op-code).

config MCUMGR_GRP_SETTINGS_CMD_DELETE
	bool "Delete"
	default y
	help
	  Enables deleting settings (command ID 1, write op-code).	  

config MCUMGR_GRP_SETTINGS_CMD_COMMIT
	bool "Commit"
	default y
	help
	  Enables committing settings (command ID 2, write op-code).

config MCUMGR_GRP_SETTINGS_CMD_LOAD
	bool "Load"
	default y
	help
	  Enables loading settings (command ID 3, read op-code).

config MCUMGR_GRP_SETTINGS_CMD_SAVE
	bool "Save"
	default y
	help
	  Enables saving settings (command ID 3, write op-code).

endmenu

choice MCUMGR_GRP_SETTINGS_BUFFER_TYPE
	prompt "Buffer type"
	default MCUMGR_GRP_SETTINGS_BUFFER_TYPE_STACK
	depends on MCUMGR_GRP_SETTINGS_CMD_READ || MCUMGR_GRP_SETTINGS_CMD_WRITE || MCUMGR_GRP_SETTINGS_CMD_DELETE
	help
	  Selects if the stack or heap will be used for variables that are
	  needed when processing requests.

config MCUMGR_GRP_SETTINGS_BUFFER_TYPE_STACK
	bool "Stack (fixed size)"
	help
	  Use a fixed size stack buffer, any user-supplied values longer than
	  this will be rejected.

	  Note that stack usage for parameter storage alone will be
	  MCUMGR_GRP_SETTINGS_NAME_LEN + MCUMGR_GRP_SETTINGS_VALUE_LEN,
	  therefore the MCUmgr stack should be appropriately sized.

config MCUMGR_GRP_SETTINGS_BUFFER_TYPE_HEAP
	bool "Heap (dynamic size)"
	depends on COMMON_LIBC_MALLOC_ARENA_SIZE > 0
	help
	  Use dynamic heap memory allocation through malloc, if there is
	  insufficient heap memory for the allocation then the request will be
	  rejected.

endchoice

config MCUMGR_GRP_SETTINGS_NAME_LEN
	int "Maximum setting name length"
	default 32
	depends on MCUMGR_GRP_SETTINGS_CMD_READ || MCUMGR_GRP_SETTINGS_CMD_WRITE || MCUMGR_GRP_SETTINGS_CMD_DELETE
	help
	  Maximum length of a key to lookup, this will be the size of the
	  variable if placed on the stack or the maximum allocated size of the
	  variable if placed on the heap.

config MCUMGR_GRP_SETTINGS_VALUE_LEN
	int "Maximum setting value length"
	default 32
	depends on MCUMGR_GRP_SETTINGS_CMD_READ || MCUMGR_GRP_SETTINGS_CMD_WRITE
	help
	  Maximum length of a value to read, this will be the size of the
	  variable if placed on the stack or the allocated size of the
	  variable if placed on the heap (settings does not support getting
	  the size of a value prior to looking it up).

config MCUMGR_GRP_SETTINGS_ACCESS_HOOK
	bool "Settings access hook"
	depends on MCUMGR_MGMT_NOTIFICATION_HOOKS
	help
	  Allows applications to control settings management access by
	  registering for a callback which is then triggered whenever a
	  settings read or write attempt is made.

endif
```

## subsys/retention/Kconfig
```kconfig
# Copyright (c) 2023, Nordic Semiconductor ASA
# SPDX-License-Identifier: Apache-2.0

menuconfig RETENTION
	bool "Retention support"
	depends on CRC
	depends on RETAINED_MEM
	depends on DT_HAS_ZEPHYR_RETENTION_ENABLED
	help
	  Enables support for the retention system, which uses retained memory
	  drivers.

if RETENTION

config RETENTION_INIT_PRIORITY
	int "Retention devices init priority"
	default 86
	help
	  Retention device initialization priority (must be higher than init
	  priorities for retained memory drivers).

config RETENTION_MUTEXES
	bool
	default y
	depends on MULTITHREADING
	depends on !RETENTION_MUTEX_FORCE_DISABLE

config RETENTION_MUTEX_FORCE_DISABLE
	bool "Disable retention mutex support"
	depends on MULTITHREADING
	help
	  Disable use of mutexes which prevent issues with concurrent retention
	  device access. This option should only be enabled when retention
	  access is required in an ISR or for special use cases.

config RETENTION_BUFFER_SIZE
	int "Retention stack buffer sizes"
	default 16
	range 1 4096
	help
	  Size of buffers (stack based) used when reading and writing data
	  from/to the retention device.

menu "Retention modules"

config RETENTION_BOOT_MODE
	bool "Boot mode"
	help
	  Adds a boot mode system that allows for changing execution flow
	  depending upon the value of a boot mode parameter. Can be used for
	  e.g. button-less bootloader serial recovery mode entering from the
	  application.

	  In order to use this, a retention area with at least 1 usable user
	  byte must be created and set as the "zephyr,boot-mode" chosen node
	  via device tree.

menuconfig RETENTION_BOOTLOADER_CONFIG
	bool "Bootloader configuration"
	depends on SETTINGS
	help
	  Adds a bootloader configuration sharing system which allows for
	  retreiving information from the bootloader when data sharing is
	  enabled via the settings system with the "blinfo" prefix.

if RETENTION_BOOTLOADER_CONFIG

# Workaround for not being able to have commas in macro arguments
DT_CHOSEN_BOOTLOADER_CONFIG := zephyr,bootloader-config

config RETENTION_BOOTLOADER_CONFIG_TYPE_MCUBOOT
	bool "MCUboot"
	depends on !MCUBOOT && BOOTLOADER_MCUBOOT
	depends on $(dt_chosen_enabled,$(DT_CHOSEN_BOOTLOADER_CONFIG))
	select MCUBOOT_BOOTUTIL_LIB
	help
	  Adds a bootloader configuration sharing system for MCUboot and
	  applications which allows applications to read the configurion of
	  MCUboot and the running image. This can be used by applications so
	  that they know how to e.g. handle firmware updates and place them
	  into the correct slot.

	  In order to use this, a retention area must be created and set as
	  the "zephyr,bootloader-config" chosen node via device tree, MCUboot
	  must be built with the same "zephyr,bootloader-config" DTS node and
	  have CONFIG_BOOT_SHARE_DATA and CONFIG_BOOT_SHARE_DATA_BOOTINFO
	  enabled, or the shared information will not be accessible.

config RETENTION_BOOTLOADER_CONFIG_INIT_PRIORITY
	int "Bootloader configuration init priority"
	default 87
	help
	  Bootloader configuration initialization priority (must be higher
	  than init priorities for for retention subsystem).

endif

endmenu

module = RETENTION
module-str = retention
source "subsys/logging/Kconfig.template.log_config"

endif # RETENTION
```

## tests/boot/with_mcumgr/testcase.yaml
```yaml
common:
  sysbuild: true
  platform_allow:
    - nrf52840dk_nrf52840
    - nrf5340dk_nrf5340_cpuapp
    - nrf9160dk_nrf9160
  integration_platforms:
    - nrf52840dk_nrf52840
  timeout: 600
  slow: true
tests:
  boot.with_mcumgr.test_upgrade:
    tags:
      - pytest
      - mcuboot
      - mcumgr
    harness: pytest
    harness_config:
      pytest_args: ["-k=test_upgrade"]

  boot.with_mcumgr.test_downgrade_prevention:
    tags:
      - pytest
      - mcuboot
      - mcumgr
    harness: pytest
    harness_config:
      pytest_args: ["-k=test_downgrade_prevention"]
    extra_args:
      - mcuboot_CONFIG_MCUBOOT_DOWNGRADE_PREVENTION=y
    extra_configs:
      - CONFIG_MCUBOOT_IMGTOOL_SIGN_VERSION="1.1.1+1"
```

## tests/cmake/overlays/soc_folder_overlay/Kconfig
```kconfig
# Copyright (c) 2024 Nordic Semiconductor ASA
# SPDX-License-Identifier: Apache-2.0

config SOC_FOLDER_TEST_INCLUDE_BOARD
	bool
	default "$(dt_alias_enabled,test-board)"

config SOC_FOLDER_TEST_INCLUDE_BOARD_SUFFIX
	bool
	default "$(dt_alias_enabled,test-board-suffix)"

config SOC_FOLDER_TEST_INCLUDE_BOARD_QUALIFIERS
	bool
	default "$(dt_alias_enabled,test-board-qualifiers)"

config SOC_FOLDER_TEST_INCLUDE_SOC
	bool
	default "$(dt_alias_enabled,test-soc)"

config SOC_FOLDER_TEST_INCLUDE_SOC_SUFFIX
	bool
	default "$(dt_alias_enabled,test-soc-suffix)"

config SOC_FOLDER_TEST_INCLUDE_SOC_QUALIFIERS
	bool
	default "$(dt_alias_enabled,test-soc-qualifiers)"

config TEST_TYPE
	int "Test type"

source "Kconfig.zephyr"
```

## tests/cmake/overlays/soc_folder_overlay/testcase.yaml
```yaml
common:
  tags:
    - cmake
  platform_allow:
    - native_sim
    - native_sim/native/64
  integration_platforms:
    - native_sim
    - native_sim/native/64
tests:
  cmake.overlays.soc_folder_overlay.default:
    extra_args:
      - CONFIG_TEST_TYPE=0
  cmake.overlays.soc_folder_overlay.suffix:
    extra_args:
      - CONFIG_TEST_TYPE=1
      - FILE_SUFFIX=somesuffix
```

## tests/subsys/mgmt/mcumgr/enum_mgmt/testcase.yaml
```yaml
#
# Copyright (c) 2024 Nordic Semiconductor ASA
#
# SPDX-License-Identifier: Apache-2.0
#
common:
  platform_allow:
    - native_posix
    - native_posix/native/64
    - native_sim
    - native_sim/native/64
    - nrf52840dk/nrf52840
  platform_allow: nrf52840dk/nrf52840
  tags:
    - mgmt
    - mcumgr
    - enum_mgmt
  build_only: true
tests:
  enum.mgmt:
    build_only: false
  enum.mgmt.shell:
    extra_config:
      - CONFIG_SHELL=y
      - CONFIG_SHELL_BACKEND_DUMMY=y
      - CONFIG_MCUMGR_GRP_SHELL=y
  enum.mgmt.os:
    extra_config:
      - CONFIG_MCUMGR_GRP_OS=y
  enum.mgmt.shell.os:
    extra_config:
      - CONFIG_SHELL=y
      - CONFIG_SHELL_BACKEND_DUMMY=y
      - CONFIG_MCUMGR_GRP_SHELL=y
      - CONFIG_MCUMGR_GRP_OS=y
```

## tests/subsys/mgmt/mcumgr/img_mgmt_slots/testcase.yaml
```yaml
#
# Copyright (c) 2024 Nordic Semiconductor ASA
#
# SPDX-License-Identifier: Apache-2.0
#
common:
  platform_allow:
    - nrf52840dk/nrf52840
  tags:
    - mgmt
    - mcumgr
    - img_mgmt
tests:
  img.mgmt.slots:
    build_only: false
```

## tests/subsys/mgmt/mcumgr/os_mgmt_datetime/testcase.yaml
```yaml
#
# Copyright (c) 2023 Nordic Semiconductor ASA
#
# SPDX-License-Identifier: Apache-2.0
#
common:
  tags:
    - mcumgr
    - os_mgmt_info
  # FIXME: Exclude architectures that lack a reboot handler function
  arch_exclude:
    - arm64
    - nios2
    - sparc
    - arc
    - xtensa
    - mips
    - posix
tests:
  mgmt.mcumgr.os.info: {}
```

## west.yml
```yaml
# The west manifest file for upstream Zephyr.
#
# The per-installation west configuration file, .west/config, sets the
# path to the project containing this file in the [manifest] section's
# "path" variable.
#
# You are free to create your own manifest files and put them in any
# repository you want, to create your own custom Zephyr installations.
# For example, you could create a manifest file in your own out of
# tree application directory, which would pull this zephyr repository
# in as an ordinary project.
#
# You can pass your manifest repositories to west init when creating a
# new Zephyr installation. See the west documentation for more
# information.

manifest:
  defaults:
    remote: upstream

  remotes:
    - name: upstream
      url-base: https://github.com/zephyrproject-rtos

  #
  # Please add items below based on alphabetical order
  projects:
    - name: cmsis
      revision: b0612c97c1401feeb4160add6462c3627fe90fc7
      path: modules/hal/cmsis
      groups:
        - hal
    - name: fatfs
      revision: 9237454a30bcf6e14a89db174e8dbeb8f31831d2
      path: modules/fs/fatfs
      groups:
        - fs
    - name: hal_nordic
      revision: 1f9145e8c8359f103b4ac5085c6f5d2e66a2557d
      path: modules/hal/nordic
      groups:
        - hal
    - name: libmetal
      revision: c6efe091dfe02704097586a522969b5a4cc197bd
      path: modules/hal/libmetal
      groups:
        - hal
    - name: littlefs
      path: modules/fs/littlefs
      groups:
        - fs
      revision: 7b2cf4ba759bd530b543644e2790b07cf20cd6aa
    - name: mbedtls
      revision: 3e3e58a92de76069730c63e0d524f40fea948a61
      path: modules/crypto/mbedtls
      groups:
        - crypto
    - name: mcuboot
      revision: 89936c338e46f43cb177a8b928cd80b90f3ace8f
      path: bootloader/mcuboot
    - name: mipi-sys-t
      path: modules/debug/mipi-sys-t
      groups:
        - debug
      revision: d9da086b11cda494d85f4d8a9829f505c2d5e380
    - name: nanopb
      revision: d148bd26718e4c10414f07a7eb1bd24c62e56c5d
      path: modules/lib/nanopb
    - name: segger
      revision: 3a52ab222133193802d3c3b4d21730b9b1f1d2f6
      path: modules/debug/segger
      groups:
        - debug
    - name: tinycbor
      revision: 40daca97b478989884bffb5226e9ab73ca54b8c4
      path: modules/lib/tinycbor
    - name: tinycrypt
      revision: 3e9a49d2672ec01435ffbf0d788db6d95ef28de0
      path: modules/crypto/tinycrypt
      groups:
        - crypto

  group-filter:
    - -ci

  self:
    path: zephyr
    west-commands: scripts/west-commands.yml
    import: submanifests
```
